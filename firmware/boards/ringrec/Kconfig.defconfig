## firmware/modules/ring_inbox/Kconfig
```kconfig
config RING_INBOX
	bool "Ring inbox: the store of the last 16 notifications (pure logic)"
	help
	  No kernel, driver or Bluetooth call. Newest first, the oldest is dropped when the
	  store is full; text fields are cut at a character boundary (UTF-8).
```
