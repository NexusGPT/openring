## firmware/boards/ringrec/board.yml
```yaml
board:
  name: ringrec
  full_name: AI ring recorder (the ring itself)
  vendor: ring
  socs:
  - name: nrf54lm20a
```

## firmware/build-logs/step3/editcheck2/late_fragment/ring_iphone/Kconfig
```kconfig
config RING_IPHONE_LOGIC
	bool "Ring iPhone logic: ANCS response reassembly, AMS decoder (pure)"
	select RING_INBOX
	select RING_TIME_LOGIC
	help
	  No kernel, driver or Bluetooth call.

config RING_IPHONE
	bool "Ring iPhone: notifications and actions, media, time from an iPhone"
	select RING_IPHONE_LOGIC
	select RING_TIME
	select RING_DEVICES
	select BT_GATT_CLIENT
	select BT_GATT_DM
	select BT_GATTP
	select BT_ANCS_CLIENT
	select BT_AMS_CLIENT
	select BT_CTS_CLIENT
	depends on BT_PERIPHERAL && BT_SMP
	help
	  After the link of the active device reaches security level 4 the ring looks for Apple's
	  three services (Notification Center, Media, Current Time) and for Service Changed. A device
	  without them (Android, Mac) is not an error. Nothing received here can start or stop a recording.

config RING_IPHONE_FETCH_QUEUE
	int "Notifications waiting for their attributes"
	default 32
	range 1 255
	depends on RING_IPHONE
	help
	  The iPhone sends every notification it holds when the ring subscribes. The ring asks for the
	  attributes of one at a time. An id that does not fit is not fetched (counted).
```

## firmware/build-logs/step6/fix1-rec-base/tests/devices/testcase.yaml
```yaml
tests:
  ring_devices.logic:
    tags: ring_devices
    platform_allow:
      - native_sim
      - nrf54lm20bsim/nrf54lm20a/cpuapp
    integration_platforms:
      - native_sim
```

## firmware/build-logs/step6/fix1-rec-base/tests/store/testcase.yaml
```yaml
tests:
  ring_store.sim:
    tags: ring_store
    platform_allow:
      - native_sim
      - nrf54lm20bsim/nrf54lm20a/cpuapp
    integration_platforms:
      - native_sim
```

## firmware/build-logs/step6/fix1-rec-editcheck-work/audio-ring_two/Kconfig
```kconfig
config RING_AUDIO_LOGIC
	bool "Ring audio: blocks into chunks (pure part, no kernel call)"
	help
	  The 800-frame discard, the zero fill of a missing block, chunk flags, highlights, motor intervals and the
	  chunk header fields (design/firmware.md sections 4 and 5.3). Stdint, stdbool and string only.

config RING_AUDIO
	bool "Ring audio: the microphones (thin part, reaches hardware only through ring_rhw)"
	depends on RING_RHW
	select RING_AUDIO_LOGIC
	help
	  The audio thread, the ring of 3 chunks, the 100 ms no-block watch, HFXO request and release, the clock
	  pins' sleep state and the hand-off of full chunks to the store (design/firmware.md section 4).

if RING_AUDIO

config RING_AUDIO_STACK_SIZE
	int "Stack of the audio thread, bytes"
	default 4096

config RING_AUDIO_THREAD_PRIO
	int "Priority of the audio thread (preemptible, higher number = lower priority)"
	default 5

endif
```

## firmware/build-logs/step6/fix1-rec-editcheck-work/motor-edge_late/Kconfig
```kconfig
config RING_MOTOR_LOGIC
	bool "Ring motor: patterns, replace rule, charge (pure part, no kernel call)"
	help
	  The seven vibration patterns, the rule which pattern may replace which, the Vibration setting's filter and the
	  charge per pulse (design/firmware.md section 3.1). Stdint and stdbool only.

config RING_MOTOR
	bool "Ring motor: the pattern player (thin part, reaches hardware only through ring_rhw)"
	depends on RING_RHW
	select RING_MOTOR_LOGIC
	help
	  The k_timer that plays a pattern on the MOTOR pin: one high per on segment, no PWM (design/firmware.md
	  section 3.1).
```

## firmware/build-logs/step6/fix1-rec-editcheck-work/screens/power_off_outside_standby/ring_screens/dts/bindings/ring,mem-display.yaml
```yaml
description: |
  Ring memory display: a display that keeps the frame it was given in RAM. It stands in for the
  ring's panel (SH8501A, 120 x 240) until the panel driver exists, and is the display the test
  hook reads back.

compatible: "ring,mem-display"

include: display-controller.yaml
```

## firmware/build-logs/step6/fix1-rec-editcheck-work/screens/wrong_passkey_digit/ring_screens/Kconfig
```kconfig
config RING_SCREENS
	bool "Ring screens: the screens of design/firmware.md 3.3 and 3.4, drawn with LVGL"
	select RING_CORE
	select RING_CONTROL_LOGIC
	select RING_DEVICES_LOGIC
	select RING_INBOX
	select RING_TIME
	select RING_IPHONE_LOGIC
	select DISPLAY
	select LVGL
	select RING_MEM_DISPLAY
	help
	  The pure part (rscr_logic.c) decides which screen is shown; the drawing part (rscr.c,
	  rscr_draw.c) draws it with LVGL in a 240 x 120 frame and turns the frame for the 120 x 240 panel.

config RING_SCREENS_PURE
	bool "Ring screens: the pure part only (no graphics)"
	select RING_CORE
	select RING_CONTROL_LOGIC
	select RING_DEVICES_LOGIC
	select RING_INBOX
	help
	  For the logic test: rscr_logic.c without the display, LVGL or the iPhone part.

config RING_MEM_DISPLAY
	bool "Ring memory display driver (stand-in for the panel)"
	depends on DT_HAS_RING_MEM_DISPLAY_ENABLED
	default y if DT_HAS_RING_MEM_DISPLAY_ENABLED

config RING_SCREENS_CAPTURE
	bool "Ring screens: test hook that reads the frame back and writes PNG files (host builds only)"
	depends on RING_SCREENS

config RING_SCREENS_SIGN_WAIT_MS
	int "How long rscr_sign_start waits for the screens thread (ms)"
	default 5000
	depends on RING_SCREENS

config RING_SCREENS_STACK_SIZE
	int "Stack size of the screens thread"
	default 8192
	depends on RING_SCREENS
	help
	  Static chain on the DK build (tools/stack_report.py): 760 bytes for the largest named chain, without LVGL's own frames,
	  which no tool here measured (the simulated builds run on host stacks). 8192 keeps the figure that the pictures ran with.

config RING_SCREENS_REAL
	bool "Ring screens: call the real devices, control, iPhone and glue parts (the product and the two-device test)"
	depends on RING_SCREENS
	select RING_CONTROL
	select RING_DEVICES
	select RING_IPHONE
	select RING_GLUE
```

## firmware/build-logs/step6/fix1-rec-editcheck-work/xfer-factory_flag_ignored/Kconfig
```kconfig
config RING_XFER_LOGIC
	bool "Ring USB transfer: protocol and descriptor tables (pure part, no kernel call)"
	select CRC
	help
	  The 16-byte header, CRC-32, status codes, opcode table, argument limits and response layouts of
	  design/firmware.md section 6, and the descriptor tables of the vendor class.

config RING_XFER
	bool "Ring USB transfer: the vendor class and its thread (thin part, reaches hardware only through ring_rhw)"
	depends on RING_RHW
	select RING_XFER_LOGIC
	help
	  The transfer thread, the stack enabled on VBUS ready and disabled on VBUS removed, the request reader and the
	  BUSY answer (design/firmware.md section 6).

if RING_XFER

config RING_XFER_STACK_SIZE
	int "Stack of the transfer thread (bytes)"
	default 4096

config RING_XFER_THREAD_PRIO
	int "Priority of the transfer thread (preemptible, higher number = lower priority)"
	default 6

config RING_XFER_SEND_TIMEOUT_MS
	int "Time one send may take before the host is taken as stopped (ms)"
	default 2000

config RING_XFER_RESYNC_MS
	int "Silence on the bulk OUT pipe after which a half-read request is dropped (ms)"
	default 100

endif
```

## firmware/build-logs/step6/j-work/editcheck1/mic_in_factory_idle/Kconfig
```kconfig
config RING_RECORDER
	bool "Ring recorder: the join of software step 6 (actions of the core through the recorder parts, boot, the one microphone path)"
	depends on RING_RHW && RING_STORE && RING_AUDIO && RING_XFER && RING_POWER && RING_MOTOR && RING_SYS
	depends on RING_GLUE && RING_SCREENS && RING_TIME
	help
	  Carries out every action of the core through the units of step 6, runs the boot sequence, bridges the units'
	  callbacks into the core through the glue, fills the USB backend, and holds rec_mics_on(), the one path that
	  switches the microphone supply on (design/firmware.md 3.2). The factory part (ring_factory) is used when
	  CONFIG_RING_FACTORY is set.

config RING_RECORDER_STACK_SIZE
	int "Stack size of the recorder's thread (events from the units' callbacks, recovery scan, storage retry)"
	default 4096
	depends on RING_RECORDER

config RING_RECORDER_PRIO
	int "Priority of the recorder's thread"
	default 7
	depends on RING_RECORDER

config RING_RECORDER_TEST_HOOKS
	bool "Test read-outs of the recorder (the event log tap); simulated builds only"
	depends on RING_RECORDER && RING_RHW_SIM
	help
	  For tests/recorder only: keeps a copy of every event log record the recorder queues, and lets a test start the
	  boot sequence again after rhw_sim_reboot(). Never in the product.
```

## firmware/build-logs/step6/u0-editcheck/disk_fault_late/Kconfig
```kconfig
config RING_RHW
	bool "Ring recorder driver interfaces (rhw)"
	help
	  The driver interfaces of the recorder parts (software step 6): one struct of function pointers per kind
	  of driver, the active instance of each, the specification numbers (rrec_spec.h) and the real clock.

config RING_RHW_SIM
	bool "Simulated drivers of the recorder parts (tests and simulated boards only)"
	depends on RING_RHW
	help
	  Every driver kind runs on a simulated driver written for this project (card, microphone input, power
	  chip, gauge, HFXO, motor pin, storage bus, USB transport, image store, settings, retained memory,
	  watchdog, clock, beacon), with one ordered event log and the faults of rhw_sim.h. Never set in the
	  development kit build.

if RING_RHW_SIM

config RING_RHW_SIM_DISK_POOL
	int "Sectors the simulated card can hold"
	default 4096
	help
	  Written sectors take memory (512 bytes each); unwritten ones read as zero.

config RING_RHW_SIM_LOG_SIZE
	int "Entries of the simulated drivers' event log"
	default 4096

config RING_RHW_SIM_REBOOT_HOOKS
	int "Reboot hooks the units can register"
	default 32

config RING_RHW_SIM_USB_HOST_BYTES
	int "Bytes the simulated USB host buffers before it stops taking packets"
	default 70000

endif
```

## firmware/build-logs/step6/u0-editcheck/disk_fault_late/dts/bindings/ring,sim-mic.yaml
```yaml
description: Simulated stereo microphone input of the ring tests (software step 6, ring_rhw); one 1,024-byte block every 16 ms

compatible: "ring,sim-mic"

properties:
  queue-size:
    type: int
    default: 8
    description: blocks in the slab (design/firmware.md line 420)
```

## firmware/build-logs/step6/u2-editcheck/delete_frees_middle/Kconfig
```kconfig
config RING_STORE
	bool "Ring recorder storage: raw append-only log on the card (software step 6, unit U2)"
	depends on RING_RHW
	select CRC
	help
	  The recording store of design/firmware.md section 5: superblock, index records, event log records and chunks
	  with CRC-32, the recovery scan, free space and deletion after a confirmed transfer. The pure files
	  (rst_fmt.c, rst_layout.c, rst_log.c) make no kernel call; rst.c reaches the card, the storage bus and the
	  VDD_SD rail only through ring_rhw.

if RING_STORE

config RING_STORE_STACK_SIZE
	int "Stack of the storage thread (bytes)"
	default 4096

config RING_STORE_THREAD_PRIORITY
	int "Priority of the storage thread"
	default 5

endif
```

## firmware/build-logs/step6/u5-editcheck2/cc_15250/ring_power/Kconfig
```kconfig
config RING_POWER
	bool "Ring power: battery levels, charger, ship mode, reset causes (software step 6, unit U5)"
	depends on RING_RHW
	help
	  design/firmware.md sections 1.1, 1.2 (R-CHG) and 8. Reaches hardware only through ring_rhw's rhw.h.

if RING_POWER

config RING_POWER_STACK_SIZE
	int "Stack of the power thread"
	default 2048

config RING_POWER_PRIORITY
	int "Priority of the power thread (preemptible)"
	default 5

config RING_POWER_REAL
	bool "The real driver file: nPM1304 chip, charger and the kit's fuel gauge (development kit build only)"
	depends on DT_HAS_NORDIC_NPM1304_ENABLED && !RING_RHW_SIM
	default y
	help
	  Compiles src/rpw_hw_real.c, which registers the real power chip and gauge with ring_rhw. Never in a
	  simulated build; not proven without hardware (plan section 7).

endif
```

## firmware/build-logs/step6/u8-editcopy2/bsim-never_stops/ring_factory/Kconfig
```kconfig
config RING_FACTORY_LOGIC
	bool "Ring factory: sub-command parsing, result layout, levels, ppm, beacon name (pure part, no kernel call)"
	help
	  The pure part of the factory tests of design/firmware.md section 9.3: stdint, stdbool and string only.

config RING_FACTORY
	bool "Ring factory: the FACTORY sub-commands and the ship beacon (thin part, software step 6, unit U8)"
	depends on RING_RHW
	select RING_FACTORY_LOGIC
	imply RING_STORE
	help
	  Runs the tests of design/firmware.md section 9.3 and the ship beacon of ruling R20. Reaches hardware only
	  through ring_rhw (the beacon, the clock) and the other units' public headers; the join supplies the rest through
	  struct rfa_ops. The built-in T-STORE (used when the join gives none) needs RING_STORE.

config RING_FACTORY_REAL
	bool "The real beacon: not-connectable advertising through the Bluetooth host (development kit build only)"
	depends on RING_FACTORY && BT && !RING_RHW_SIM
	default y
	help
	  Compiles src/rfa_hw_real.c, which registers the real beacon with ring_rhw. Never in a simulated build.
```

## firmware/build-logs/step6/u8-editcopy2/store_lba_4097/ring_rhw/dts/bindings/ring,sim-disk.yaml
```yaml
description: Simulated SD card of the ring tests (software step 6, ring_rhw); sparse sectors of 512 bytes

compatible: "ring,sim-disk"

properties:
  sector-count:
    type: int
    default: 7812500
    description: sectors the card reports at mount (default 4,000,000,000 bytes, design/firmware.md line 654)
```

## firmware/modules/ring_control/Kconfig
```kconfig
config RING_CONTROL_LOGIC
	bool "Ring control logic: mode tables and HID report builder"
	select RING_CORE
	help
	  Pure logic (no kernel, driver or Bluetooth call): the four mode tables,
	  the HID report map and the report builder. Needs the ring core only for
	  the names of its actions.

config RING_CONTROL
	bool "Ring control: keyboard, media keys and pointer over HID over GATT"
	select RING_CONTROL_LOGIC
	select RING_DEVICES
	depends on BT_PERIPHERAL && BT_HIDS
	help
	  Sends the joystick actions to the active device as HID reports.

config RING_CONTROL_TEST_HOOKS
	bool "Ring control test hooks (failing releases, sending to a given link)"
	depends on RING_CONTROL
	help
	  For the two-device tests only. Off in the product.
```

## firmware/modules/ring_core/Kconfig
```kconfig
config RING_CORE
	bool "Ring core logic: state machine of FW 1.2, gestures of FW 2.1 and 2.2"
	help
	  Pure logic that takes events with timestamps and returns actions.
	  No hardware, driver, Bluetooth or kernel dependency.
```

## firmware/modules/ring_devices/Kconfig
```kconfig
config RING_DEVICES_LOGIC
	bool "Ring devices logic: device list, switch decision"
	help
	  Pure logic with no kernel, driver or Bluetooth call.

config RING_DEVICES
	bool "Ring devices: pairing with a passkey, three paired devices, active device"
	select RING_DEVICES_LOGIC
	depends on BT_PERIPHERAL && BT_SMP && BT_ID_MAX >= 3
	help
	  One local Bluetooth identity per paired device, up to three devices,
	  one active; switching, reconnect and removal of a pairing.

config RING_DEVICES_FAST_ADV_S
	int "Seconds of fast advertising (100 ms) after a drop or a switch"
	default 30
	depends on RING_DEVICES
	help
	  After that the ring advertises every 1,000 ms (FW 7.3). The pairing
	  window always advertises every 100 ms.
```

## firmware/modules/ring_glue/Kconfig
```kconfig
config RING_GLUE
	bool "Ring glue: joystick edges into the core, the core's actions to control and recording"
	select RING_CORE
	select RING_CONTROL
	help
	  One module shared by the product application and the test application, so the chain
	  that the tests prove is the chain the product runs.

config RING_GLUE_STACK_SIZE
	int "Stack size of the glue's tick thread"
	default 2048
	depends on RING_GLUE
```
