## prj.conf
```kconfig
CONFIG_ZTEST=y
CONFIG_RING_RHW=y
CONFIG_RING_RHW_SIM=y
CONFIG_RING_XFER=y
CONFIG_RING_STORE=y
CONFIG_THREAD_NAME=y
CONFIG_ZTEST_STACK_SIZE=16384
CONFIG_MAIN_STACK_SIZE=8192
CONFIG_SYSTEM_WORKQUEUE_STACK_SIZE=4096
# a test card for xfer_store: 12,000 written sectors (6 MB) hold the small recordings and the log records
CONFIG_RING_RHW_SIM_DISK_POOL=12000
CONFIG_RING_RHW_SIM_LOG_SIZE=16384
```

## boards/native_sim.conf
```kconfig
# Kernel ticks of 0.1 ms so that the timing cases measure the simulated drivers, not a 10 ms tick (run 2: k_sleep(1) took 20 ms)
CONFIG_SYS_CLOCK_TICKS_PER_SEC=10000
```

## src/glue.c
```c
/* glue.c: see glue.h. Written for the tests of unit U4. */
#include <errno.h>
#include <string.h>

#include <zephyr/kernel.h>

#include <ring_rhw/rhw.h>

#include "glue.h"
#include "xt.h"

struct glue_seen gl;

void glue_reset(void)
{
	memset(&gl, 0, sizeof(gl));
}

static bool g_may(void)
{
	return true;
}

static enum rrec_status map_err(int r)
{
	switch (r) {
	case 0:
		return RREC_ST_OK;
	case -ENOENT:
		return RREC_ST_NOT_FOUND;
	case -EACCES:
		return RREC_ST_NOT_CONFIRMED;
	case -EBADMSG:
		return RREC_ST_DIGEST_MISMATCH;
	default:
		return RREC_ST_STORAGE_ERROR;
	}
}

static uint32_t count_recordings(void)
{
	static struct rst_rec_info e[RREC_LIST_MAX_MAX];
	uint32_t first = 0, total = 0;
	uint16_t n = 0;

	do {
		if (rst_list(first, RREC_LIST_MAX_MAX, e, &n) != 0) {
			return 0;
		}
		total += n;
		if (n != 0) {
			first = e[n - 1].recording_id + 1u;
		}
	} while (n == RREC_LIST_MAX_MAX);
	return total;
}

static enum rrec_status g_info(uint8_t out[RREC_GET_INFO_BYTES])
{
	struct rst_space sp;
	uint64_t id = 0;
	uint32_t sectors = 0;

	memset(out, 0, RREC_GET_INFO_BYTES);
	if (rst_space(&sp) != 0) {
		return RREC_ST_STORAGE_ERROR;
	}
	(void)rhw_clock()->device_id(&id);
	/* sector count from the card as the store mounted it */
	(void)rhw_disk()->sector_count(&sectors);
	xt_put(out + RREC_GI_OFF_PROTOCOL, RREC_PROTOCOL_VERSION, 2);
	xt_put(out + RREC_GI_OFF_FW_VERSION, GLUE_FW_VERSION, 4);
	xt_put(out + RREC_GI_OFF_DEVICE_ID, id, 8);
	xt_put(out + RREC_GI_OFF_CARD_SECTORS, sectors, 4);
	xt_put(out + RREC_GI_OFF_CHUNK_COUNT_TOTAL, sp.total, 4);
	xt_put(out + RREC_GI_OFF_FREE_CHUNKS, sp.free_chunks, 4);
	xt_put(out + RREC_GI_OFF_RECORDINGS, count_recordings(), 4);
	xt_put(out + RREC_GI_OFF_BOOT_COUNT, gl.boot_count, 4);
	out[RREC_GI_OFF_FACTORY_FLAG] = gl.factory_flag ? 1 : 0;
	return RREC_ST_OK;
}

static enum rrec_status g_list(uint32_t first, uint16_t max, uint8_t *out, size_t *len)
{
	static struct rst_rec_info e[RREC_LIST_MAX_MAX];
	uint16_t n = 0;
	int r = rst_list(first, max, e, &n);

	if (r != 0) {
		return map_err(r == -EINVAL ? -EIO : r);
	}
	xt_put(out, n, 2);
	for (uint16_t i = 0; i < n; i++) {
		uint8_t *p = out + 2 + i * RREC_LIST_ENTRY_BYTES;

		memset(p, 0, RREC_LIST_ENTRY_BYTES);
		xt_put(p + RREC_LE_OFF_RECORDING_ID, e[i].recording_id, 4);
		p[RREC_LE_OFF_TYPE] = e[i].type;
		p[RREC_LE_OFF_CHANNELS] = e[i].channels;
		p[RREC_LE_OFF_STATE] = e[i].state;
		xt_put(p + RREC_LE_OFF_FIRST_CHUNK_SEQ, e[i].first_chunk_seq, 4);
		xt_put(p + RREC_LE_OFF_CHUNK_COUNT, e[i].chunk_count, 4);
		xt_put(p + RREC_LE_OFF_SAMPLE_RATE, e[i].sample_rate_hz, 4);
		xt_put(p + RREC_LE_OFF_START_UTC_MS, (uint64_t)e[i].start_utc_ms, 8);
		xt_put(p + RREC_LE_OFF_DURATION_FRAMES, e[i].duration_frames, 8);
		xt_put(p + RREC_LE_OFF_DIGEST, e[i].digest, 4);
		xt_put(p + RREC_LE_OFF_HIGHLIGHT_COUNT, e[i].highlight_count, 2);
	}
	*len = 2u + (size_t)n * RREC_LIST_ENTRY_BYTES;
	return RREC_ST_OK;
}

/* the recording exists (not deleted) and holds chunks first .. first + count - 1 */
static enum rrec_status g_range(uint32_t rec, uint32_t first, uint32_t count)
{
	static struct rst_rec_info e[1];
	uint16_t n = 0;
	int r = rst_list(rec, 1, e, &n);

	if (r != 0) {
		return RREC_ST_STORAGE_ERROR;
	}
	if (n == 0 || e[0].recording_id != rec) {
		return RREC_ST_NOT_FOUND;
	}
	if (first >= e[0].chunk_count || count > e[0].chunk_count - first) {
		return RREC_ST_NOT_FOUND;
	}
	return RREC_ST_OK;
}

static enum rrec_status g_read(uint32_t rec, uint32_t chunk, uint8_t *out)
{
	return map_err(rst_read_chunk(rec, chunk, out));
}

static enum rrec_status g_confirm(uint32_t rec, uint32_t digest)
{
	return map_err(rst_confirm(rec, digest));
}

static enum rrec_status g_del(uint32_t rec, uint32_t *free_after)
{
	return map_err(rst_delete(rec, free_after));
}

static enum rrec_status g_time(int64_t utc_ms, int16_t tz)
{
	gl.utc_ms = utc_ms;
	gl.tz = tz;
	gl.time_calls++;
	return RREC_ST_OK;
}

static enum rrec_status g_batt(uint8_t out[RREC_GET_BATTERY_BYTES])
{
	memset(out, 0, RREC_GET_BATTERY_BYTES);
	return RREC_ST_OK;
}

static enum rrec_status g_fwb(uint32_t s, uint32_t c)
{
	ARG_UNUSED(s);
	ARG_UNUSED(c);
	return RREC_ST_OK;
}

static enum rrec_status g_fwd(uint32_t o, const uint8_t *d, size_t l)
{
	ARG_UNUSED(o);
	ARG_UNUSED(d);
	ARG_UNUSED(l);
	return RREC_ST_OK;
}

static enum rrec_status g_fwe(void)
{
	return RREC_ST_OK;
}

static enum rrec_status g_log(uint32_t first, uint16_t max, uint8_t *out, size_t *len)
{
	uint16_t n = 0;
	int r = rst_log_read(first, max, out + 2, &n);

	if (r != 0) {
		return RREC_ST_STORAGE_ERROR;
	}
	xt_put(out, n, 2);
	*len = 2u + (size_t)n * RREC_LOG_RECORD_BYTES;
	return RREC_ST_OK;
}

static enum rrec_status g_factory(const uint8_t *req, size_t len, uint8_t *out, size_t *out_len)
{
	ARG_UNUSED(req);
	ARG_UNUSED(len);
	ARG_UNUSED(out);
	*out_len = 0;
	return gl.factory_flag ? RREC_ST_OK : RREC_ST_NOT_ALLOWED;
}

static void g_after(uint8_t op, enum rrec_status st, uint32_t tag, uint32_t len)
{
	ARG_UNUSED(st);
	ARG_UNUSED(tag);
	ARG_UNUSED(len);
	gl.after_calls++;
	gl.after_op = op;
}

static const struct rxf_backend glue_backend = {
	.may_answer = g_may, .get_info = g_info, .list = g_list, .range_check = g_range, .read_chunk = g_read,
	.confirm = g_confirm, .del = g_del, .set_time = g_time, .get_battery = g_batt, .fw_begin = g_fwb,
	.fw_data = g_fwd, .fw_end = g_fwe, .get_log = g_log, .factory = g_factory, .after_response = g_after,
};

const struct rxf_backend *glue_be(void)
{
	return &glue_backend;
}
```

## src/test_desc.c
```c
/*
 * test_desc.c: suite xfer_desc (unit U4): the descriptor tables of the vendor class (rxf_desc.c).
 * Rows X2 and X22 of firmware/docs/step6-plan.md. Expected bytes are typed from design/firmware.md l.669 (class 0xFF,
 * subclass 0x00, protocol 0x00, bulk OUT 0x01, bulk IN 0x81, 64 bytes at full speed, 512 at high speed) and the
 * USB 2.0 descriptor formats (interface: 9 bytes, type 4; endpoint: 7 bytes, type 5, bulk = 2).
 */
#include "xt.h"

ZTEST_SUITE(xfer_desc, NULL, NULL, NULL, NULL, NULL);

/* X2: the full-speed and high-speed tables, byte by byte */
ZTEST(xfer_desc, test_descriptor_bytes_fs_hs)
{
	uint8_t d[RXF_DESC_BYTES];
	const uint8_t fs[23] = {
		0x09, 0x04, 0x00, 0x00, 0x02, 0xFF, 0x00, 0x00, 0x00,    /* interface 0, 2 endpoints, 0xFF/0x00/0x00 */
		0x07, 0x05, 0x01, 0x02, 0x40, 0x00, 0x00,                /* OUT 0x01, bulk, 64 */
		0x07, 0x05, 0x81, 0x02, 0x40, 0x00, 0x00,                /* IN 0x81, bulk, 64 */
	};
	const uint8_t hs[23] = {
		0x09, 0x04, 0x00, 0x00, 0x02, 0xFF, 0x00, 0x00, 0x00,
		0x07, 0x05, 0x01, 0x02, 0x00, 0x02, 0x00,                /* OUT 0x01, bulk, 512 = 0x0200 */
		0x07, 0x05, 0x81, 0x02, 0x00, 0x02, 0x00,                /* IN 0x81, bulk, 512 */
	};

	memset(d, 0xEE, sizeof(d));
	zassert_equal(rxf_desc_get(RHW_USB_FS, d), 23u);
	zassert_mem_equal(d, fs, sizeof(fs), "full speed table");
	memset(d, 0xEE, sizeof(d));
	zassert_equal(rxf_desc_get(RHW_USB_HS, d), 23u);
	zassert_mem_equal(d, hs, sizeof(hs), "high speed table");
	zassert_equal(rxf_desc_mps(RHW_USB_FS), 64u);
	zassert_equal(rxf_desc_mps(RHW_USB_HS), 512u);
}

/* X22: one vendor interface, no mass storage class and no serial class: the case reads only through the protocol */
ZTEST(xfer_desc, test_one_vendor_interface_only)
{
	enum rhw_usb_speed sp[] = { RHW_USB_FS, RHW_USB_HS };

	for (unsigned s = 0; s < 2; s++) {
		uint8_t d[RXF_DESC_BYTES];
		unsigned ifaces = 0, eps = 0, off = 0, in_n = 0, out_n = 0;
		size_t n = rxf_desc_get(sp[s], d);

		while (off < n) {
			uint8_t len = d[off], type = d[off + 1];

			zassert_true(len >= 2 && off + len <= n, "well formed at offset %u", off);
			if (type == 0x04) {
				ifaces++;
				zassert_equal(d[off + 5], 0xFF, "vendor class");
				zassert_not_equal(d[off + 5], 0x08, "not mass storage");
				zassert_not_equal(d[off + 5], 0x02, "not communications (serial)");
				zassert_not_equal(d[off + 5], 0x0A, "not CDC data");
				zassert_equal(d[off + 6], 0x00);
				zassert_equal(d[off + 7], 0x00);
				zassert_equal(d[off + 4], 2u, "two endpoints");
			} else if (type == 0x05) {
				eps++;
				zassert_equal(d[off + 3] & 0x03, 0x02, "bulk");
				if (d[off + 2] == 0x01) {
					out_n++;
				}
				if (d[off + 2] == 0x81) {
					in_n++;
				}
			} else {
				zassert_unreachable("a descriptor of type %02x in the class's table", type);
			}
			off += len;
		}
		zassert_equal(ifaces, 1u, "exactly one interface");
		zassert_equal(eps, 2u);
		zassert_equal(out_n, 1u);
		zassert_equal(in_n, 1u);
	}
}
```

## src/test_svc.c
```c
/*
 * test_svc.c: suite xfer_svc (unit U4): the thin part (rxf_class.c) on the simulated USB transport, with the fake
 * backend. Rows X4, X6, X16, C18, C24 of firmware/docs/step6-plan.md. The test is the case's host: it writes requests
 * with rhw_sim_usb_host_write() and reads responses with rhw_sim_usb_host_read() or a sink. Simulated time only.
 */
#include "xt.h"

static uint32_t conf_n, unconf_n;
static char conf_thread[16];

static void on_conf(void)
{
	conf_n++;
	strncpy(conf_thread, k_thread_name_get(k_current_get()), sizeof(conf_thread) - 1);
}

static void on_unconf(void)
{
	unconf_n++;
}

static const struct rxf_cb cbs = { .configured = on_conf, .unconfigured = on_unconf };

static void before(void *f)
{
	ARG_UNUSED(f);
	rhw_sim_reset();
	fake_reset();
	conf_n = unconf_n = 0;
	conf_thread[0] = 0;
	zassert_equal(rxf_start(fake_be(), &cbs), 0);
}

static void after(void *f)
{
	ARG_UNUSED(f);
	rhw_sim_usb_host_stop(false);
	rhw_sim_usb_host_sink(NULL);
	(void)rxf_finish(5000);
	k_msleep(5);
}

ZTEST_SUITE(xfer_svc, NULL, NULL, before, after, NULL);

static uint8_t rq[RXF_REQ_BYTES];
static uint8_t rsp[20000];

static void vbus_on(void)
{
	rhw_sim_vbus(true);
	k_msleep(2);
}

static void host_send(uint8_t op, uint32_t tag, const void *pl, uint32_t plen)
{
	size_t n = xt_req(rq, op, tag, pl, plen);

	zassert_equal(rhw_sim_usb_host_write(rq, n), 0);
}

/* what the host receives: 16 bytes, then length more; returns the bytes read (stops at the timeout) */
static size_t host_get(uint8_t *out, size_t max, uint32_t timeout_ms)
{
	size_t n = 0;

	for (uint32_t t = 0; t < timeout_ms; t++) {
		n += rhw_sim_usb_host_read(out + n, max - n);
		if (n >= 16 && n >= 16u + xt_le(out + 8, 4)) {
			return n;
		}
		k_msleep(1);
	}
	return n + rhw_sim_usb_host_read(out + n, max - n);
}

/* X4: the stack is enabled on VBUS ready and disabled on VBUS removed, and not before */
ZTEST(xfer_svc, test_stack_follows_vbus)
{
	uint8_t one[16];

	k_msleep(5);
	zassert_false(rhw_sim_usb_enabled(), "no stack without VBUS");
	zassert_equal(rhw_sim_log_count_kind(RHW_EV_USB_ENABLE), 0u, "no enable before VBUS");
	zassert_equal(rhw_sim_usb_host_write(one, 1), -ENODEV, "nothing listens without VBUS");

	rhw_sim_vbus(true);
	k_msleep(2);
	zassert_true(rhw_sim_usb_enabled());
	zassert_equal(rhw_sim_log_count_kind(RHW_EV_USB_ENABLE), 1u);
	zassert_equal(rhw_sim_log_count_kind(RHW_EV_USB_DISABLE), 0u);

	rhw_sim_vbus(false);
	k_msleep(2);
	zassert_false(rhw_sim_usb_enabled());
	zassert_equal(rhw_sim_log_count_kind(RHW_EV_USB_ENABLE), 1u);
	zassert_equal(rhw_sim_log_count_kind(RHW_EV_USB_DISABLE), 1u);

	/* a second insertion: one more of each, in order enable then disable */
	rhw_sim_vbus(true);
	k_msleep(2);
	rhw_sim_vbus(false);
	k_msleep(2);
	zassert_equal(rhw_sim_log_count_kind(RHW_EV_USB_ENABLE), 2u);
	zassert_equal(rhw_sim_log_count_kind(RHW_EV_USB_DISABLE), 2u);
	int32_t e1 = rhw_sim_log_find(RHW_EV_USB_ENABLE, 0);
	int32_t d1 = rhw_sim_log_find(RHW_EV_USB_DISABLE, 0);
	int32_t e2 = rhw_sim_log_find(RHW_EV_USB_ENABLE, (uint32_t)e1 + 1);

	zassert_true(e1 >= 0 && e1 < d1 && d1 < e2, "enable, disable, enable in this order");
	zassert_false(rhw_sim_usb_enabled());
}

/* X4: the unit answers only while the backend allows it (CHARGING, TRANSFER, FACTORY_TEST) */
ZTEST(xfer_svc, test_silent_when_not_allowed_over_transport)
{
	vbus_on();
	fk.allowed = false;
	host_send(RREC_OP_GET_INFO, 1, NULL, 0);
	zassert_equal(host_get(rsp, sizeof(rsp), 30), 0u, "no byte while the state does not allow USB");
	zassert_equal(fk.calls[RREC_OP_GET_INFO], 0u);
	fk.allowed = true;
	host_send(RREC_OP_GET_INFO, 2, NULL, 0);
	zassert_equal(host_get(rsp, sizeof(rsp), 30), 51u);
	zassert_equal(rsp[3], RREC_ST_OK);
}

/* a request over the transport, written whole, in packets of 64 and byte by byte: the same response */
ZTEST(xfer_svc, test_request_in_pieces)
{
	uint8_t pl[8] = { 0x02, 0x01, 0, 0, 0xD4, 0xC3, 0xB2, 0xA1 };
	size_t n = xt_req(rq, RREC_OP_CONFIRM, 0x0A0B0C0Du, pl, 8);
	static const size_t step[] = { 24, 5, 1, 16, 17 };

	vbus_on();
	for (unsigned s = 0; s < ARRAY_SIZE(step); s++) {
		fake_reset();
		for (size_t off = 0; off < n; off += step[s]) {
			zassert_equal(rhw_sim_usb_host_write(rq + off, MIN(step[s], n - off)), 0);
			k_msleep(1);
		}
		zassert_equal(host_get(rsp, sizeof(rsp), 30), 16u, "step %u", (unsigned)step[s]);
		zassert_equal(rsp[3], RREC_ST_OK);
		zassert_equal(xt_le(rsp + 4, 4), 0x0A0B0C0Du);
		zassert_equal(fk.last_rec, 0x102u);
		zassert_equal(fk.last_digest, 0xA1B2C3D4u);
	}
	/* two requests in one write: the first runs, the second finds it still busy or runs after: both are answered once */
	fake_reset();
	size_t n2 = xt_req(rq + n, RREC_OP_GET_BATTERY, 0x22, NULL, 0);

	zassert_equal(rhw_sim_usb_host_write(rq, n + n2), 0);
	k_msleep(20);
	size_t got = rhw_sim_usb_host_read(rsp, sizeof(rsp));

	zassert_equal(got, 32u, "an answer for each of the two requests");
	/* the BUSY header may overtake the response of the first, so match by tag */
	for (unsigned i = 0; i < 2; i++) {
		uint32_t tag = xt_le(rsp + 16 * i + 4, 4);

		if (tag == 0x0A0B0C0Du) {
			zassert_equal(rsp[16 * i + 3], RREC_ST_OK, "the first request ran");
		} else {
			zassert_equal(tag, 0x22u);
			zassert_equal(rsp[16 * i + 3], RREC_ST_BUSY, "the second arrived while the first was queued: BUSY (FW l.711)");
		}
	}
	zassert_equal(fk.calls[RREC_OP_GET_BATTERY], 0u, "the second request did not run");
}

/* X6: no zero-length packet ends a response; every packet but the last is full; the bytes are 16 + length */
static void check_packets(unsigned expect_bytes, uint32_t mps)
{
	uint32_t n = rhw_sim_log_count(), pk = 0, sum = 0;
	struct rhw_sim_ev ev;
	bool short_seen = false;

	for (uint32_t i = 0; i < n; i++) {
		zassert_true(rhw_sim_log_get(i, &ev));
		if (ev.kind != RHW_EV_USB_PACKET) {
			continue;
		}
		zassert_not_equal(ev.a0, 0, "a zero-length packet at log entry %u", i);
		zassert_equal(ev.a1, mps, "packet size of the speed");
		zassert_false(short_seen, "a short packet before the end of the response");
		if (ev.a0 < (int64_t)mps) {
			short_seen = true;
		}
		zassert_true(ev.a0 <= (int64_t)mps);
		sum += (uint32_t)ev.a0;
		pk++;
	}
	zassert_equal(sum, expect_bytes, "bytes in the packets");
	zassert_true(pk >= 1u);
}

ZTEST(xfer_svc, test_no_zero_length_packet)
{
	uint8_t fac = 0x01;

	vbus_on();
	/* full speed: response of exactly 64 bytes, then 128, then 100 (one short) */
	static const size_t pay[] = { 48, 112, 84 };

	for (unsigned i = 0; i < ARRAY_SIZE(pay); i++) {
		fk.factory_out_len = pay[i];
		rhw_sim_log_clear();
		host_send(RREC_OP_FACTORY, 1, &fac, 1);
		zassert_equal(host_get(rsp, sizeof(rsp), 30), 16u + pay[i]);
		zassert_equal(xt_le(rsp + 8, 4), pay[i]);
		check_packets((unsigned)(16 + pay[i]), 64);
	}
	/* high speed: 256 bytes are one short packet, nothing after it */
	rhw_sim_usb_speed(RHW_USB_HS);
	fk.factory_out_len = 240;
	rhw_sim_log_clear();
	host_send(RREC_OP_FACTORY, 1, &fac, 1);
	zassert_equal(host_get(rsp, sizeof(rsp), 30), 16u + 240u);
	check_packets(16 + 240, 512);
	/* exactly 512 bytes (16 + 496): one full packet and nothing after it */
	uint8_t pl[6] = { 0, 0, 0, 0, 64, 0 };

	fk.list_len = 496;
	rhw_sim_log_clear();
	host_send(RREC_OP_LIST_RECORDINGS, 2, pl, 6);
	zassert_equal(host_get(rsp, sizeof(rsp), 30), 512u);
	check_packets(512, 512);
	zassert_equal(rhw_sim_log_count_kind(RHW_EV_USB_PACKET), 1u);
	/* a LIST of 64 entries: 16 + 2 + 4,096 = 4,114 bytes = 8 packets of 512 and a short one */
	fk.list_len = RXF_LIST_PAYLOAD_MAX;

	rhw_sim_log_clear();
	host_send(RREC_OP_LIST_RECORDINGS, 2, pl, 6);
	zassert_equal(host_get(rsp, sizeof(rsp), 30), 4114u);
	check_packets(4114, 512);
}

/* the bytes of a long response go to a sink: header, then the reference CRC of everything after it */
static size_t sink_total;
static uint8_t sink_hdr[16];
static uint32_t sink_crc;
static bool sink_abort_first;

static void sink_fn(const uint8_t *d, size_t n)
{
	size_t skip = 0;

	if (sink_total < 16) {
		skip = MIN(16 - sink_total, n);
		memcpy(sink_hdr + sink_total, d, skip);
	}
	if (n > skip) {
		sink_crc = xt_crc(sink_crc, d + skip, n - skip);
	}
	sink_total += n;
	if (sink_abort_first) {
		sink_abort_first = false;
		rxf_abort();
	}
}

/* X6, X10 over the transport: a READ_RANGE of 3 chunks arrives as one stream of packets of the speed, no short packet
 * inside, header CRC equal to the reference CRC of the payload */
ZTEST(xfer_svc, test_read_range_over_transport)
{
	uint8_t pl[12];
	static const enum rhw_usb_speed sp[] = { RHW_USB_FS, RHW_USB_HS };

	vbus_on();
	for (unsigned s = 0; s < 2; s++) {
		xt_put(pl, 12, 4);
		xt_put(pl + 4, 0, 4);
		xt_put(pl + 8, 3, 4);
		rhw_sim_usb_speed(sp[s]);
		sink_total = 0;
		sink_crc = 0;
		rhw_sim_usb_host_sink(sink_fn);
		rhw_sim_log_clear();
		host_send(RREC_OP_READ_RANGE, 0x44, pl, 12);
		for (unsigned t = 0; t < 2000 && sink_total < 16u + 3u * 33280u; t++) {
			k_msleep(1);
		}
		zassert_equal(sink_total, 16u + 3u * 33280u);
		zassert_equal(xt_le(sink_hdr + 8, 4), 3u * 33280u);
		zassert_equal(xt_le(sink_hdr + 12, 4), sink_crc, "crc of the payload");
		check_packets(16 + 3 * 33280, sp[s] == RHW_USB_HS ? 512 : 64);
		rhw_sim_usb_host_sink(NULL);
		(void)rxf_finish(1000);
	}
}

static void slow(void)
{
	k_msleep(50);
}

/* X19, C24: a request that arrives while a command runs gets BUSY at once, the command's response follows, and the
 * unit is free again afterwards */
ZTEST(xfer_svc, test_busy_over_transport)
{
	vbus_on();
	fk.hook = slow;
	host_send(RREC_OP_GET_BATTERY, 0x31, NULL, 0);
	k_msleep(5);
	zassert_true(rxf_busy(), "the command runs (rxf_busy for the join)");
	host_send(RREC_OP_GET_INFO, 0x32, NULL, 0);
	k_msleep(5);
	size_t n = rhw_sim_usb_host_read(rsp, sizeof(rsp));

	zassert_equal(n, 16u, "BUSY came while the command still ran");
	zassert_equal(rsp[3], RREC_ST_BUSY);
	zassert_equal(rsp[2], RREC_OP_GET_INFO);
	zassert_equal(xt_le(rsp + 4, 4), 0x32u);
	zassert_equal(fk.calls[RREC_OP_GET_INFO], 0u);
	k_msleep(80);
	n = rhw_sim_usb_host_read(rsp, sizeof(rsp));
	zassert_equal(n, 25u, "then the response of the command that ran");
	zassert_equal(rsp[3], RREC_ST_OK);
	zassert_equal(xt_le(rsp + 4, 4), 0x31u);
	zassert_false(rxf_busy());
	fk.hook = NULL;
	host_send(RREC_OP_GET_INFO, 0x33, NULL, 0);
	zassert_equal(host_get(rsp, sizeof(rsp), 30), 51u);
	zassert_equal(rsp[3], RREC_ST_OK);
	/* a bad request while a command runs gets its own status, not BUSY */
	fk.hook = slow;
	host_send(RREC_OP_GET_BATTERY, 0x34, NULL, 0);
	k_msleep(5);
	size_t m = xt_req(rq, RREC_OP_GET_INFO, 0x35, NULL, 0);

	rq[12] = 9;
	zassert_equal(rhw_sim_usb_host_write(rq, m), 0);
	k_msleep(5);
	n = rhw_sim_usb_host_read(rsp, sizeof(rsp));
	zassert_equal(n, 16u);
	zassert_equal(rsp[3], RREC_ST_BAD_CRC);
	k_msleep(80);
}

/* C18: unconfigured in TRANSFER finishes the command that runs: rxf_finish() waits for it and its response */
ZTEST(xfer_svc, test_finish_and_abort)
{
	vbus_on();
	zassert_equal(rxf_finish(10), 0, "nothing runs: returns at once");
	fk.hook = slow;
	host_send(RREC_OP_GET_BATTERY, 1, NULL, 0);
	k_msleep(5);
	zassert_true(rxf_busy());
	zassert_equal(rxf_finish(10), -ETIMEDOUT, "the command needs 50 ms");
	zassert_equal(rxf_finish(200), 0);
	zassert_false(rxf_busy());
	zassert_equal(rhw_sim_usb_host_read(rsp, sizeof(rsp)), 25u, "its response was handed over before finish returned");
	zassert_equal(rsp[3], RREC_ST_OK);

	/* rxf_abort(): the command that runs ends, no response is sent for it */
	host_send(RREC_OP_GET_BATTERY, 2, NULL, 0);
	k_msleep(5);
	rxf_abort();
	zassert_equal(rxf_finish(200), 0);
	zassert_equal(rhw_sim_usb_host_read(rsp, sizeof(rsp)), 0u, "no response for the aborted command");
	zassert_equal(fk.after_calls, 1u, "only the first command was reported");
	fk.hook = NULL;
	host_send(RREC_OP_GET_INFO, 3, NULL, 0);
	zassert_equal(host_get(rsp, sizeof(rsp), 30), 51u, "the next command runs");
	/* an abort with nothing running does not spoil the next command */
	rxf_abort();
	host_send(RREC_OP_GET_INFO, 4, NULL, 0);
	zassert_equal(host_get(rsp, sizeof(rsp), 30), 51u);

	/* VBUS removed while a command runs (FW l.179): nothing is sent, the stack goes off, the next insertion works */
	fk.hook = slow;
	host_send(RREC_OP_GET_BATTERY, 5, NULL, 0);
	k_msleep(5);
	rhw_sim_vbus(false);
	k_msleep(80);
	zassert_equal(rhw_sim_usb_host_read(rsp, sizeof(rsp)), 0u);
	zassert_false(rhw_sim_usb_enabled());
	zassert_false(rxf_busy());
	fk.hook = NULL;
	vbus_on();
	host_send(RREC_OP_GET_INFO, 6, NULL, 0);
	zassert_equal(host_get(rsp, sizeof(rsp), 30), 51u);

	/* VBUS removed in the middle of a long response: the stream stops */
	uint8_t pl[12];

	xt_put(pl, 1, 4);
	xt_put(pl + 4, 0, 4);
	xt_put(pl + 8, 8, 4);
	sink_total = 0;
	sink_crc = 0;
	sink_abort_first = true;
	rhw_sim_usb_host_sink(sink_fn);
	host_send(RREC_OP_READ_RANGE, 7, pl, 12);
	k_msleep(100);
	zassert_true(sink_total > 0u && sink_total < 16u + 8u * 33280u, "the response stopped after an abort (%u bytes)",
		     (unsigned)sink_total);
	zassert_false(rxf_busy());
	rhw_sim_usb_host_sink(NULL);
}

/* the bus events reach the join on the transfer thread: configured, unconfigured, suspended; VBUS removal is not one */
ZTEST(xfer_svc, test_configured_callbacks)
{
	vbus_on();
	rhw_sim_usb_event(RHW_USB_CONFIGURED);
	k_msleep(2);
	zassert_equal(conf_n, 1u);
	zassert_equal(strcmp(conf_thread, "rxf"), 0, "on the transfer thread, not the driver's context (%s)", conf_thread);
	rhw_sim_usb_event(RHW_USB_UNCONFIGURED);
	k_msleep(2);
	zassert_equal(unconf_n, 1u);
	rhw_sim_usb_event(RHW_USB_SUSPENDED);
	k_msleep(2);
	zassert_equal(unconf_n, 2u);
	rhw_sim_vbus(false);
	k_msleep(2);
	zassert_equal(conf_n, 1u);
	zassert_equal(unconf_n, 2u);
}

/* a half-read request is dropped after the pipe was quiet; the rest of a refused request is dropped, then the next
 * request is read afresh */
ZTEST(xfer_svc, test_bad_magic_and_resync)
{
	uint8_t pl[8] = { 1, 0, 0, 0, 2, 0, 0, 0 };
	size_t n = xt_req(rq, RREC_OP_CONFIRM, 0x61, pl, 8);

	vbus_on();
	/* wrong magic with its payload in the same write: one BAD_MAGIC answer, payload bytes not read as a request */
	xt_put(rq, 0x5253, 2);
	zassert_equal(rhw_sim_usb_host_write(rq, n), 0);
	k_msleep(3);
	zassert_equal(rhw_sim_usb_host_read(rsp, sizeof(rsp)), 16u);
	zassert_equal(rsp[3], RREC_ST_BAD_MAGIC);
	zassert_equal(xt_le(rsp + 4, 4), 0x61u);
	zassert_equal(xt_le(rsp + 8, 4), 0u);
	zassert_equal(fk.calls[RREC_OP_CONFIRM], 0u);
	/* after a quiet period a good request is read */
	k_msleep(150);
	n = xt_req(rq, RREC_OP_GET_INFO, 0x62, NULL, 0);
	zassert_equal(rhw_sim_usb_host_write(rq, n), 0);
	zassert_equal(host_get(rsp, sizeof(rsp), 30), 51u);
	zassert_equal(xt_le(rsp + 4, 4), 0x62u);

	/* a length beyond the largest request: BAD_ARG, no memory overrun */
	n = xt_req(rq, RREC_OP_FW_DATA, 0x63, NULL, 0);
	xt_put(rq + 8, 0x7FFFFFFFu, 4);
	zassert_equal(rhw_sim_usb_host_write(rq, 16), 0);
	k_msleep(3);
	zassert_equal(rhw_sim_usb_host_read(rsp, sizeof(rsp)), 16u);
	zassert_equal(rsp[3], RREC_ST_BAD_ARG);
	k_msleep(150);

	/* half a request, then silence, then a whole one: only the whole one is answered */
	n = xt_req(rq, RREC_OP_CONFIRM, 0x64, pl, 8);
	zassert_equal(rhw_sim_usb_host_write(rq, 20), 0);
	k_msleep(150);
	n = xt_req(rq, RREC_OP_GET_INFO, 0x65, NULL, 0);
	zassert_equal(rhw_sim_usb_host_write(rq, n), 0);
	zassert_equal(host_get(rsp, sizeof(rsp), 30), 51u);
	zassert_equal(xt_le(rsp + 4, 4), 0x65u);
	k_msleep(10);
	zassert_equal(rhw_sim_usb_host_read(rsp, sizeof(rsp)), 0u, "nothing else was answered");
}

/* X16: the reboot request of the join comes after the OK response went out through the transport */
ZTEST(xfer_svc, test_reboot_after_response)
{
	vbus_on();
	rhw_sim_log_clear();
	host_send(RREC_OP_REBOOT, 0x77, NULL, 0);
	zassert_equal(host_get(rsp, sizeof(rsp), 30), 16u);
	k_msleep(2);
	zassert_equal(fk.after_calls, 1u);
	zassert_equal(fk.after_op, RREC_OP_REBOOT);
	zassert_equal(fk.after_st, RREC_ST_OK);
	zassert_equal(fk.after_tag, 0x77u);
	zassert_equal(fk.after_packets, 1u, "the response packet was in the log when the reboot request ran");
	/* the host stops reading: the send times out, the response is not handed over, no reboot request */
	fake_reset();
	rhw_sim_usb_host_stop(true);
	host_send(RREC_OP_REBOOT, 0x78, NULL, 0);
	k_msleep(CONFIG_RING_XFER_SEND_TIMEOUT_MS + 100);
	zassert_equal(fk.after_calls, 0u, "no reboot for an OK that never left");
	zassert_false(rxf_busy());
	rhw_sim_usb_host_stop(false);
	/* FW_END the same */
	host_send(RREC_OP_FW_END, 0x79, NULL, 0);
	zassert_equal(host_get(rsp, sizeof(rsp), 30), 16u);
	k_msleep(2);
	zassert_equal(fk.after_op, RREC_OP_FW_END);
}

/* rxf_start refuses a backend with a missing function */
ZTEST(xfer_svc, test_start_checks_backend)
{
	struct rxf_backend b = *fake_be();

	zassert_equal(rxf_start(NULL, NULL), -EINVAL);
	b.read_chunk = NULL;
	zassert_equal(rxf_start(&b, NULL), -EINVAL);
	b = *fake_be();
	zassert_equal(rxf_start(&b, NULL), 0, "no callbacks is allowed");
	vbus_on();
	rhw_sim_usb_event(RHW_USB_CONFIGURED);
	k_msleep(2);
	zassert_equal(conf_n, 0u);
}
```

## src/xt.c
```c
/* xt.c: helpers shared by the suites of tests/xfer (unit U4). */
#include "xt.h"

static uint32_t crc_table[256];
static bool crc_ready;

uint32_t xt_crc(uint32_t prev, const uint8_t *d, size_t n)
{
	uint32_t c = ~prev;

	if (!crc_ready) {
		for (uint32_t i = 0; i < 256; i++) {
			uint32_t v = i;

			for (int b = 0; b < 8; b++) {
				v = (v & 1u) ? (v >> 1) ^ 0xEDB88320u : (v >> 1);
			}
			crc_table[i] = v;
		}
		crc_ready = true;
	}
	for (size_t i = 0; i < n; i++) {
		c = crc_table[(c ^ d[i]) & 0xFFu] ^ (c >> 8);
	}
	return ~c;
}

uint32_t xt_le(const uint8_t *p, unsigned bytes)
{
	uint32_t v = 0;

	for (unsigned i = 0; i < bytes; i++) {
		v |= (uint32_t)p[i] << (8 * i);
	}
	return v;
}

uint64_t xt_le64(const uint8_t *p)
{
	return (uint64_t)xt_le(p, 4) | ((uint64_t)xt_le(p + 4, 4) << 32);
}

void xt_put(uint8_t *p, uint64_t v, unsigned bytes)
{
	for (unsigned i = 0; i < bytes; i++) {
		p[i] = (uint8_t)(v >> (8 * i));
	}
}

size_t xt_req(uint8_t *out, uint8_t op, uint32_t tag, const void *payload, uint32_t plen)
{
	xt_put(out, 0x5252, 2);
	out[2] = op;
	out[3] = 0;
	xt_put(out + 4, tag, 4);
	xt_put(out + 8, plen, 4);
	xt_put(out + 12, plen == 0 ? 0u : xt_crc(0, payload, plen), 4);
	if (plen != 0) {
		memcpy(out + 16, payload, plen);
	}
	return 16u + plen;
}

/* ---- fake backend */
struct fake fk;

uint8_t fake_chunk_byte(uint32_t rec, uint32_t chunk, uint32_t i)
{
	return (uint8_t)(rec * 31u + chunk * 7u + i * 13u + (i >> 8));
}

static bool f_may(void)
{
	return fk.allowed;
}

static enum rrec_status f_info(uint8_t out[RREC_GET_INFO_BYTES])
{
	fk.calls[RREC_OP_GET_INFO]++;
	for (unsigned i = 0; i < RREC_GET_INFO_BYTES; i++) {
		out[i] = (uint8_t)(0xA0u + i);
	}
	return fk.st[RREC_OP_GET_INFO];
}

static enum rrec_status f_list(uint32_t first, uint16_t max, uint8_t *out, size_t *len)
{
	fk.calls[RREC_OP_LIST_RECORDINGS]++;
	fk.last_first = first;
	fk.last_max = max;
	/* count = max, entries filled with a pattern, up to the size the test asked for */
	xt_put(out, max, 2);
	for (size_t i = 2; i < fk.list_len; i++) {
		out[i] = (uint8_t)i;
	}
	*len = fk.list_len;
	return fk.st[RREC_OP_LIST_RECORDINGS];
}

static enum rrec_status f_range(uint32_t rec, uint32_t first, uint32_t count)
{
	fk.calls[RREC_OP_READ_RANGE]++;
	fk.last_rec = rec;
	fk.last_first = first;
	fk.last_count = count;
	return fk.st[RREC_OP_READ_RANGE];
}

static enum rrec_status f_read(uint32_t rec, uint32_t chunk, uint8_t *out)
{
	fk.read_calls++;
	if (fk.fail_read_at != 0 && fk.read_calls == fk.fail_read_at) {
		return RREC_ST_STORAGE_ERROR;
	}
	for (uint32_t i = 0; i < RREC_CHUNK_BYTES; i++) {
		out[i] = fake_chunk_byte(rec, chunk, i);
	}
	if (fk.change_read_at != 0 && fk.read_calls == fk.change_read_at) {
		out[100] ^= 0x01;
	}
	return RREC_ST_OK;
}

static enum rrec_status f_confirm(uint32_t rec, uint32_t digest)
{
	fk.calls[RREC_OP_CONFIRM]++;
	fk.last_rec = rec;
	fk.last_digest = digest;
	return fk.st[RREC_OP_CONFIRM];
}

static enum rrec_status f_del(uint32_t rec, uint32_t *free_after)
{
	fk.calls[RREC_OP_DELETE]++;
	fk.last_rec = rec;
	*free_after = fk.free_after;
	return fk.st[RREC_OP_DELETE];
}

static enum rrec_status f_time(int64_t utc_ms, int16_t tz)
{
	fk.calls[RREC_OP_SET_TIME]++;
	fk.last_utc_ms = utc_ms;
	fk.last_tz = tz;
	return fk.st[RREC_OP_SET_TIME];
}

static enum rrec_status f_batt(uint8_t out[RREC_GET_BATTERY_BYTES])
{
	fk.calls[RREC_OP_GET_BATTERY]++;
	for (unsigned i = 0; i < RREC_GET_BATTERY_BYTES; i++) {
		out[i] = (uint8_t)(0x50u + i);
	}
	if (fk.hook != NULL) {
		fk.hook();
	}
	return fk.st[RREC_OP_GET_BATTERY];
}

static enum rrec_status f_fwb(uint32_t size, uint32_t crc)
{
	fk.calls[RREC_OP_FW_BEGIN]++;
	fk.last_image_size = size;
	fk.last_image_crc = crc;
	return fk.st[RREC_OP_FW_BEGIN];
}

static enum rrec_status f_fwd(uint32_t offset, const uint8_t *data, size_t len)
{
	fk.calls[RREC_OP_FW_DATA]++;
	fk.last_fw_offset = offset;
	fk.last_fw_len = len;
	fk.last_fw_first = data[0];
	fk.last_fw_lastbyte = data[len - 1];
	return fk.st[RREC_OP_FW_DATA];
}

static enum rrec_status f_fwe(void)
{
	fk.calls[RREC_OP_FW_END]++;
	return fk.st[RREC_OP_FW_END];
}

static enum rrec_status f_log(uint32_t first, uint16_t max, uint8_t *out, size_t *len)
{
	fk.calls[RREC_OP_GET_LOG]++;
	fk.last_first = first;
	fk.last_max = max;
	xt_put(out, max, 2);
	for (size_t i = 2; i < fk.log_len; i++) {
		out[i] = (uint8_t)(i * 3u);
	}
	*len = fk.log_len;
	return fk.st[RREC_OP_GET_LOG];
}

static enum rrec_status f_factory(const uint8_t *req, size_t len, uint8_t *out, size_t *out_len)
{
	fk.calls[RREC_OP_FACTORY]++;
	fk.last_factory_len = len;
	memcpy(fk.last_factory, req, MIN(len, sizeof(fk.last_factory)));
	for (size_t i = 0; i < fk.factory_out_len; i++) {
		out[i] = (uint8_t)(0xC0u + i);
	}
	*out_len = fk.factory_out_len;
	return fk.st[RREC_OP_FACTORY];
}

static void f_after(uint8_t op, enum rrec_status st, uint32_t tag, uint32_t len)
{
	fk.after_calls++;
	fk.after_op = op;
	fk.after_st = st;
	fk.after_tag = tag;
	fk.after_len = len;
	fk.after_seq = ++fk.seq;
	fk.after_packets = rhw_sim_log_count_kind(RHW_EV_USB_PACKET);
}

static const struct rxf_backend fake_backend = {
	.may_answer = f_may, .get_info = f_info, .list = f_list, .range_check = f_range, .read_chunk = f_read,
	.confirm = f_confirm, .del = f_del, .set_time = f_time, .get_battery = f_batt, .fw_begin = f_fwb,
	.fw_data = f_fwd, .fw_end = f_fwe, .get_log = f_log, .factory = f_factory, .after_response = f_after,
};

const struct rxf_backend *fake_be(void)
{
	return &fake_backend;
}

void fake_reset(void)
{
	memset(&fk, 0, sizeof(fk));
	fk.allowed = true;
	fk.list_len = 2 + 3 * RREC_LIST_ENTRY_BYTES;
	fk.log_len = 2 + 2 * RREC_LOG_RECORD_BYTES;
	fk.free_after = 777;
	fk.factory_out_len = 3;
}

/* ---- capture */
struct cap cap;
struct rxf_ctx xctx;

void cap_reset(uint32_t mps)
{
	cap.total = 0;
	cap.pieces = 0;
	cap.bad_pieces = 0;
	cap.last_flags = 0;
	cap.mps = mps;
	cap.pcrc = 0;
	cap.fail_after = 0;
	cap.last_seen_then_more = false;
}

int cap_emit(void *user, const uint8_t *d, size_t n, bool last)
{
	ARG_UNUSED(user);
	if (cap.last_flags != 0) {
		cap.last_seen_then_more = true;
	}
	cap.pieces++;
	fk.seq++;
	if (cap.fail_after != 0 && cap.pieces >= (uint32_t)cap.fail_after) {
		return -EIO;
	}
	if (!last && (n % cap.mps) != 0) {
		cap.bad_pieces++;
	}
	if (last) {
		cap.last_flags++;
	}
	/* the reference CRC covers what follows the header */
	if (cap.total >= RREC_MSG_HEADER_BYTES) {
		cap.pcrc = xt_crc(cap.pcrc, d, n);
	} else {
		size_t skip = RREC_MSG_HEADER_BYTES - cap.total;

		if (n > skip) {
			cap.pcrc = xt_crc(cap.pcrc, d + skip, n - skip);
		}
	}
	if (cap.total < CAP_MAX) {
		memcpy(cap.buf + cap.total, d, MIN(n, CAP_MAX - cap.total));
	}
	cap.total += n;
	return 0;
}

int xt_run(uint32_t mps, const uint8_t *req, size_t n, struct rxf_result *res)
{
	cap_reset(mps);
	return rxf_proto_handle(&xctx, mps, req, n, cap_emit, NULL, res);
}

uint8_t cap_status(void)
{
	return cap.buf[3];
}

uint32_t cap_len(void)
{
	return xt_le(cap.buf + 8, 4);
}

uint32_t cap_tag(void)
{
	return xt_le(cap.buf + 4, 4);
}

uint32_t cap_crc(void)
{
	return xt_le(cap.buf + 12, 4);
}
```

## src/xt.h
```c
/* xt.h: helpers shared by the suites of tests/xfer (unit U4): a reference CRC-32, little-endian access, request
 * builders, a response capture, and a fake backend. Expected values in the cases are typed from design/firmware.md. */
#ifndef XT_H
#define XT_H

#include <errno.h>
#include <string.h>

#include <zephyr/kernel.h>
#include <zephyr/ztest.h>

#include <ring_rhw/rhw.h>
#include <ring_rhw/rhw_sim.h>
#include <ring_xfer/rxf.h>

#include "rxf_desc.h"
#include "rxf_proto.h"

/* CRC-32/ISO-HDLC written for the tests (table built from the reflected polynomial): the expected values never come
 * from the code under test (which calls the C library's crc32_ieee). */
uint32_t xt_crc(uint32_t prev, const uint8_t *d, size_t n);      /* prev = 0 starts; chain with the result */
uint32_t xt_le(const uint8_t *p, unsigned bytes);                /* little-endian read, 1 to 4 bytes */
uint64_t xt_le64(const uint8_t *p);
void xt_put(uint8_t *p, uint64_t v, unsigned bytes);             /* little-endian write */

/* A request: header (status 0, CRC of the payload, 0 when empty) and payload. Returns the total length. */
size_t xt_req(uint8_t *out, uint8_t op, uint32_t tag, const void *payload, uint32_t plen);

/* What the fake backend does and what it saw. */
struct fake {
	bool allowed;                           /* may_answer() */
	enum rrec_status st[RREC_OP_LAST + 1];  /* status each command returns (index = opcode; READ_RANGE: range_check) */
	uint32_t calls[RREC_OP_LAST + 1];       /* calls per opcode (READ_RANGE counts range_check; reads: read_calls) */
	uint32_t read_calls;                    /* read_chunk calls */
	uint32_t fail_read_at;                  /* read_chunk call number (from 1) that fails with STORAGE_ERROR; 0 = never */
	uint32_t change_read_at;                /* read_chunk call number whose data differs (a chunk that changed); 0 = never */
	uint32_t last_rec, last_first, last_count;
	uint32_t last_digest;
	int64_t last_utc_ms;
	int16_t last_tz;
	uint32_t last_image_size, last_image_crc, last_fw_offset;
	size_t last_fw_len;
	uint8_t last_fw_first, last_fw_lastbyte;
	uint8_t last_factory[16];
	size_t last_factory_len;
	uint16_t last_max;
	uint32_t free_after;
	size_t factory_out_len;                 /* bytes the factory call reports (it writes them even when it refuses) */
	size_t list_len, log_len;               /* payload sizes the list and log calls report */
	void (*hook)(void);                     /* called inside get_battery (a command that runs) */
	/* after_response */
	uint32_t after_calls;
	uint8_t after_op;
	enum rrec_status after_st;
	uint32_t after_tag, after_len;
	uint32_t seq;                           /* counts emitted pieces and after_response calls in order */
	uint32_t after_seq;                     /* the value of seq when after_response ran */
	uint32_t after_packets;                 /* USB packets in the simulated log when after_response ran */
};
extern struct fake fk;
void fake_reset(void);
const struct rxf_backend *fake_be(void);
/* The byte i of chunk `chunk` of recording `rec` as the fake serves it (the same function on both sides). */
uint8_t fake_chunk_byte(uint32_t rec, uint32_t chunk, uint32_t i);

/* Response capture: an emit function for rxf_proto_handle(). */
#define CAP_MAX 140000u
struct cap {
	uint8_t buf[CAP_MAX];
	size_t total;           /* bytes handed over (also when more than CAP_MAX) */
	uint32_t pieces;        /* emit calls */
	uint32_t bad_pieces;    /* non-last pieces that are not a multiple of mps */
	uint32_t last_flags;    /* emit calls with last = true */
	uint32_t mps;
	uint32_t pcrc;          /* running reference CRC of everything after the 16-byte header */
	int fail_after;         /* emit returns -EIO from this piece number on (0 = never) */
	bool last_seen_then_more;
};
extern struct cap cap;
void cap_reset(uint32_t mps);
int cap_emit(void *user, const uint8_t *d, size_t n, bool last);

/* Runs one request through the pure handler on a context bound to the fake backend, with the capture. */
extern struct rxf_ctx xctx;
int xt_run(uint32_t mps, const uint8_t *req, size_t n, struct rxf_result *res);
/* The response header fields of what the capture holds. */
uint8_t cap_status(void);
uint32_t cap_len(void);
uint32_t cap_tag(void);
uint32_t cap_crc(void);

#endif
```
