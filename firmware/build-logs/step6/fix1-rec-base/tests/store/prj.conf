## CMakeLists.txt
```
cmake_minimum_required(VERSION 3.20.0)

# RING_STORE_DIR (and RING_RHW_DIR) let a run point at a broken copy of ring_store (or ring_rhw) to prove that these
# tests can fail (broken_run.sh).
if(NOT DEFINED RING_RHW_DIR)
  set(RING_RHW_DIR ${CMAKE_CURRENT_SOURCE_DIR}/../../modules/ring_rhw)
endif()
if(NOT DEFINED RING_STORE_DIR)
  set(RING_STORE_DIR ${CMAKE_CURRENT_SOURCE_DIR}/../../modules/ring_store)
endif()
list(APPEND ZEPHYR_EXTRA_MODULES ${RING_RHW_DIR} ${RING_STORE_DIR})

find_package(Zephyr REQUIRED HINTS $ENV{ZEPHYR_BASE})
project(ring_store_tests)

# the pure files' own headers (not public) so the logic suites can call them directly
target_include_directories(app PRIVATE ${RING_STORE_DIR}/src)

target_sources(app PRIVATE
  src/tst.c
  src/test_fmt.c src/test_layout.c src/test_log.c src/test_index.c src/test_space.c
  src/test_recovery.c src/test_delete.c src/test_evlog.c src/test_svc.c)
```

## prj.conf
```kconfig
CONFIG_ZTEST=y
CONFIG_RING_RHW=y
CONFIG_RING_RHW_SIM=y
CONFIG_RING_STORE=y
CONFIG_THREAD_NAME=y
CONFIG_ZTEST_STACK_SIZE=8192
# a test card: 12,000 written sectors (6 MB) are enough for the 260 small recordings and the 2,050 log records
CONFIG_RING_RHW_SIM_DISK_POOL=12000
CONFIG_RING_RHW_SIM_LOG_SIZE=16384
```

## src/test_delete.c
```c
/* Suite store_delete (unit U2): CONFIRM, DELETE and the tail (FW l.658 to l.661). */
#include "tst.h"

ZTEST_SUITE(store_delete, NULL, NULL, tst_before, NULL, NULL);

static int recs(uint32_t n, uint32_t chunks_each, uint32_t *ids, uint32_t *digests)
{
	for (uint32_t i = 0; i < n; i++) {
		int r = tst_record(RREC_REC_TYPE_RECORDING, chunks_each, &ids[i], &digests[i]);

		if (r != 0) {
			return r;
		}
	}
	return 0;
}

static uint32_t count_index_records(void)
{
	struct rst_space sp;
	uint8_t s[512];
	struct rst_ix x;
	uint32_t n = 0;

	zassert_equal(rst_space(&sp), 0);
	for (uint32_t i = 1; i < 200; i++) {
		rhw_sim_disk_peek(8192 + i, s);
		if (rst_fmt_ix_decode(s, &x) == 0 && x.record_number == i) {
			n++;
		}
	}
	return n;
}

/* S26: CONFIRM compares the case's digest with the CLOSE digest: match appends CONFIRM; no match changes nothing */
ZTEST(store_delete, test_confirm_match_and_mismatch)
{
	struct rst_mount_info mi;
	uint32_t ids[1], dg[1];
	static struct rst_rec_info li[2];
	uint16_t n;

	tst_card(100);
	tst_mount_boot(&mi);
	zassert_equal(recs(1, 2, ids, dg), 0);
	zassert_equal(count_index_records(), 1u, "the CLOSE record");

	zassert_equal(rst_confirm(ids[0], dg[0] ^ 1u), -EBADMSG, "DIGEST_MISMATCH");
	zassert_equal(count_index_records(), 1u, "nothing appended");
	zassert_equal(rst_list(0, 1, li, &n), 0);
	zassert_equal(li[0].state, RREC_LIST_STATE_NEW, "nothing changed");
	zassert_equal(li[0].digest, dg[0], "the CLOSE digest is the reference digest");

	zassert_equal(rst_confirm(ids[0], dg[0]), 0);
	zassert_equal(count_index_records(), 2u, "a CONFIRM record");
	zassert_equal(rst_list(0, 1, li, &n), 0);
	zassert_equal(li[0].state, RREC_LIST_STATE_TRANSFERRED);
	zassert_equal(rst_confirm(99, dg[0]), -ENOENT);

	tst_reboot();
	tst_mount_boot(&mi);
	zassert_equal(rst_list(0, 1, li, &n), 0);
	zassert_equal(li[0].state, RREC_LIST_STATE_TRANSFERRED, "the CONFIRM survives a restart");
}

/* S27: DELETE is refused without a CONFIRM record (NOT_CONFIRMED, FW l.659) */
ZTEST(store_delete, test_delete_needs_confirm)
{
	struct rst_mount_info mi;
	uint32_t ids[1], dg[1], freed = 0;
	struct rst_space sp;

	tst_card(100);
	tst_mount_boot(&mi);
	zassert_equal(recs(1, 2, ids, dg), 0);
	zassert_equal(rst_delete(ids[0], &freed), -EACCES);
	zassert_equal(count_index_records(), 1u, "no DELETE record");
	zassert_equal(rst_space(&sp), 0);
	zassert_equal(sp.used, 2u, "nothing freed");
	zassert_equal(rst_delete(77, &freed), -ENOENT);
	zassert_equal(rst_confirm(ids[0], dg[0]), 0);
	zassert_equal(rst_delete(ids[0], &freed), 0);
	zassert_equal(freed, 100u, "free chunks after the deletion");
}

/* S28: DELETE appends a record and moves the tail over the leading deleted recordings only; a deleted recording in
 * the middle stays counted as used (FW l.660) */
ZTEST(store_delete, test_tail_moves_over_leading_only)
{
	struct rst_mount_info mi;
	uint32_t ids[3], dg[3], freed = 0;
	struct rst_space sp;
	static struct rst_rec_info li[4];
	uint16_t n;

	tst_card(100);
	tst_mount_boot(&mi);
	zassert_equal(recs(3, 2, ids, dg), 0);
	for (int i = 0; i < 3; i++) {
		zassert_equal(rst_confirm(ids[i], dg[i]), 0);
	}
	zassert_equal(rst_space(&sp), 0);
	zassert_equal(sp.free_chunks, 100u - 6u);

	zassert_equal(rst_delete(ids[1], &freed), 0, "the second of three");
	zassert_equal(freed, 94u, "free unchanged: the deleted recording is in the middle");
	zassert_equal(rst_space(&sp), 0);
	zassert_equal(sp.free_chunks, 94u);
	zassert_equal(rst_list(0, 4, li, &n), 0);
	zassert_equal(n, 2);
	zassert_equal(li[0].recording_id, ids[0]);
	zassert_equal(li[1].recording_id, ids[2]);

	tst_reboot();
	tst_mount_boot(&mi);
	zassert_equal(mi.space.free_chunks, 94u, "also after a restart");
	zassert_equal(mi.recordings, 2u);

	zassert_equal(rst_delete(ids[0], &freed), 0, "now the first");
	zassert_equal(freed, 98u, "the first and the deleted second are freed: 4 chunks");
	zassert_equal(rst_space(&sp), 0);
	zassert_equal(sp.used, 2u, "only the third remains");

	tst_reboot();
	tst_mount_boot(&mi);
	zassert_equal(mi.space.free_chunks, 98u, "the tail is on the card");
	zassert_equal(mi.recordings, 1u);
	zassert_equal(rst_delete(ids[2], &freed), 0);
	zassert_equal(freed, 100u, "all freed");
	zassert_equal(rst_list(0, 4, li, &n), 0);
	zassert_equal(n, 0);
}

/* S29: audio sectors are not erased; READ_RANGE's store call refuses a deleted recording (FW l.661) */
ZTEST(store_delete, test_no_erase)
{
	struct rst_mount_info mi;
	uint32_t ids[1], dg[1], freed;
	static uint8_t before[RREC_CHUNK_BYTES], after[RREC_CHUNK_BYTES];

	tst_card(100);
	tst_mount_boot(&mi);
	zassert_equal(recs(1, 2, ids, dg), 0);
	zassert_equal(rst_read_chunk(ids[0], 1, before), 0);
	zassert_equal(rst_confirm(ids[0], dg[0]), 0);
	uint32_t w0 = rhw_sim_disk_write_calls();

	zassert_equal(rst_delete(ids[0], &freed), 0);
	/* the delete wrote only an index record and the superblock: no sector of the chunk area */
	uint32_t i = 0;
	struct rhw_sim_ev e;
	uint32_t chunk_area_writes = 0, writes = 0;

	while (rhw_sim_log_get(i++, &e)) {
		if (e.kind == RHW_EV_DISK_WRITE && e.a2 > (int64_t)w0) {
			writes++;
			if (e.a0 >= 81920) {
				chunk_area_writes++;
			}
		}
	}
	zassert_equal(writes, 2u, "an index record and a superblock");
	zassert_equal(chunk_area_writes, 0u);
	for (uint32_t k = 0; k < 65; k++) {
		uint8_t s[512];

		rhw_sim_disk_peek(rst_lay_chunk_lba(mi.space.total, 2) + k, s);
		memcpy(after + k * 512, s, 512);
	}
	zassert_equal(memcmp(before, after, sizeof(before)), 0, "the deleted chunk is still on the card");
}

ZTEST(store_delete, test_read_chunk_deleted_not_found)
{
	struct rst_mount_info mi;
	uint32_t ids[2], dg[2], freed;
	static uint8_t buf[RREC_CHUNK_BYTES];
	struct rst_chunk_hdr h;

	tst_card(100);
	tst_mount_boot(&mi);
	zassert_equal(recs(2, 2, ids, dg), 0);
	zassert_equal(rst_read_chunk(ids[1], 1, buf), 0);
	zassert_equal(rst_fmt_chunk_verify(buf, &h, NULL), 0, "a chunk exactly as stored");
	zassert_equal(h.recording_id, ids[1]);
	zassert_equal(h.chunk_in_recording, 1u);
	zassert_equal(h.chunk_seq, 4u);
	zassert_equal(rst_read_chunk(ids[1], 2, buf), -ENOENT, "past the end of the recording");
	zassert_equal(rst_read_chunk(55, 0, buf), -ENOENT, "unknown recording");
	zassert_equal(rst_confirm(ids[0], dg[0]), 0);
	zassert_equal(rst_delete(ids[0], &freed), 0);
	zassert_equal(rst_read_chunk(ids[0], 0, buf), -ENOENT, "NOT_FOUND for a deleted recording (FW l.661)");
	zassert_equal(rst_read_chunk(ids[1], 0, buf), 0);
}

/* a recording that is open blocks a delete; so does an unrecovered one */
ZTEST(store_delete, test_delete_refused_while_open)
{
	struct rst_mount_info mi;
	uint32_t ids[1], dg[1], freed, id2;

	tst_card(100);
	tst_mount_boot(&mi);
	zassert_equal(recs(1, 1, ids, dg), 0);
	zassert_equal(rst_confirm(ids[0], dg[0]), 0);
	zassert_equal(rst_open(RREC_REC_TYPE_RECORDING, 0, &id2), 0);
	zassert_equal(rst_delete(ids[0], &freed), -EBUSY);
}

/* T-STORE's last step (FW l.1030): every recording of type 2 is deleted without a CONFIRM, the others stay */
ZTEST(store_delete, test_factory_recordings_deleted)
{
	struct rst_mount_info mi;
	uint32_t id, dg, deleted = 99;
	struct rst_space sp;
	static struct rst_rec_info li[4];
	uint16_t n;

	tst_card(100);
	tst_mount_boot(&mi);
	zassert_equal(tst_record(RREC_REC_TYPE_FACTORY, 1, &id, &dg), 0);
	uint32_t f1 = id;

	zassert_equal(tst_record(RREC_REC_TYPE_RECORDING, 2, &id, &dg), 0);
	uint32_t keep = id;

	zassert_equal(tst_record(RREC_REC_TYPE_FACTORY, 1, &id, &dg), 0);
	zassert_equal(rst_list(0, 4, li, &n), 0);
	zassert_equal(n, 3);
	zassert_equal(li[0].type, RREC_REC_TYPE_FACTORY);
	zassert_equal(rst_delete_factory_recordings(&deleted), 0);
	zassert_equal(deleted, 2u);
	zassert_equal(rst_list(0, 4, li, &n), 0);
	zassert_equal(n, 1);
	zassert_equal(li[0].recording_id, keep);
	zassert_not_equal(li[0].recording_id, f1);
	zassert_equal(rst_space(&sp), 0);
	zassert_equal(sp.used, 3u, "the first factory recording is freed from the tail, the last one stays counted");
	zassert_equal(rst_delete_factory_recordings(&deleted), 0);
	zassert_equal(deleted, 0u);
}
```

## src/test_evlog.c
```c
/* Suite store_evlog (unit U2): the event log (FW l.1062): the RAM buffer of 8, writing when VDD_SD is on, the ring of 2,046. */
#include "tst.h"

ZTEST_SUITE(store_evlog, NULL, NULL, tst_before, NULL, NULL);

static struct rrec_logrec mkrec(uint16_t code)
{
	struct rrec_logrec r;

	memset(&r, 0, sizeof(r));
	r.code = code;
	r.state = 3;
	r.uptime_ns = (int64_t)code * 1000000;
	r.utc_ms = 1700000000000ll + code;
	r.args[0] = (uint8_t)code;
	return r;
}

static bool log_sector(uint32_t lba, struct rrec_logrec *out)
{
	uint8_t s[512];

	rhw_sim_disk_peek(lba, s);
	return rst_fmt_log_decode(s, out) == 0;
}

/* T26: 8 records wait in RAM; when the buffer is full the oldest unwritten is dropped and counted */
ZTEST(store_evlog, test_buffer_of_8_drops_oldest)
{
	struct rst_evbuf b;
	struct rrec_logrec r, got;

	rst_evbuf_init(&b);
	for (uint16_t c = 1; c <= 10; c++) {
		r = mkrec(c);
		rst_evbuf_push(&b, &r);
	}
	zassert_equal(b.n, 8u, "8 records wait");
	zassert_equal(b.dropped, 2u, "two dropped and counted");
	for (uint16_t c = 3; c <= 10; c++) {
		zassert_true(rst_evbuf_peek(&b, &got));
		zassert_equal(got.code, c, "the oldest kept is record %u", c);
		rst_evbuf_pop(&b);
	}
	zassert_false(rst_evbuf_peek(&b, &got));
	zassert_equal(b.dropped, 2u);

	/* the same through the store's call while the card is off */
	for (uint16_t c = 1; c <= 10; c++) {
		r = mkrec(c);
		rst_log_put(&r);
	}
	zassert_equal(rst_log_dropped(), 2u);
}

/* T26: records wait while VDD_SD is off and are written at the next mount; later ones at once (FW l.1062) */
ZTEST(store_evlog, test_written_when_rail_on)
{
	struct rst_mount_info mi;
	struct rrec_logrec r, got;

	for (uint16_t c = 1; c <= 3; c++) {
		r = mkrec(c);
		rst_log_put(&r);
	}
	k_msleep(50);
	zassert_equal(rhw_sim_disk_write_calls(), 0u, "no write with the rail off");
	zassert_equal(rhw_sim_disk_refused(), 0u, "and no refused call either");
	zassert_equal(rhw_sim_log_count_kind(RHW_EV_DISK_WRITE), 0u);
	zassert_false(rhw_sim_pmic_rail_caller(RHW_RAIL_SD)[0] != 0, "the rail was never touched");

	tst_mount_boot(&mi);
	for (uint16_t c = 1; c <= 3; c++) {
		zassert_true(log_sector(2 + c - 1, &got), "record %u at LBA %u", c, 2 + c - 1);
		zassert_equal(got.seq, c);
		zassert_equal(got.code, c);
		zassert_equal(got.state, 3);
		zassert_equal(got.utc_ms, 1700000000000ll + c);
		zassert_equal(got.args[0], c);
	}
	zassert_false(log_sector(5, &got), "nothing more yet");

	r = mkrec(4);
	rst_log_put(&r);
	k_msleep(20);
	zassert_true(log_sector(5, &got), "a record put while mounted is written at once");
	zassert_equal(got.seq, 4u);

	uint8_t out[3 * 512];
	uint16_t n = 0;

	zassert_equal(rst_log_read(0, 3, out, &n), 0);
	zassert_equal(n, 3);
	zassert_equal(rst_fmt_log_decode(out, &got), 0);
	zassert_equal(got.seq, 1u);
	zassert_equal(rst_fmt_log_decode(out + 1024, &got), 0);
	zassert_equal(got.seq, 3u);
	static uint8_t big[32 * 512];

	zassert_equal(rst_log_read(3, 32, big, &n), 0);
	zassert_equal(n, 2, "records 3 and 4");
	zassert_equal(rst_log_read(0, 0, out, &n), -EINVAL);
	zassert_equal(rst_log_read(0, 33, out, &n), -EINVAL);
	zassert_equal(rst_log_read(100, 2, out, &n), 0);
	zassert_equal(n, 0, "past the head");

	/* the drop count and the written records together: 10 records put with the card off */
	tst_reset();
	for (uint16_t c = 1; c <= 10; c++) {
		r = mkrec(c);
		rst_log_put(&r);
	}
	tst_mount_boot(&mi);
	zassert_equal(rst_log_dropped(), 2u);
	zassert_true(log_sector(2, &got));
	zassert_equal(got.code, 3u, "records 1 and 2 were dropped, 3 is the first written");
	zassert_equal(got.seq, 1u, "sequence numbers on the card have no gap");
}

/* FW l.525: a ring of 2,046 records, 1 record per sector from LBA 2 */
ZTEST(store_evlog, test_ring_of_2046)
{
	struct rst_mount_info mi;
	struct rrec_logrec r, got;
	static uint8_t out[32 * 512];
	uint16_t n;

	zassert_equal(rst_lay_log_lba(1), 2u);
	zassert_equal(rst_lay_log_lba(2046), 2047u, "the 2,046th record is in the last sector of the log area");
	zassert_equal(rst_lay_log_lba(2047), 2u, "the 2,047th record wraps to the first sector");
	zassert_equal(rst_lay_log_lba(2048), 3u);
	zassert_equal(rst_lay_log_lba(4093), 2u, "2 x 2,046 + 1");

	tst_mount_boot(&mi);
	for (uint16_t c = 1; c <= 2100; c++) {
		r = mkrec(c);
		rst_log_put(&r);
		k_msleep(1);
	}
	k_msleep(10);
	zassert_equal(rst_log_dropped(), 0u);
	zassert_true(log_sector(2 + 53, &got));
	zassert_equal(got.seq, 2100u, "record 2,100 = 2,046 + 54 is in the 54th sector of the area, LBA 55");
	zassert_true(log_sector(2, &got));
	zassert_equal(got.seq, 2047u, "sector 2 was overwritten by the second lap: record 2,047, no longer record 1");
	zassert_true(log_sector(2047, &got));
	zassert_equal(got.seq, 2046u);
	zassert_equal(rst_log_read(0, 32, out, &n), 0);
	zassert_equal(n, 32);
	zassert_equal(rst_fmt_log_decode(out, &got), 0);
	zassert_equal(got.seq, 2100u - 2046u + 1u, "only the newest 2,046 are kept: the oldest is record 55");

	/* after a restart the head is found although the superblock lags */
	tst_reboot();
	tst_mount_boot(&mi);
	r = mkrec(9000);
	rst_log_put(&r);
	k_msleep(20);
	zassert_true(log_sector(rst_lay_log_lba(2101), &got), "the next record goes to sequence 2,101");
	zassert_equal(got.seq, 2101u);
	zassert_equal(got.code, 9000u);
}

/* a crash block travels through the buffer and the card */
ZTEST(store_evlog, test_crash_block_roundtrip)
{
	struct rst_mount_info mi;
	struct rrec_logrec r = mkrec(0x0230), got;

	r.has_crash = true;
	r.crash.reason = 4;
	r.crash.pc = 0x1234;
	strcpy(r.crash.thread, "rst");
	r.crash.stack[63] = 77;
	tst_mount_boot(&mi);
	rst_log_put(&r);
	k_msleep(20);
	zassert_true(log_sector(2, &got));
	zassert_true(got.has_crash);
	zassert_equal(got.crash.pc, 0x1234u);
	zassert_equal(got.crash.stack[63], 77u);
}
```

## src/test_index.c
```c
/* Suite store_index (unit U2): recordings rebuilt from the index records (FW l.612 to l.636), the CLOSE record's
 * highlights, and the list beyond the 256-entry cache (decision D16). */
#include "tst.h"

ZTEST_SUITE(store_index, NULL, NULL, tst_before, NULL, NULL);

static struct rst_ix mkix(uint8_t type, uint32_t number, uint32_t id, uint32_t first_seq, uint32_t count,
			  uint8_t close_state)
{
	struct rst_ix x = { .type = type, .close_state = close_state, .record_number = number, .recording_id = id,
			    .first_chunk_seq = first_seq, .chunk_count = count, .recording_type = 1, .channels = 2,
			    .sample_rate_hz = 16000, .digest = 0xD0000000u + id };

	memset(x.highlight_ms, 0xFF, sizeof(x.highlight_ms));
	return x;
}

static void put_ix(const struct rst_ix *x)
{
	uint8_t s[512];

	rst_fmt_ix_encode(x, s);
	rd_write(rst_lay_index_lba(x->record_number), s, 1);
}

/* S17: a recording's state is its last record: CLOSE = new, CONFIRM = transferred, DELETE = deleted; a recovered
 * recording shows RECOVERED until a CONFIRM (rst.h) */
ZTEST(store_index, test_state_is_last_record)
{
	struct rst_rec store[8];
	struct rst_recs t;
	struct rst_ix x;

	rd_reset();
	x = mkix(RREC_IX_TYPE_CLOSE, 1, 1, 1, 4, RREC_IX_CLOSE_COMPLETE);
	put_ix(&x);
	x = mkix(RREC_IX_TYPE_CLOSE, 2, 2, 5, 3, RREC_IX_CLOSE_RECOVERED);
	put_ix(&x);
	x = mkix(RREC_IX_TYPE_CLOSE, 3, 3, 8, 2, RREC_IX_CLOSE_COMPLETE);
	put_ix(&x);

	uint8_t sector[512];

	rst_recs_init(&t, store, 8);
	zassert_equal(rst_log_load_index(rd_read, NULL, 1, 4, &t, sector), 0);
	zassert_equal(t.live_total, 3u);
	zassert_equal(rst_recs_find(&t, 1)->info.state, RREC_LIST_STATE_NEW);
	zassert_equal(rst_recs_find(&t, 2)->info.state, RREC_LIST_STATE_RECOVERED);
	zassert_equal(rst_recs_find(&t, 3)->info.state, RREC_LIST_STATE_NEW);
	zassert_equal(rst_recs_find(&t, 2)->info.chunk_count, 3u);
	zassert_equal(rst_recs_find(&t, 2)->info.first_chunk_seq, 5u);
	zassert_equal(rst_recs_find(&t, 1)->info.digest, 0xD0000001u);

	/* CONFIRM of 1 and 2, DELETE of 1 */
	x = mkix(RREC_IX_TYPE_CONFIRM, 4, 1, 1, 4, 0);
	put_ix(&x);
	x = mkix(RREC_IX_TYPE_CONFIRM, 5, 2, 5, 3, 0);
	put_ix(&x);
	zassert_equal(rst_log_load_index(rd_read, NULL, 1, 6, &t, sector), 0);
	zassert_equal(rst_recs_find(&t, 1)->info.state, RREC_LIST_STATE_TRANSFERRED);
	zassert_equal(rst_recs_find(&t, 2)->info.state, RREC_LIST_STATE_TRANSFERRED, "a recovered recording once confirmed");
	zassert_equal(rst_recs_find(&t, 3)->info.state, RREC_LIST_STATE_NEW);
	x = mkix(RREC_IX_TYPE_DELETE, 6, 1, 1, 4, 0);
	put_ix(&x);
	zassert_equal(rst_log_load_index(rd_read, NULL, 1, 7, &t, sector), 0);
	zassert_true(rst_recs_find(&t, 1) == NULL, "a deleted recording is not listed");
	zassert_equal(t.live_total, 2u);
	zassert_equal(t.n, 2u);

	/* starting at the tail record 3 (record 1 and its records dropped): the orphan DELETE of id 1 is ignored */
	rd_reset();
	x = mkix(RREC_IX_TYPE_CLOSE, 3, 3, 8, 2, RREC_IX_CLOSE_COMPLETE);
	put_ix(&x);
	x = mkix(RREC_IX_TYPE_DELETE, 4, 1, 1, 4, 0);
	put_ix(&x);
	zassert_equal(rst_log_load_index(rd_read, NULL, 3, 5, &t, sector), 0);
	zassert_equal(t.live_total, 1u, "a DELETE for a recording before the tail changes nothing");
}

/* D16: a table of 4 holds the newest 4; the older live ones are read from the index; the count stays exact */
ZTEST(store_index, test_table_pushes_out_oldest_and_finds_on_demand)
{
	struct rst_rec store[4], win[8];
	struct rst_recs t;
	struct rst_ix x;
	uint8_t sector[512];
	uint32_t n = 0;

	rd_reset();
	for (uint32_t i = 1; i <= 10; i++) {
		x = mkix(RREC_IX_TYPE_CLOSE, i, i, i * 10, 2, RREC_IX_CLOSE_COMPLETE);
		put_ix(&x);
	}
	x = mkix(RREC_IX_TYPE_CONFIRM, 11, 2, 20, 2, 0);
	put_ix(&x);
	x = mkix(RREC_IX_TYPE_DELETE, 12, 3, 30, 2, 0);
	put_ix(&x);
	rst_recs_init(&t, store, 4);
	zassert_equal(rst_log_load_index(rd_read, NULL, 1, 13, &t, sector), 0);
	zassert_equal(t.n, 4u);
	zassert_equal(t.live_total, 9u, "10 closed, 1 deleted");
	zassert_equal(t.first_id, 1u);
	zassert_equal(t.evict_max_id, 6u, "ids 1 to 6 were pushed out");
	zassert_equal(t.ent[0].info.recording_id, 7u);
	zassert_equal(t.ent[3].info.recording_id, 10u);

	zassert_equal(rst_log_index_find(rd_read, NULL, 1, 13, 1, 8, win, &n, sector), 0);
	zassert_equal(n, 7u, "ids 1 to 8 minus the deleted 3: 7 of them");
	zassert_equal(win[0].info.recording_id, 1u);
	zassert_equal(win[1].info.recording_id, 2u);
	zassert_equal(win[1].info.state, RREC_LIST_STATE_TRANSFERRED, "id 2 was confirmed");
	zassert_equal(win[2].info.recording_id, 4u, "id 3 was deleted");
	zassert_equal(win[6].info.recording_id, 8u);

	/* a DELETE of a pushed-out recording lowers the exact count */
	x = mkix(RREC_IX_TYPE_DELETE, 13, 5, 50, 2, 0);
	rst_recs_apply(&t, &x);
	zassert_equal(t.live_total, 8u);
}

/* S11, decision D4: the CLOSE record keeps the first 32 highlights (ms from the start) and the full count */
ZTEST(store_index, test_close_highlights_32)
{
	struct rst_mount_info mi;
	struct rst_close_args a = { .duration_frames = 8192u * 2 };
	uint32_t id;
	uint8_t s[512];
	struct rst_ix x;
	static struct rst_chunk c;

	tst_card(100);
	tst_mount_boot(&mi);
	zassert_equal(rst_open(RREC_REC_TYPE_RECORDING, 1700000000000ll, &id), 0);
	tst_fill(&c, id, 0, 8192, 0);
	zassert_equal(rst_put_chunk(&c, tst_done_cb), 0);
	zassert_true(tst_wait_done(1, 1000));
	a.highlight_count = 40;
	for (uint32_t i = 0; i < 32; i++) {
		a.highlight_ms[i] = 100 * i + 7;
	}
	zassert_equal(rst_close(NULL, &a), 0);
	rhw_sim_disk_peek(8192 + 1, s);               /* the first index record: number 1 */
	zassert_equal(rst_fmt_ix_decode(s, &x), 0);
	zassert_equal(x.type, 1);
	zassert_equal(x.highlight_count, 40, "the full count");
	for (uint32_t i = 0; i < 32; i++) {
		zassert_equal(x.highlight_ms[i], 100 * i + 7, "highlight %u", i);
	}
	/* a ninth highlight in one chunk's header is refused by the store (the header holds 8, decision D4) */
	tst_fill(&c, id, 1, 8192, 1);
	c.hdr.highlight_count = 9;
	zassert_equal(rst_open(RREC_REC_TYPE_RECORDING, 0, &id), 0);
	zassert_equal(rst_put_chunk(&c, tst_done_cb), -EINVAL);
	zassert_equal(rst_close(NULL, &a), 0);
}

/* D16, S17: 300 recordings (the table holds 256): list, confirm and delete work on the ones pushed out of it */
ZTEST(store_index, test_list_beyond_cache_reads_index)
{
	struct rst_mount_info mi;
	uint32_t id, freed;
	static struct rst_rec_info li[64];
	uint16_t n = 0;

	tst_card(100);
	tst_mount_boot(&mi);
	for (uint32_t i = 1; i <= 300; i++) {
		zassert_equal(tst_record(RREC_REC_TYPE_RECORDING, 0, &id, NULL), 0, "recording %u", i);
		zassert_equal(id, i);
	}
	tst_reboot();
	tst_mount_boot(&mi);
	zassert_equal(mi.recordings, 300u);

	zassert_equal(rst_list(0, 64, li, &n), 0);
	zassert_equal(n, 64);
	zassert_equal(li[0].recording_id, 1u, "from the index: older than the table");
	zassert_equal(li[63].recording_id, 64u, "ids 1 to 44 from the index, 45 to 64 from the table");
	zassert_equal(li[43].recording_id, 44u);
	zassert_equal(li[44].recording_id, 45u);
	zassert_equal(rst_list(290, 64, li, &n), 0);
	zassert_equal(n, 11);
	zassert_equal(li[10].recording_id, 300u);

	/* the digest of a recording without chunks is the CRC-32 of nothing: 0 */
	zassert_equal(rst_confirm(2, 5), -EBADMSG);
	zassert_equal(rst_confirm(2, 0), 0);
	zassert_equal(rst_list(2, 1, li, &n), 0);
	zassert_equal(li[0].state, RREC_LIST_STATE_TRANSFERRED);
	zassert_equal(rst_delete(2, &freed), 0);
	zassert_equal(rst_list(0, 3, li, &n), 0);
	zassert_equal(n, 3);
	zassert_equal(li[0].recording_id, 1u);
	zassert_equal(li[1].recording_id, 3u, "2 is deleted");
	zassert_equal(rst_delete(1, &freed), -EACCES);

	tst_reboot();
	tst_mount_boot(&mi);
	zassert_equal(mi.recordings, 299u, "the count after a remount");
}
```

## src/test_layout.c
```c
/* Suite store_layout (unit U2): the sector map of design/firmware.md 5.2 and the examples of 5.6. */
#include "tst.h"

ZTEST_SUITE(store_layout, NULL, NULL, tst_before, NULL, NULL);

/* S4: sector map (FW l.519 to l.531): superblock A at 0, B at 1, log 2 to 2,047, index 8,192 to 73,727, chunks from 81,920 */
ZTEST(store_layout, test_sector_map)
{
	zassert_equal(rst_lay_sb_lba(0), 0u);
	zassert_equal(rst_lay_sb_lba(1), 1u);
	zassert_equal(rst_lay_sb_lba(6), 0u);
	zassert_equal(rst_lay_sb_lba(7), 1u, "the superblock goes to LBA sb_seq mod 2 (FW l.587)");
	zassert_equal(rst_lay_log_lba(1), 2u, "the first record is in the first sector of the log area");
	zassert_equal(rst_lay_log_lba(2), 3u);
	zassert_equal(rst_lay_log_lba(2046), 2047u, "the last sector of the log area");
	zassert_equal(rst_lay_index_lba(0), 8192u);
	zassert_equal(rst_lay_index_lba(65535), 73727u);
	zassert_equal(rst_lay_chunk_total(81920), 0u, "no room for a chunk");
	zassert_equal(rst_lay_chunk_total(81920 + 64), 0u, "64 sectors do not hold a chunk of 65");
	zassert_equal(rst_lay_chunk_total(81920 + 65), 1u);
	zassert_equal(rst_lay_chunk_total(81920 + 130), 2u);
	zassert_equal(rst_lay_chunk_total(100), 0u, "a card smaller than the metadata areas");
	zassert_equal(rst_lay_chunk_lba(10, 0), 81920u);
	zassert_equal(rst_lay_chunk_lba(10, 1), 81920u + 65u);
	zassert_equal(rst_lay_chunk_lba(10, 9), 81920u + 9u * 65u);
	zassert_equal(rst_lay_chunk_lba(0, 5), UINT32_MAX);
}

/* S4: chunk s starts at 81,920 + (s mod total) x 65 (FW l.531) */
ZTEST(store_layout, test_chunk_lba_wraps)
{
	const uint32_t total = 118932;          /* the 4 GB example of FW l.654 */

	zassert_equal(rst_lay_chunk_lba(total, total - 1), 81920u + 118931u * 65u);
	zassert_equal(rst_lay_chunk_lba(total, total), 81920u, "s = total wraps to the first chunk");
	zassert_equal(rst_lay_chunk_lba(total, total + 1), 81920u + 65u);
	zassert_equal(rst_lay_chunk_lba(total, 2 * total + 5), 81920u + 5u * 65u);
	zassert_equal(rst_lay_chunk_lba(7, 6), 81920u + 6u * 65u);
	zassert_equal(rst_lay_chunk_lba(7, 7), 81920u);
	zassert_equal(rst_lay_chunk_lba(7, 8), 81920u + 65u);
}

/* S4: the examples of FW l.654: 7,812,500 sectors give 118,932 chunks; 7,226,562 give 109,917 */
ZTEST(store_layout, test_examples)
{
	zassert_equal(rst_lay_chunk_total(7812500), 118932u);
	zassert_equal(rst_lay_chunk_total(7226562), 109917u);
}

/* S15: index record n at 8,192 + (n mod 65,536) (FW l.612) */
ZTEST(store_layout, test_index_lba_wraps)
{
	zassert_equal(rst_lay_index_lba(65536), 8192u);
	zassert_equal(rst_lay_index_lba(65537), 8193u);
	zassert_equal(rst_lay_index_lba(3), 8195u);
	zassert_equal(rst_lay_index_lba(131071), 73727u);
}
```

## src/test_space.c
```c
/* Suite store_space (unit U2): free-space accounting (FW l.650 to l.654): counts, S30, SFULL, "storage left". */
#include "tst.h"

static struct {
	int s30, sfull;
	uint32_t s30_free, sfull_free;
} cbn;

static void on_s30(uint32_t f)
{
	cbn.s30++;
	cbn.s30_free = f;
}

static void on_sfull(uint32_t f)
{
	cbn.sfull++;
	cbn.sfull_free = f;
}

ZTEST_SUITE(store_space, NULL, NULL, tst_before, NULL, NULL);

/* S24: used = head - tail; free = total - used */
ZTEST(store_space, test_counts)
{
	struct rst_space sp;

	rst_lay_space(1000, 11, 1, &sp);
	zassert_equal(sp.total, 1000u);
	zassert_equal(sp.used, 10u);
	zassert_equal(sp.free_chunks, 990u);
	rst_lay_space(1000, 1, 1, &sp);
	zassert_equal(sp.used, 0u);
	zassert_equal(sp.free_chunks, 1000u);
	rst_lay_space(1000, 1001, 1, &sp);
	zassert_equal(sp.free_chunks, 0u);
	rst_lay_space(1000, 2500, 1, &sp);
	zassert_equal(sp.used, 1000u, "never more used than the card holds");
	zassert_equal(sp.free_chunks, 0u);
}

/* C3, S24: SFULL at or under 16 free chunks (FW l.651), S30 at or under 3,516 (FW l.652) */
ZTEST(store_space, test_s30_sfull_edges)
{
	struct rst_space sp;
	const uint32_t total = 10000;

	rst_lay_space(total, 1 + (total - 3517), 1, &sp);
	zassert_equal(sp.free_chunks, 3517u);
	zassert_false(sp.s30, "3,517 free: no S30");
	zassert_false(sp.sfull);
	rst_lay_space(total, 1 + (total - 3516), 1, &sp);
	zassert_equal(sp.free_chunks, 3516u);
	zassert_true(sp.s30, "3,516 free: S30");
	zassert_false(sp.sfull);
	rst_lay_space(total, 1 + (total - 17), 1, &sp);
	zassert_equal(sp.free_chunks, 17u);
	zassert_true(sp.s30);
	zassert_false(sp.sfull, "17 free: no SFULL");
	rst_lay_space(total, 1 + (total - 16), 1, &sp);
	zassert_equal(sp.free_chunks, 16u);
	zassert_true(sp.sfull, "16 free: SFULL");
	rst_lay_space(total, 1 + total, 1, &sp);
	zassert_equal(sp.free_chunks, 0u);
	zassert_true(sp.sfull);
}

/* S24: "storage left" = free x 0.512 s in whole minutes (FW l.653): 118,932 chunks = 60,893 s = 1,014 minutes */
ZTEST(store_space, test_storage_left_minutes)
{
	struct rst_space sp;

	rst_lay_space(118932, 1, 1, &sp);
	zassert_equal(sp.minutes_left, 1014u);
	rst_lay_space(109917, 1, 1, &sp);
	zassert_equal(sp.minutes_left, 937u, "109,917 x 0.512 s = 56,278 s = 937.97 minutes");
	rst_lay_space(1172, 1, 1, &sp);
	zassert_equal(sp.minutes_left, 10u, "1,172 x 0.512 = 600.06 s");
	rst_lay_space(1171, 1, 1, &sp);
	zassert_equal(sp.minutes_left, 9u, "1,171 x 0.512 = 599.55 s");
	rst_lay_space(100, 1, 1, &sp);
	zassert_equal(sp.minutes_left, 0u);
}

static struct rst_chunk big;

static void put_n(uint32_t id, uint32_t from, uint32_t n)
{
	for (uint32_t i = from; i < from + n; i++) {
		tst_fill(&big, id, i, 8192, i);
		zassert_equal(rst_put_chunk(&big, tst_done_cb), 0, "put %u", i);
		zassert_true(tst_wait_done((int)i + 1, 20000));
		zassert_equal(tst_done_last_err(), 0);
	}
}

/* S24, C15: S30 and SFULL are reported once per crossing while a recording runs (FW l.166, l.167) */
ZTEST(store_space, test_callbacks_once_per_crossing)
{
	struct rst_cb cb = { .s30 = on_s30, .sfull = on_sfull };
	struct rst_mount_info mi;
	struct rst_close_args a = { .duration_frames = 0 };
	struct rst_space sp;
	uint32_t id;

	memset(a.highlight_ms, 0xFF, sizeof(a.highlight_ms));
	memset(&cbn, 0, sizeof(cbn));

	/* S30: a card of 3,530 chunks; the 14th chunk takes the free count from 3,530 to 3,516 */
	tst_reset_cb(&cb);
	tst_card(3530);
	tst_mount_boot(&mi);
	zassert_equal(mi.space.total, 3530u);
	zassert_false(mi.space.s30);
	zassert_equal(rst_open(RREC_REC_TYPE_RECORDING, 0, &id), 0);
	put_n(id, 0, 13);
	zassert_equal(cbn.s30, 0, "3,517 free");
	put_n(id, 13, 1);
	zassert_equal(cbn.s30, 1);
	zassert_equal(cbn.s30_free, 3516u);
	put_n(id, 14, 2);
	zassert_equal(cbn.s30, 1, "S30 once");
	zassert_equal(cbn.sfull, 0);
	zassert_equal(rst_close(NULL, &a), 0);
	zassert_equal(rst_space(&sp), 0);
	zassert_equal(sp.free_chunks, 3530u - 16u);
	zassert_true(sp.s30);

	/* SFULL: a card of 30 chunks (S30 is true from the start); the 14th chunk takes free from 30 to 16 */
	memset(&cbn, 0, sizeof(cbn));
	tst_reset_cb(&cb);
	tst_card(30);
	tst_mount_boot(&mi);
	zassert_equal(rst_open(RREC_REC_TYPE_RECORDING, 0, &id), 0);
	put_n(id, 0, 13);
	zassert_equal(cbn.sfull, 0, "17 free");
	put_n(id, 13, 1);
	zassert_equal(cbn.sfull, 1);
	zassert_equal(cbn.sfull_free, 16u);
	zassert_equal(cbn.s30, 0, "a recording that opens under S30 is not told again");
	zassert_equal(rst_close(NULL, &a), 0);
	zassert_equal(rst_open(RREC_REC_TYPE_RECORDING, 0, &id), -ENOSPC, "no recording opens at SFULL");
	zassert_equal(rst_space(&sp), 0);
	zassert_true(sp.sfull);
}
```
