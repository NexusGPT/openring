/* The ring's panel stands in as a memory display (120 x 240) until the panel driver exists. */
/ {
	chosen {
		zephyr,display = &ring_display;
	};
	ring_display: ring_display {
		compatible = "ring,mem-display";
		width = <120>;
		height = <240>;
	};
};
