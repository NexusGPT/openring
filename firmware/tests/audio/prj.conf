## CMakeLists.txt
```
cmake_minimum_required(VERSION 3.20.0)

# RING_RHW_DIR and RING_AUDIO_DIR let a run point at a broken copy of ring_rhw or ring_audio to prove that these tests
# can fail (broken_run.sh). RING_STORE_INCLUDE: the store's header folder (rau.h names the store's chunk type); a
# broken copy of ring_audio does not sit beside ring_store, so the path is given here.
if(NOT DEFINED RING_RHW_DIR)
  set(RING_RHW_DIR ${CMAKE_CURRENT_SOURCE_DIR}/../../modules/ring_rhw)
endif()
if(NOT DEFINED RING_AUDIO_DIR)
  set(RING_AUDIO_DIR ${CMAKE_CURRENT_SOURCE_DIR}/../../modules/ring_audio)
endif()
set(RING_STORE_INCLUDE ${CMAKE_CURRENT_SOURCE_DIR}/../../modules/ring_store/include)
list(APPEND ZEPHYR_EXTRA_MODULES ${RING_RHW_DIR} ${RING_AUDIO_DIR})

find_package(Zephyr REQUIRED HINTS $ENV{ZEPHYR_BASE})
project(ring_audio_tests)

# rau_chunk.h is the unit's own (not public) header of the pure part: taken from the same copy as the code.
target_include_directories(app PRIVATE ${RING_AUDIO_DIR}/src ${RING_STORE_INCLUDE} ${CMAKE_CURRENT_SOURCE_DIR}/src)

target_sources(app PRIVATE
  src/common.c
  src/test_cfg.c
  src/test_chunk.c
  src/test_motor.c
  src/test_svc.c)
```

## prj.conf
```kconfig
CONFIG_ZTEST=y
CONFIG_RING_RHW=y
CONFIG_RING_RHW_SIM=y
CONFIG_RING_AUDIO=y
CONFIG_THREAD_NAME=y
CONFIG_ZTEST_STACK_SIZE=8192
```

## src/common.c
```c
/* Helpers of tests/audio: the pure part's pool of chunk buffers, the frame-counter source, and the stand-in for the
 * store's hand-off (the store's own code is never linked here: another builder writes it). */
#include "common.h"

/* ------------------------------------------------------------------ pool for the pure tests */
static struct rst_chunk pool[T_POOL];
static int pool_next;
static struct rst_chunk *fulls[T_POOL];
static int n_fulls;
static struct {
	uint32_t chunk;
	uint8_t block;
} drops[64];
static int n_drops;
static struct rac_facts facts;

static struct rst_chunk *op_get(void *ctx, struct rac_facts *f)
{
	ARG_UNUSED(ctx);
	if (pool_next >= T_POOL) {
		return NULL;
	}
	*f = facts;
	facts.battery_mv++;
	return &pool[pool_next++];
}

static void op_full(void *ctx, struct rst_chunk *c)
{
	ARG_UNUSED(ctx);
	fulls[n_fulls++] = c;
}

static void op_dropout(void *ctx, uint32_t chunk, uint8_t block)
{
	ARG_UNUSED(ctx);
	if (n_drops < 64) {
		drops[n_drops].chunk = chunk;
		drops[n_drops].block = block;
	}
	n_drops++;
}

static const struct rac_ops ops = { .get = op_get, .full = op_full, .dropout = op_dropout };

void t_reset(void)
{
	memset(pool, 0xA5, sizeof(pool));
	pool_next = 0;
	n_fulls = 0;
	n_drops = 0;
	memset(&facts, 0, sizeof(facts));
}

const struct rac_ops *t_ops(void)
{
	return &ops;
}

int t_fulls(void)
{
	return n_fulls;
}

struct rst_chunk *t_full(int i)
{
	return fulls[i];
}

int t_dropouts(void)
{
	return n_drops;
}

uint32_t t_dropout_chunk(int i)
{
	return drops[i].chunk;
}

uint8_t t_dropout_block(int i)
{
	return drops[i].block;
}

void t_facts(uint16_t mv, int16_t temp, uint32_t fw, bool b15)
{
	facts.battery_mv = mv;
	facts.temp_c_x10 = temp;
	facts.fw_version = fw;
	facts.b15 = b15;
}

struct rac_start t_start(bool time_set, int64_t start_ms, uint64_t start_cycles, uint32_t hz)
{
	struct rac_start a = {
		.recording_id = 1, .recording_type = 1, .boot_count = 1, .time_set = time_set,
		.utc_offset_ms = 1700000000000LL, .start_ms = start_ms, .start_cycles = start_cycles, .cycles_hz = hz,
	};

	return a;
}

int16_t t_counter_left(uint32_t f)
{
	return (int16_t)(uint16_t)(f & 0xFFFFu);
}

static void counter_block(int16_t *b, uint32_t k)
{
	for (uint32_t j = 0; j < 256; j++) {
		uint32_t f = k * 256 + j;

		b[2 * j] = t_counter_left(f);
		b[2 * j + 1] = (int16_t)~(uint16_t)t_counter_left(f);
	}
}

void t_feed(struct rac *s, uint32_t first, uint32_t n)
{
	static int16_t b[512];

	for (uint32_t k = first; k < first + n; k++) {
		counter_block(b, k);
		(void)rac_block(s, b, &ops);
	}
}

void t_feed_block_with(struct rac *s, uint32_t k, uint32_t frame_in_block, int channel, int16_t v)
{
	static int16_t b[512];

	counter_block(b, k);
	b[2 * frame_in_block + channel] = v;
	(void)rac_block(s, b, &ops);
}

int16_t t_left(const struct rst_chunk *c, uint32_t i)
{
	int16_t v;

	memcpy(&v, &c->bytes[RREC_CHUNK_HEADER_BYTES + 4 * i], 2);
	return v;
}

int16_t t_right(const struct rst_chunk *c, uint32_t i)
{
	int16_t v;

	memcpy(&v, &c->bytes[RREC_CHUNK_HEADER_BYTES + 4 * i + 2], 2);
	return v;
}

bool t_tail_zero(const struct rst_chunk *c, uint32_t frames)
{
	for (uint32_t i = RREC_CHUNK_HEADER_BYTES + 4 * frames; i < RREC_CHUNK_BYTES; i++) {
		if (c->bytes[i] != 0) {
			return false;
		}
	}
	return true;
}

/* ------------------------------------------------------------------ the store's hand-off, as a stand-in */
static struct {
	struct rst_chunk *live;
	struct rst_chunk copy;
	rst_chunk_done_fn done;
	bool completed;
} si[SI_MAX];
static int si_n;
static bool hold;
static int enobufs_after = -1;
static struct k_spinlock si_lock;
static struct k_work si_work;
static bool work_ready;

static void si_work_fn(struct k_work *w)
{
	ARG_UNUSED(w);
	for (int i = 0; i < SI_MAX; i++) {
		struct rst_chunk *c = NULL;
		rst_chunk_done_fn d = NULL;
		k_spinlock_key_t k = k_spin_lock(&si_lock);

		if (i < si_n && !si[i].completed && !hold) {
			si[i].completed = true;
			c = si[i].live;
			d = si[i].done;
		}
		k_spin_unlock(&si_lock, k);
		if (d != NULL) {
			d(c, 0);
		}
	}
}

void si_reset(void)
{
	if (!work_ready) {
		k_work_init(&si_work, si_work_fn);
		work_ready = true;
	}
	k_work_cancel(&si_work);
	si_n = 0;
	hold = false;
	enobufs_after = -1;
	memset(si, 0, sizeof(si));
}

void si_hold(bool h)
{
	hold = h;
	if (!h) {
		k_work_submit(&si_work);
	}
}

void si_enobufs_after(int n)
{
	enobufs_after = n;
}

int si_puts(void)
{
	return si_n;
}

const struct rst_chunk *si_copy(int i)
{
	return &si[i].copy;
}

const struct rst_chunk *si_live(int i)
{
	return si[i].live;
}

int si_put(struct rst_chunk *c, rst_chunk_done_fn done)
{
	if (enobufs_after >= 0 && si_n >= enobufs_after) {
		return -ENOBUFS;
	}
	k_spinlock_key_t k = k_spin_lock(&si_lock);
	int i = si_n++;

	if (i < SI_MAX) {
		si[i].live = c;
		si[i].done = done;
		memcpy(&si[i].copy, c, sizeof(*c));
	}
	k_spin_unlock(&si_lock, k);
	if (!hold) {
		k_work_submit(&si_work);
	}
	return 0;
}

void si_complete(int i)
{
	struct rst_chunk *c = NULL;
	rst_chunk_done_fn d = NULL;
	k_spinlock_key_t k = k_spin_lock(&si_lock);

	if (i < si_n && !si[i].completed) {
		si[i].completed = true;
		c = si[i].live;
		d = si[i].done;
	}
	k_spin_unlock(&si_lock, k);
	if (d != NULL) {
		d(c, 0);
	}
}

void si_complete_all(void)
{
	for (int i = 0; i < SI_MAX && i < si_n; i++) {
		si_complete(i);
	}
}

/* the default path of rau.c (cb.put NULL) lands here, as it would in the store */
int rst_put_chunk(struct rst_chunk *c, rst_chunk_done_fn done)
{
	return si_put(c, done);
}

/* ------------------------------------------------------------------ thin part */
struct svc_events svc_ev;
uint32_t svc_fw_version = 0x01020003u;

static void cb_no_block(void)
{
	svc_ev.no_block++;
	svc_ev.no_block_ms = rhw_clock()->now_ms();
}

static void cb_dropout(uint32_t rec, uint32_t chunk, uint8_t block)
{
	svc_ev.dropouts++;
	svc_ev.dr_rec = rec;
	svc_ev.dr_chunk = chunk;
	svc_ev.dr_block = block;
}

static void cb_facts(uint16_t *mv, int16_t *temp, uint32_t *fw)
{
	struct rhw_pmic_sample s;

	/* stands for the join: the battery and the die temperature of the simulated power chip */
	if (rhw_pmic()->sample(&s) == 0) {
		*mv = s.mv;
		*temp = s.die_c_x10;
	}
	*fw = svc_fw_version;
}

void svc_setup(void)
{
	rhw_sim_reset();
	si_reset();
	memset(&svc_ev, 0, sizeof(svc_ev));
	struct rau_cb cb = { .put = si_put, .no_block = cb_no_block, .dropout = cb_dropout, .chunk_facts = cb_facts };

	zassert_ok(rau_init(&cb));
}

void svc_cleanup(void)
{
	si_hold(false);
	si_complete_all();
	if (rau_capturing()) {
		(void)rau_halt();
	}
	(void)rau_release();
	k_sleep(K_MSEC(20));
}

int64_t svc_begin(bool time_set, bool b15)
{
	struct rau_start_args a = {
		.recording_id = 7, .recording_type = RREC_REC_TYPE_RECORDING, .boot_count = 4, .time_set = time_set,
		.utc_offset_ms = 1700000000000LL, .b15 = b15,
	};

	zassert_ok(rhw_pmic()->rail_set(RHW_RAIL_MIC, true, "test_join"));
	zassert_ok(rau_prepare(100));
	k_sleep(K_MSEC(RREC_MIC_RAIL_WAIT_MS));
	zassert_ok(rau_start(&a));
	return rhw_clock()->now_ms();
}

int32_t ev_find(uint16_t kind, uint32_t from)
{
	return rhw_sim_log_find(kind, from);
}

int64_t ev_t_us(int32_t idx)
{
	struct rhw_sim_ev e;

	zassert_true(rhw_sim_log_get((uint32_t)idx, &e));
	return e.t_us;
}

int64_t ev_a0(int32_t idx)
{
	struct rhw_sim_ev e;

	zassert_true(rhw_sim_log_get((uint32_t)idx, &e));
	return e.a0;
}
```

## src/common.h
```c
/* Helpers shared by the suites of tests/audio (software step 6, unit U3). Every expected value in the suites is a
 * literal written from design/firmware.md (the line is cited at each case), never produced by the code under test. */
#ifndef AUDIO_TEST_COMMON_H
#define AUDIO_TEST_COMMON_H

#include <errno.h>
#include <string.h>

#include <zephyr/kernel.h>
#include <zephyr/ztest.h>

#include <ring_audio/rau.h>
#include <ring_rhw/rhw.h>
#include <ring_rhw/rhw_sim.h>

#include "rau_chunk.h"

/* ------------------------------------------------------------------ the pure part's test ops: a pool of chunk buffers */
#define T_POOL 10
void t_reset(void);                        /* pool dirty (0xA5), counters zero, facts default */
const struct rac_ops *t_ops(void);
int t_fulls(void);                         /* chunks handed over by rac_block so far */
struct rst_chunk *t_full(int i);
int t_dropouts(void);                      /* dropout callbacks so far */
uint32_t t_dropout_chunk(int i);
uint8_t t_dropout_block(int i);
void t_facts(uint16_t mv, int16_t temp, uint32_t fw, bool b15);   /* what the next chunk's start gets; mv += 1 per chunk */
struct rac_start t_start(bool time_set, int64_t start_ms, uint64_t start_cycles, uint32_t hz);
/* feed blocks first..first+n-1 of the frame-counter source (left = frame number since the PDM start, 16 bits,
 * right = its bitwise inverse) */
void t_feed(struct rac *s, uint32_t first, uint32_t n);
/* feed one block of the counter source, but with the one chosen sample forced to a value */
void t_feed_block_with(struct rac *s, uint32_t k, uint32_t frame_in_block, int channel, int16_t v);
/* left and right sample of kept frame i of a chunk's payload */
int16_t t_left(const struct rst_chunk *c, uint32_t i);
int16_t t_right(const struct rst_chunk *c, uint32_t i);
/* the counter source's value at raw frame f since the PDM start */
int16_t t_counter_left(uint32_t f);
/* check that all unused payload bytes after `frames` frames are zero */
bool t_tail_zero(const struct rst_chunk *c, uint32_t frames);

/* ------------------------------------------------------------------ stand-in for the store's chunk hand-off */
#define SI_MAX 12
void si_reset(void);
void si_hold(bool hold);                   /* true: chunks are never reported written until si_complete() */
void si_enobufs_after(int n);              /* the (n+1)th put and later return -ENOBUFS; -1 = never */
int si_puts(void);
const struct rst_chunk *si_copy(int i);    /* the chunk as it was when put */
const struct rst_chunk *si_live(int i);    /* the buffer the audio part handed over, as it is now */
void si_complete(int i);
void si_complete_all(void);
int si_put(struct rst_chunk *c, rst_chunk_done_fn done);

/* ------------------------------------------------------------------ the thin part on the simulated input */
struct svc_events {
	int dropouts;
	uint32_t dr_rec, dr_chunk;
	uint8_t dr_block;
	int no_block;
	int64_t no_block_ms;
};
extern struct svc_events svc_ev;
extern uint32_t svc_fw_version;
void svc_setup(void);                      /* rhw_sim_reset, stand-in reset, rau_init with the callbacks below */
void svc_cleanup(void);
/* rails on (as the join does), HFXO, 1 ms, rau_start; returns the uptime ms of the PDM start */
int64_t svc_begin(bool time_set, bool b15);
/* index in the simulated event log of the first entry of this kind at or after `from`, or -1 */
int32_t ev_find(uint16_t kind, uint32_t from);
int64_t ev_t_us(int32_t idx);
int64_t ev_a0(int32_t idx);

#endif
```

## src/test_cfg.c
```c
/* Suite audio_cfg (software step 6, unit U3): the configuration the audio part gives the microphone input, and the
 * specification's constants it rests on. Expected values are literals from design/firmware.md (lines cited). */
#include "common.h"

static void before(void *f)
{
	ARG_UNUSED(f);
	svc_setup();
}

static void after(void *f)
{
	ARG_UNUSED(f);
	svc_cleanup();
}

ZTEST_SUITE(audio_cfg, NULL, NULL, before, after, NULL);

/* A1: FW l.410 to l.420: pdm20, 2 channels, 16,000 Hz, 16 bits, clock window 1,200,000 to 1,650,000 Hz, block 1,024
 * bytes, 8 blocks; the simulated input records what it received. */
ZTEST(audio_cfg, test_dmic_config_values)
{
	struct rhw_mic_cfg got;

	zassert_false(rhw_sim_mic_last_cfg(&got), "nothing configured before the start");
	(void)svc_begin(true, false);
	zassert_true(rhw_sim_mic_last_cfg(&got));
	zassert_equal(got.pcm_rate, 16000, "FW l.411");
	zassert_equal(got.pcm_width, 16, "FW l.412");
	zassert_equal(got.channels, 2, "FW l.413");
	zassert_equal(got.min_pdm_clk_hz, 1200000, "FW l.415");
	zassert_equal(got.max_pdm_clk_hz, 1650000, "FW l.415");
	zassert_equal(got.gain_db, 0, "FW l.417");
	zassert_equal(got.block_size, 1024, "FW l.419");
	zassert_equal(got.block_count, 8, "FW l.420");
	/* order: configure, pins default, trigger (rau.h) */
	int32_t c = ev_find(RHW_EV_MIC_CONFIGURE, 0);
	int32_t d = ev_find(RHW_EV_MIC_PINS_DEFAULT, 0);
	int32_t s = ev_find(RHW_EV_MIC_START, 0);

	zassert_true(c >= 0 && d > c && s > d, "configure %d, pins default %d, start %d", c, d, s);
}

/* The numbers of rrec_spec.h that the unit uses, against the specification's literals (FW l.411 to l.420, l.440,
 * l.443, l.460, l.495, l.535). */
ZTEST(audio_cfg, test_spec_numbers)
{
	zassert_equal(RREC_BLOCK_BYTES, 1024, "FW l.419");
	zassert_equal(RREC_BLOCK_FRAMES, 256, "FW l.419");
	zassert_equal(RREC_BLOCK_MS, 16, "FW l.419");
	zassert_equal(RREC_BLOCK_COUNT, 8, "FW l.420");
	zassert_equal(RREC_BLOCKS_PER_CHUNK, 32, "FW l.443");
	zassert_equal(RREC_CHUNK_RING, 3, "FW l.440");
	zassert_equal(RREC_CHUNK_BYTES, 33280, "FW l.535");
	zassert_equal(RREC_CHUNK_FRAMES, 8192, "FW l.535");
	zassert_equal(RREC_DISCARD_FRAMES, 800, "FW l.460");
	zassert_equal(RREC_MOTOR_TAIL_FRAMES, 800, "FW l.495");
	zassert_equal(RREC_MIC_NO_BLOCK_MS, 100, "FW l.169");
}

/* A2: FW l.416, l.560, l.561: the header carries 1,280,000 and 80 (the store writes them from these numbers); the
 * driver's own pick of the clock is not shown by the simulation. */
ZTEST(audio_cfg, test_header_clock_fields)
{
	zassert_equal(RREC_PDM_CLOCK_HZ, 1280000, "FW l.416, l.560");
	zassert_equal(RREC_PDM_RATIO, 80, "FW l.416, l.561");
	zassert_equal(RREC_PDM_CLOCK_HZ / RREC_PDM_RATIO, 16000, "FW l.416: 1,280,000 / 80 = 16,000 Hz");
}

/* A3: FW l.417: gain 0 dB, register value 0x28; header gain_code 0x28 (l.562). */
ZTEST(audio_cfg, test_gain_zero)
{
	struct rhw_mic_cfg got;

	(void)svc_begin(true, false);
	zassert_true(rhw_sim_mic_last_cfg(&got));
	zassert_equal(got.gain_db, 0, "FW l.417");
	zassert_equal(RREC_PDM_GAIN_DB, 0, "FW l.417");
	zassert_equal(RREC_PDM_GAIN_CODE, 0x28, "FW l.417, l.562");
}
```

## src/test_chunk.c
```c
/* Suite audio_chunk (software step 6, unit U3): blocks into chunks (design/firmware.md 4.1 to 4.5, 5.3). Pure part
 * only. Source of every case: the frame counter (left = frame number since the PDM start, 16 bits; right = its
 * bitwise inverse), so the kept frame i of a recording holds the value i + 800 on the left (FW l.460: 800 frames
 * are dropped). Expected values are literals written from the specification, with the line cited. */
#include "common.h"

static struct rac s;

static void before(void *f)
{
	ARG_UNUSED(f);
	t_reset();
}

ZTEST_SUITE(audio_chunk, NULL, NULL, before, NULL, NULL);

static void begin_with(bool time_set, int64_t start_ms, uint64_t start_cycles, uint32_t hz)
{
	struct rac_start a = t_start(time_set, start_ms, start_cycles, hz);

	rac_begin(&s, &a);
}

static void begin(void)
{
	begin_with(true, 1000, 1000000, 1000000);
}

/* A4, FW l.418, l.422, l.443: the block's order is kept, channel 0 first. First kept frame = raw frame 800. */
ZTEST(audio_chunk, test_interleave_order)
{
	struct rst_close_args cl;

	begin();
	t_feed(&s, 0, 4);
	struct rst_chunk *c = rac_cut(&s, &cl);

	zassert_not_null(c);
	zassert_equal(t_left(c, 0), 800, "channel 0 first");
	zassert_equal(t_right(c, 0), -801, "channel 1 second: bitwise inverse of 800");
	zassert_equal(t_left(c, 1), 801);
	zassert_equal(t_right(c, 1), -802);
}

/* A5, FW l.423: samples stored as they come, no level rule. */
ZTEST(audio_chunk, test_payload_equals_blocks)
{
	begin();
	t_feed(&s, 0, 36);
	zassert_equal(t_fulls(), 1);
	const struct rst_chunk *c = t_full(0);

	for (uint32_t i = 0; i < 8192; i++) {
		int16_t l = (int16_t)(uint16_t)((i + 800u) & 0xFFFFu);

		zassert_equal(t_left(c, i), l, "frame %u left", i);
		zassert_equal(t_right(c, i), (int16_t)~(uint16_t)l, "frame %u right", i);
	}
}

/* A9, FW l.447, l.460: the first 50 ms (800 frames) are dropped. 3 blocks = 768 frames: nothing kept; 4 blocks: 224. */
ZTEST(audio_chunk, test_discard_800_frames)
{
	struct rst_close_args cl;

	begin();
	t_feed(&s, 0, 3);
	zassert_is_null(rac_cut(&s, &cl), "768 frames are all inside the discard");
	zassert_equal(cl.duration_frames, 0);

	t_reset();
	begin();
	t_feed(&s, 0, 4);
	struct rst_chunk *c = rac_cut(&s, &cl);

	zassert_not_null(c);
	zassert_equal(c->hdr.frames, 224, "1,024 - 800");
	zassert_equal(cl.duration_frames, 224);
	zassert_equal(t_left(c, 0), 800, "the first kept frame is raw frame 800, not 0");
}

/* A9, FW l.460, l.558: the recording time is that of the first kept frame (PDM start + 50 ms). PDM start at 12 s. */
ZTEST(audio_chunk, test_start_time_is_first_kept_frame)
{
	struct rst_close_args cl;

	begin_with(true, 12000, 12000000, 1000000);
	t_feed(&s, 0, 4);
	struct rst_chunk *c = rac_cut(&s, &cl);

	zassert_not_null(c);
	zassert_equal(c->hdr.uptime_ns, 12050000000ULL, "12 s + 50 ms");
	zassert_equal(c->hdr.utc_ms, 1700000012050LL, "offset 1,700,000,000,000 ms + 12,050 ms");
	zassert_equal(c->hdr.first_frame_index, 0);
}

/* A8, FW l.443: 32 blocks fill a chunk (8,192 frames). The first chunk is full in the 36th block (8,992 raw frames
 * = 800 + 8,192), the next 32 blocks later, in the 68th. */
ZTEST(audio_chunk, test_32_blocks_per_chunk)
{
	int first = 0, second = 0;

	begin();
	for (uint32_t k = 0; k < 70; k++) {
		t_feed(&s, k, 1);
		if (t_fulls() == 1 && first == 0) {
			first = (int)k + 1;
		}
		if (t_fulls() == 2 && second == 0) {
			second = (int)k + 1;
		}
	}
	zassert_equal(first, 36, "first chunk full after 36 blocks");
	zassert_equal(second, 68, "second chunk full after 68 blocks");
	zassert_equal(second - first, 32, "32 blocks per chunk");
	zassert_equal(t_full(0)->hdr.frames, 8192);
	zassert_equal(t_full(1)->hdr.frames, 8192);
	zassert_equal(t_full(1)->hdr.first_frame_index, 8192);
	zassert_equal(t_full(1)->hdr.chunk_in_recording, 1);
}

/* A7, FW l.430: a missing block becomes zeros of the same length, flag bit 7, counted, logged; the recording keeps its
 * length. Block 6 (raw frames 1,536 to 1,791 = kept 736 to 991) is missing. */
ZTEST(audio_chunk, test_dropout_zero_fill)
{
	struct rst_close_args cl;

	begin();
	t_feed(&s, 0, 6);
	zassert_ok(rac_block(&s, NULL, t_ops()));
	t_feed(&s, 7, 3);
	struct rst_chunk *c = rac_cut(&s, &cl);

	zassert_not_null(c);
	zassert_equal(c->hdr.frames, 1760, "10 blocks = 2,560 raw frames - 800: the length does not change");
	zassert_equal(cl.duration_frames, 1760);
	zassert_equal(c->hdr.dropout_blocks, 1);
	zassert_equal(c->hdr.flags, RREC_CH_FLAG_FIRST | RREC_CH_FLAG_LAST | RREC_CH_FLAG_DROPOUT, "0x83");
	zassert_equal(t_left(c, 735), 1535, "the frame before the gap");
	for (uint32_t i = 736; i < 992; i++) {
		zassert_equal(t_left(c, i), 0, "frame %u zero", i);
		zassert_equal(t_right(c, i), 0, "frame %u zero", i);
	}
	zassert_equal(t_left(c, 992), 1792, "the stream goes on in place after the gap");
	zassert_equal(t_dropouts(), 1, "logged once");
	zassert_equal(t_dropout_chunk(0), 0);
	zassert_equal(t_dropout_block(0), 2, "at frame 736 of the chunk = block position 2");

	/* a missing block over a chunk edge: block 35 holds kept frames 8,160 to 8,415 (chunk edge at 8,192) */
	t_reset();
	begin();
	t_feed(&s, 0, 35);
	zassert_ok(rac_block(&s, NULL, t_ops()));
	t_feed(&s, 36, 1);
	zassert_equal(t_fulls(), 1);
	c = rac_cut(&s, &cl);
	zassert_not_null(c);
	const struct rst_chunk *c0 = t_full(0);

	zassert_equal(c0->hdr.flags, RREC_CH_FLAG_FIRST | RREC_CH_FLAG_DROPOUT, "0x81");
	zassert_equal(c0->hdr.dropout_blocks, 1);
	zassert_equal(c->hdr.flags, RREC_CH_FLAG_LAST | RREC_CH_FLAG_DROPOUT, "0x82");
	zassert_equal(c->hdr.dropout_blocks, 1, "counted in each chunk it touches");
	zassert_equal(c->hdr.frames, 480, "9,472 raw - 800 - 8,192");
	zassert_equal(t_left(c0, 8191), 0);
	zassert_equal(t_left(c, 223), 0);
	zassert_equal(t_left(c, 224), 9216, "8,416 + 800");
	zassert_equal(t_dropouts(), 1, "one block, one log");
	zassert_equal(cl.duration_frames, 8672);
}

/* S10, FW l.547: each flag bit; bit 2 and bits 8 to 15 are zero. Frame 100 of block 3 is raw frame 868 (kept). */
static uint16_t flags_of(bool time_set, bool b15, int clip_channel, int16_t clip_val, bool dropout, bool motor)
{
	struct rst_close_args cl;

	t_reset();
	t_facts(3800, 250, 0x01020003, b15);
	begin_with(time_set, 1000, 1000000, 1000000);
	if (motor) {
		rac_motor_edge(&s, true, 1060000);    /* frame 160 */
		rac_motor_edge(&s, false, 1062000);   /* frame 192: interval [160; 992) */
	}
	t_feed(&s, 0, 3);
	if (dropout) {
		(void)rac_block(&s, NULL, t_ops());
	} else if (clip_channel >= 0) {
		t_feed_block_with(&s, 3, 100, clip_channel, clip_val);
	} else {
		t_feed(&s, 3, 1);
	}
	struct rst_chunk *c = rac_cut(&s, &cl);

	zassert_not_null(c);
	zassert_equal(c->hdr.flags & 0xFF04, 0, "bit 2 and bits 8 to 15 are zero");
	return c->hdr.flags;
}

ZTEST(audio_chunk, test_flags_each_bit)
{
	zassert_equal(flags_of(true, false, -1, 0, false, false), 0x03, "first and last only");
	zassert_equal(flags_of(true, false, -1, 0, false, true), 0x0B, "bit 3: a motor interval");
	zassert_equal(flags_of(true, false, 0, INT16_MIN, false, false), 0x13, "bit 4: -32768");
	zassert_equal(flags_of(true, false, 1, INT16_MAX, false, false), 0x13, "bit 4: 32767");
	zassert_equal(flags_of(false, false, -1, 0, false, false), 0x23, "bit 5: time not set");
	zassert_equal(flags_of(true, true, -1, 0, false, false), 0x43, "bit 6: battery at B15 or under");
	zassert_equal(flags_of(true, false, -1, 0, true, false), 0x83, "bit 7: dropout");
	/* a clipped sample in the discarded 800 frames is not stored: no flag */
	struct rst_close_args cl;

	t_reset();
	begin();
	t_feed_block_with(&s, 0, 10, 0, INT16_MIN);
	t_feed(&s, 1, 3);
	struct rst_chunk *c = rac_cut(&s, &cl);

	zassert_not_null(c);
	zassert_equal(c->hdr.flags, 0x03, "no clip flag for a sample that was dropped");
}

/* S9, FW l.535: unused payload bytes of the last chunk are zero (the buffers were filled with 0xA5), the last chunk is
 * flagged; frames are what was kept. */
ZTEST(audio_chunk, test_partial_last_chunk)
{
	struct rst_close_args cl;

	begin();
	t_feed(&s, 0, 40);
	struct rst_chunk *c1 = rac_cut(&s, &cl);

	zassert_not_null(c1);
	zassert_equal(t_fulls(), 1);
	zassert_equal(t_full(0)->hdr.flags, 0x01, "the full chunk: first only");
	zassert_equal(c1->hdr.flags, 0x02, "the partial chunk: last only");
	zassert_equal(c1->hdr.frames, 1248, "10,240 - 800 - 8,192");
	zassert_equal(c1->hdr.chunk_in_recording, 1);
	zassert_true(t_tail_zero(c1, 1248), "payload bytes after the last frame are zero");
	zassert_equal(cl.duration_frames, 9440);

	/* the stop mark inside a block: exactly 1,000 frames are kept */
	t_reset();
	begin();
	rac_set_limit(&s, 1000);
	t_feed(&s, 0, 10);
	zassert_true(rac_limit_reached(&s));
	c1 = rac_cut(&s, &cl);
	zassert_not_null(c1);
	zassert_equal(c1->hdr.frames, 1000);
	zassert_equal(cl.duration_frames, 1000);
	zassert_equal(t_left(c1, 999), 1799, "999 + 800");
	zassert_equal(t_left(c1, 1000), 0, "nothing after the mark");
	zassert_true(t_tail_zero(c1, 1000));

	/* the mark exactly at a chunk edge: that chunk has already gone to the store; no partial chunk */
	t_reset();
	begin();
	rac_set_limit(&s, 8192);
	t_feed(&s, 0, 40);
	c1 = rac_cut(&s, &cl);
	zassert_is_null(c1);
	zassert_equal(t_fulls(), 1);
	zassert_equal(cl.duration_frames, 8192);
}

/* C13, FW l.244, l.263, l.566 (ruling R24): the marker is the frame number of CENTRE_DOWN counted from the first kept
 * frame of the recording. PDM start at 1,000 ms; CENTRE_DOWN at 1,600 ms = 600 ms after the start: frame
 * 600 x 16 - 800 = 8,800. The call comes later, when 9,440 frames are kept; the chunk being filled is chunk 1. */
ZTEST(audio_chunk, test_highlight_frame_from_down_time)
{
	struct rst_close_args cl;

	begin();
	t_feed(&s, 0, 40);
	rac_highlight(&s, 1600);
	struct rst_chunk *c1 = rac_cut(&s, &cl);

	zassert_not_null(c1);
	zassert_equal(c1->hdr.highlight_count, 1);
	zassert_equal(c1->hdr.highlight_frame[0], 8800, "frame number of CENTRE_DOWN, not an offset in the chunk");
	zassert_equal(cl.highlight_count, 1);
	zassert_equal(cl.highlight_ms[0], 550, "8,800 frames = 550 ms from the first kept frame");
	zassert_equal(cl.highlight_ms[1], 0xFFFFFFFFu);
}

/* S11, FW l.564, l.566, l.582, l.632, ruling D4: up to 8 in a chunk header; the first 32 in the CLOSE record with the
 * full count. Nine in one chunk: frames 160 x k (k = 1 to 9) = CENTRE_DOWN at 1,000 + 50 + 10 k ms. */
ZTEST(audio_chunk, test_highlights_in_header)
{
	struct rst_close_args cl;

	begin();
	t_feed(&s, 0, 12);                      /* 3,072 raw frames = 2,272 kept */
	for (int k = 1; k <= 9; k++) {
		rac_highlight(&s, 1050 + 10 * k);
	}
	struct rst_chunk *c = rac_cut(&s, &cl);

	zassert_not_null(c);
	zassert_equal(c->hdr.highlight_count, 8, "a ninth stays out of the header (D4)");
	for (int k = 1; k <= 8; k++) {
		zassert_equal(c->hdr.highlight_frame[k - 1], 160 * k, "highlight %d", k);
	}
	zassert_equal(cl.highlight_count, 9, "the CLOSE record keeps the full count");
	for (int k = 1; k <= 9; k++) {
		zassert_equal(cl.highlight_ms[k - 1], 10 * k, "close ms %d", k);
	}
	zassert_equal(cl.highlight_ms[9], 0xFFFFFFFFu);

	/* 40 highlights, one every 80 ms (1,280 frames) from the first kept frame, over 6 full chunks and a partial one */
	t_reset();
	begin();
	int next = 0;

	for (uint32_t k = 0; k < 208; k++) {
		int64_t kept_after = (int64_t)(k + 1) * 256 - 800;

		while (next < 40 && 1280 * (int64_t)next < kept_after) {
			rac_highlight(&s, 1050 + 80 * next);
			next++;
		}
		t_feed(&s, k, 1);
	}
	c = rac_cut(&s, &cl);
	zassert_not_null(c);
	zassert_equal(next, 40);
	zassert_equal(cl.highlight_count, 40);
	for (int i = 0; i < 32; i++) {
		zassert_equal(cl.highlight_ms[i], 80 * i, "close ms %d", i);
	}
	int seen = 0;

	for (int n = 0; n <= t_fulls(); n++) {
		const struct rst_chunk *ch = n < t_fulls() ? t_full(n) : c;

		zassert_true(ch->hdr.highlight_count <= 8);
		for (int j = 0; j < ch->hdr.highlight_count; j++) {
			zassert_equal(ch->hdr.highlight_frame[j], 1280u * (uint32_t)seen, "highlight %d at its frame", seen);
			seen++;
		}
	}
	zassert_equal(seen, 40, "every highlight is in a header, in order");
}

/* Ruling R24, FW l.566: a highlight fires 440 to 850 ms after CENTRE_DOWN, so its frame often lies in a chunk that has
 * already gone to the store. The marker is written in the chunk being filled when it fires, with the frame number of
 * CENTRE_DOWN. CENTRE_DOWN at 1,300 ms = frame 4,000 (chunk 0, already full); chunk 1 is being filled. */
ZTEST(audio_chunk, test_late_highlight_in_next_chunk)
{
	struct rst_close_args cl;

	begin();
	t_feed(&s, 0, 40);
	zassert_equal(t_fulls(), 1);
	rac_highlight(&s, 1300);
	struct rst_chunk *c1 = rac_cut(&s, &cl);

	zassert_not_null(c1);
	zassert_equal(t_full(0)->hdr.highlight_count, 0);
	zassert_equal(c1->hdr.highlight_count, 1, "found in the next chunk's header");
	zassert_equal(c1->hdr.highlight_frame[0], 4000, "with the frame number of CENTRE_DOWN");
	zassert_equal(cl.highlight_count, 1);
	zassert_equal(cl.highlight_ms[0], 250, "4,000 frames = 250 ms");
}

/* Ruling R24, F2: the stop comes right after a full chunk went out (mark exactly at the chunk edge) and a highlight
 * fires after it: no partial chunk exists, so the marker is in the CLOSE record only. */
ZTEST(audio_chunk, test_highlight_without_partial_chunk_close_only)
{
	struct rst_close_args cl;

	begin();
	rac_set_limit(&s, 8192);
	t_feed(&s, 0, 40);
	rac_highlight(&s, 1300);
	struct rst_chunk *c = rac_cut(&s, &cl);

	zassert_is_null(c);
	zassert_equal(t_fulls(), 1);
	zassert_equal(t_full(0)->hdr.highlight_count, 0);
	zassert_equal(cl.highlight_count, 1, "kept in the CLOSE record");
	zassert_equal(cl.highlight_ms[0], 250);
}

/* S12, FW l.557, l.558, l.573: utc_ms, uptime_ns of the chunk's first frame, cycle_hz. Chunk 1 starts 8,192 frames =
 * 512 ms after chunk 0. */
ZTEST(audio_chunk, test_timestamps)
{
	struct rst_close_args cl;
	struct rst_chunk *c1;

	begin_with(true, 12000, 12000000, 1000000);
	t_feed(&s, 0, 40);
	c1 = rac_cut(&s, &cl);
	zassert_not_null(c1);
	zassert_equal(t_full(0)->hdr.uptime_ns, 12050000000ULL);
	zassert_equal(t_full(0)->hdr.utc_ms, 1700000012050LL);
	zassert_equal(t_full(0)->hdr.cycle_hz, 1000000);
	zassert_equal(c1->hdr.uptime_ns, 12562000000ULL, "+ 512 ms");
	zassert_equal(c1->hdr.utc_ms, 1700000012562LL);

	/* a counter of 16 MHz: the same instant is 192,000,000 cycles */
	t_reset();
	begin_with(true, 12000, 192000000, 16000000);
	t_feed(&s, 0, 40);
	c1 = rac_cut(&s, &cl);
	zassert_not_null(c1);
	zassert_equal(t_full(0)->hdr.uptime_ns, 12050000000ULL);
	zassert_equal(t_full(0)->hdr.cycle_hz, 16000000);
	zassert_equal(c1->hdr.uptime_ns, 12562000000ULL);

	/* 20 days of uptime on a 16 MHz counter: 27,648,000,000,000 cycles: no overflow */
	t_reset();
	begin_with(true, 1728000000, 27648000000000ULL, 16000000);
	t_feed(&s, 0, 40);
	c1 = rac_cut(&s, &cl);
	zassert_not_null(c1);
	zassert_equal(t_full(0)->hdr.uptime_ns, 1728000050000000ULL);
	zassert_equal(t_full(0)->hdr.utc_ms, 1701728000050LL);
}

/* S12, FW l.557, l.1005: time not set: utc_ms 0 in every chunk, flag bit 5; uptime_ns still written. */
ZTEST(audio_chunk, test_time_not_set)
{
	struct rst_close_args cl;

	begin_with(false, 12000, 12000000, 1000000);
	t_feed(&s, 0, 40);
	struct rst_chunk *c1 = rac_cut(&s, &cl);

	zassert_not_null(c1);
	zassert_equal(t_full(0)->hdr.utc_ms, 0);
	zassert_equal(c1->hdr.utc_ms, 0);
	zassert_true(t_full(0)->hdr.flags & RREC_CH_FLAG_TIME_NOT_SET);
	zassert_true(c1->hdr.flags & RREC_CH_FLAG_TIME_NOT_SET);
	zassert_equal(t_full(0)->hdr.uptime_ns, 12050000000ULL);
	zassert_equal(c1->hdr.uptime_ns, 12562000000ULL);
}

/* S13, FW l.567 to l.571: battery_mv and temp_c_x10 at the chunk start, boot_count, fw_version. The test's source of
 * facts gives 3,871 mV for the first chunk and 3,872 mV for the second. */
ZTEST(audio_chunk, test_fill_fields)
{
	struct rst_close_args cl;
	struct rac_start a = t_start(true, 1000, 1000000, 1000000);

	a.boot_count = 9;
	a.recording_id = 5;
	a.recording_type = RREC_REC_TYPE_FACTORY;
	t_facts(3871, -45, 0x01020003, false);
	rac_begin(&s, &a);
	t_feed(&s, 0, 40);
	struct rst_chunk *c1 = rac_cut(&s, &cl);

	zassert_not_null(c1);
	zassert_equal(t_full(0)->hdr.battery_mv, 3871);
	zassert_equal(t_full(0)->hdr.temp_c_x10, -45);
	zassert_equal(t_full(0)->hdr.boot_count, 9);
	zassert_equal(t_full(0)->hdr.fw_version, 0x01020003);
	zassert_equal(t_full(0)->hdr.recording_id, 5);
	zassert_equal(t_full(0)->hdr.recording_type, 2);
	zassert_equal(c1->hdr.battery_mv, 3872, "taken at the start of each chunk");
	zassert_equal(c1->hdr.boot_count, 9);
	zassert_equal(c1->hdr.recording_id, 5);
}
```

## src/test_motor.c
```c
/* Suite audio_motor (software step 6, unit U3): motor intervals in the chunk headers (design/firmware.md 4.7, 5.3).
 * Pure part only. Time base of every case: the PDM starts at start_cycles on a counter of 1,000,000 cycles per second
 * (1 cycle = 1 us); a frame index counts from the first kept frame (50 ms = 800 frames after the start), so the
 * frame at index f lies (f + 800) / 16 ms after the start. Expected frames are literals worked out by hand from FW l.495. */
#include "common.h"

#define HZ 1000000u

static struct rac s;

static void before(void *f)
{
	ARG_UNUSED(f);
	t_reset();
}

ZTEST_SUITE(audio_motor, NULL, NULL, before, NULL, NULL);

static void begin(uint64_t start_cycles)
{
	struct rac_start a = t_start(true, (int64_t)(start_cycles / 1000u), start_cycles, HZ);

	rac_begin(&s, &a);
}

/* A16, FW l.495: an interval runs from the frame of MOTOR high to 800 frames (50 ms) after MOTOR low.
 * High 200 ms after the start: frame 200 x 16 - 800 = 2,400; low 240 ms after: frame 3,040; end 3,040 + 800 = 3,840. */
ZTEST(audio_motor, test_interval_frames)
{
	struct rst_close_args cl;

	begin(5000000);
	rac_motor_edge(&s, true, 5200000);
	rac_motor_edge(&s, false, 5240000);
	t_feed(&s, 0, 20);                       /* 5,120 raw frames = 4,320 kept */
	struct rst_chunk *c = rac_cut(&s, &cl);

	zassert_not_null(c);
	zassert_equal(c->hdr.frames, 4320);
	zassert_equal(c->hdr.motor_count, 1);
	zassert_equal(c->hdr.motor_frames[0][0], 2400, "start = frame of MOTOR high");
	zassert_equal(c->hdr.motor_frames[0][1], 3840, "end = frame of MOTOR low + 800");
	zassert_true(c->hdr.flags & RREC_CH_FLAG_MOTOR, "flag bit 3");
}

/* A17, FW l.496, l.576: an interval over two chunks is written in both, cut at the chunk edge.
 * High at frame 8,100 (556.25 ms after the start), low at frame 8,300 (568.75 ms): interval [8,100; 9,100).
 * Chunk 0 holds frames 0 to 8,191: {8,100; 8,192}. Chunk 1 starts at 8,192: {0; 908}. */
ZTEST(audio_motor, test_span_two_chunks)
{
	struct rst_close_args cl;

	begin(0);
	rac_motor_edge(&s, true, 556250);
	rac_motor_edge(&s, false, 568750);
	t_feed(&s, 0, 40);                       /* 10,240 raw frames = 9,440 kept: chunk 0 full, 1,248 in chunk 1 */
	zassert_equal(t_fulls(), 1);
	struct rst_chunk *c0 = t_full(0);
	struct rst_chunk *c1 = rac_cut(&s, &cl);

	zassert_equal(c0->hdr.motor_count, 1);
	zassert_equal(c0->hdr.motor_frames[0][0], 8100);
	zassert_equal(c0->hdr.motor_frames[0][1], 8192, "cut at the chunk edge");
	zassert_true(c0->hdr.flags & RREC_CH_FLAG_MOTOR);
	zassert_not_null(c1);
	zassert_equal(c1->hdr.motor_count, 1, "written in the second chunk too");
	zassert_equal(c1->hdr.motor_frames[0][0], 0);
	zassert_equal(c1->hdr.motor_frames[0][1], 908);
	zassert_true(c1->hdr.flags & RREC_CH_FLAG_MOTOR);
}

/* Same, with MOTOR still high when chunk 0 ends: the low edge arrives after the chunk went to the store. */
ZTEST(audio_motor, test_span_open_interval)
{
	struct rst_close_args cl;

	begin(0);
	rac_motor_edge(&s, true, 556250);
	t_feed(&s, 0, 36);                       /* 9,216 raw frames: chunk 0 (8,992 raw) is full, MOTOR still high */
	zassert_equal(t_fulls(), 1);
	rac_motor_edge(&s, false, 568750);
	t_feed(&s, 36, 4);
	struct rst_chunk *c0 = t_full(0);
	struct rst_chunk *c1 = rac_cut(&s, &cl);

	zassert_equal(c0->hdr.motor_count, 1);
	zassert_equal(c0->hdr.motor_frames[0][0], 8100);
	zassert_equal(c0->hdr.motor_frames[0][1], 8192);
	zassert_not_null(c1);
	zassert_equal(c1->hdr.motor_count, 1);
	zassert_equal(c1->hdr.motor_frames[0][0], 0);
	zassert_equal(c1->hdr.motor_frames[0][1], 908);
}

/* A17, FW l.576: at most 4 in a header; a fifth is merged into the fourth (its end frame moved).
 * Five pulses of 100 frames, one every 1,000 frames from frame 100: high at 100, 1,100, 2,100, 3,100, 4,100; low 100
 * frames later; each interval = [high; low + 800) = [100; 1,000), [1,100; 2,000) ... [4,100; 5,000). Header: 4
 * intervals; the fourth {3,100; 5,000} (the fifth's end). */
ZTEST(audio_motor, test_fifth_merged_into_fourth)
{
	struct rst_close_args cl;
	/* frame f is at (f + 800) / 16 ms = (f + 800) x 62.5 us */
	static const uint64_t hi_us[5] = { 56250, 118750, 181250, 243750, 306250 };   /* frames 100, 1100, 2100, 3100, 4100 */
	static const uint64_t lo_us[5] = { 62500, 125000, 187500, 250000, 312500 };   /* frames 200, 1200, 2200, 3200, 4200 */

	begin(0);
	for (int i = 0; i < 5; i++) {
		rac_motor_edge(&s, true, hi_us[i]);
		rac_motor_edge(&s, false, lo_us[i]);
	}
	t_feed(&s, 0, 25);                       /* 6,400 raw frames = 5,600 kept */
	struct rst_chunk *c = rac_cut(&s, &cl);

	zassert_not_null(c);
	zassert_equal(c->hdr.motor_count, 4, "at most 4");
	zassert_equal(c->hdr.motor_frames[0][0], 100);
	zassert_equal(c->hdr.motor_frames[0][1], 1000);
	zassert_equal(c->hdr.motor_frames[1][0], 1100);
	zassert_equal(c->hdr.motor_frames[2][0], 2100);
	zassert_equal(c->hdr.motor_frames[3][0], 3100);
	zassert_equal(c->hdr.motor_frames[3][1], 5000, "the fifth's end moved into the fourth");
}

/* A17, FW l.577, l.566: unused motor pairs and highlight slots read 0xFFFFFFFF; no interval: count 0, flag bit 3 clear. */
ZTEST(audio_motor, test_unused_pairs_ff)
{
	struct rst_close_args cl;

	begin(0);
	rac_motor_edge(&s, true, 100000);        /* frame 800 */
	rac_motor_edge(&s, false, 110000);       /* frame 960; interval [800; 1,760) */
	t_feed(&s, 0, 10);
	struct rst_chunk *c = rac_cut(&s, &cl);

	zassert_not_null(c);
	zassert_equal(c->hdr.motor_count, 1);
	for (int i = 1; i < 4; i++) {
		zassert_equal(c->hdr.motor_frames[i][0], 0xFFFFFFFFu, "pair %d start", i);
		zassert_equal(c->hdr.motor_frames[i][1], 0xFFFFFFFFu, "pair %d end", i);
	}
	for (int i = 0; i < 8; i++) {
		zassert_equal(c->hdr.highlight_frame[i], 0xFFFFFFFFu, "highlight slot %d", i);
	}
	/* no interval at all */
	t_reset();
	begin(0);
	t_feed(&s, 0, 10);
	c = rac_cut(&s, &cl);
	zassert_not_null(c);
	zassert_equal(c->hdr.motor_count, 0);
	zassert_false(c->hdr.flags & RREC_CH_FLAG_MOTOR);
	for (int i = 0; i < 4; i++) {
		zassert_equal(c->hdr.motor_frames[i][0], 0xFFFFFFFFu);
		zassert_equal(c->hdr.motor_frames[i][1], 0xFFFFFFFFu);
	}
}

/* A18, FW l.497: M1 (80 ms) runs while the first 50 ms are discarded; the rest of the pulse plus 50 ms is marked in
 * the first chunk. PDM start at 1,000,000 us. */
ZTEST(audio_motor, test_m1_rest_marked_in_first_chunk)
{
	struct rst_close_args cl;
	struct rst_chunk *c;

	/* MOTOR high at 970 ms, low at 1,050 ms (80 ms): the low edge is exactly at the first kept frame (index 0), so
	 * the marked part is only the 800-frame tail: {0; 800}. The start (index -1,280) is cut at the chunk start. */
	begin(1000000);
	rac_motor_edge(&s, true, 970000);
	rac_motor_edge(&s, false, 1050000);
	t_feed(&s, 0, 8);
	c = rac_cut(&s, &cl);
	zassert_not_null(c);
	zassert_equal(c->hdr.motor_count, 1);
	zassert_equal(c->hdr.motor_frames[0][0], 0);
	zassert_equal(c->hdr.motor_frames[0][1], 800);
	zassert_true(c->hdr.flags & RREC_CH_FLAG_MOTOR);

	/* the pulse ends 100 ms after the start (frame 800): 800 + 800 = {0; 1,600} */
	t_reset();
	begin(1000000);
	rac_motor_edge(&s, true, 1020000);
	rac_motor_edge(&s, false, 1100000);
	t_feed(&s, 0, 12);
	c = rac_cut(&s, &cl);
	zassert_not_null(c);
	zassert_equal(c->hdr.motor_count, 1);
	zassert_equal(c->hdr.motor_frames[0][0], 0);
	zassert_equal(c->hdr.motor_frames[0][1], 1600);

	/* the pulse ends 20 ms after the start (inside the discard, frame -480): only the tail's 320 frames are kept */
	t_reset();
	begin(1000000);
	rac_motor_edge(&s, true, 940000);
	rac_motor_edge(&s, false, 1020000);
	t_feed(&s, 0, 8);
	c = rac_cut(&s, &cl);
	zassert_not_null(c);
	zassert_equal(c->hdr.motor_count, 1);
	zassert_equal(c->hdr.motor_frames[0][1], 320);

	/* a pulse that ended before the PDM started leaves no mark (its tail ends inside the discard) */
	t_reset();
	begin(1000000);
	rac_motor_edge(&s, true, 800000);
	rac_motor_edge(&s, false, 880000);
	t_feed(&s, 0, 8);
	c = rac_cut(&s, &cl);
	zassert_not_null(c);
	zassert_equal(c->hdr.motor_count, 0);
	zassert_false(c->hdr.flags & RREC_CH_FLAG_MOTOR);
}
```
