## CMakeLists.txt
```
cmake_minimum_required(VERSION 3.20.0)

# RING_RHW_DIR lets a run point at a broken copy of ring_rhw to prove that these tests can fail (broken_run.sh).
if(NOT DEFINED RING_RHW_DIR)
  set(RING_RHW_DIR ${CMAKE_CURRENT_SOURCE_DIR}/../../modules/ring_rhw)
endif()
list(APPEND ZEPHYR_EXTRA_MODULES ${RING_RHW_DIR})

find_package(Zephyr REQUIRED HINTS $ENV{ZEPHYR_BASE})
project(ring_rhw_tests)

# The public headers of the other units of step 6 (written by U0), compiled alone, one file per header; ring_core's
# include folder only for the core's types that rrec.h names (the core itself is not built here).
set(FWM ${CMAKE_CURRENT_SOURCE_DIR}/../../modules)
target_include_directories(app PRIVATE
  ${FWM}/ring_store/include ${FWM}/ring_audio/include ${FWM}/ring_xfer/include ${FWM}/ring_power/include
  ${FWM}/ring_motor/include ${FWM}/ring_sys/include ${FWM}/ring_factory/include ${FWM}/ring_recorder/include
  ${FWM}/ring_core/include)

target_sources(app PRIVATE
  src/test_rhw.c
  src/hdr_rrec_spec.c src/hdr_rhw.c src/hdr_rhw_sim.c
  src/hdr_rst.c src/hdr_rau.c src/hdr_rxf.c src/hdr_rpw.c src/hdr_rmo.c src/hdr_rsy.c src/hdr_rfa.c src/hdr_rrec.c)
```

## prj.conf
```kconfig
CONFIG_ZTEST=y
CONFIG_RING_RHW=y
CONFIG_RING_RHW_SIM=y
CONFIG_THREAD_NAME=y
CONFIG_ZTEST_STACK_SIZE=8192
```

## src/hdr_rau.c
```c
/* Compiles the public header ring_audio/rau.h alone: it is the first and only include of this file (step 6 plan, U0 "Done when"). */
#include <ring_audio/rau.h>

int hdr_rau_compiled(void);
int hdr_rau_compiled(void)
{
	return 1;
}
```

## src/hdr_rfa.c
```c
/* Compiles the public header ring_factory/rfa.h alone: it is the first and only include of this file (step 6 plan, U0 "Done when"). */
#include <ring_factory/rfa.h>

int hdr_rfa_compiled(void);
int hdr_rfa_compiled(void)
{
	return 1;
}
```

## src/hdr_rhw.c
```c
/* Compiles the public header ring_rhw/rhw.h alone: it is the first and only include of this file (step 6 plan, U0 "Done when"). */
#include <ring_rhw/rhw.h>

int hdr_rhw_compiled(void);
int hdr_rhw_compiled(void)
{
	return 1;
}
```

## src/hdr_rhw_sim.c
```c
/* Compiles the public header ring_rhw/rhw_sim.h alone: it is the first and only include of this file (step 6 plan, U0 "Done when"). */
#include <ring_rhw/rhw_sim.h>

int hdr_rhw_sim_compiled(void);
int hdr_rhw_sim_compiled(void)
{
	return 1;
}
```

## src/hdr_rmo.c
```c
/* Compiles the public header ring_motor/rmo.h alone: it is the first and only include of this file (step 6 plan, U0 "Done when"). */
#include <ring_motor/rmo.h>

int hdr_rmo_compiled(void);
int hdr_rmo_compiled(void)
{
	return 1;
}
```

## src/hdr_rpw.c
```c
/* Compiles the public header ring_power/rpw.h alone: it is the first and only include of this file (step 6 plan, U0 "Done when"). */
#include <ring_power/rpw.h>

int hdr_rpw_compiled(void);
int hdr_rpw_compiled(void)
{
	return 1;
}
```

## src/hdr_rrec.c
```c
/* Compiles the public header ring_recorder/rrec.h alone: it is the first and only include of this file (step 6 plan, U0 "Done when"). */
#include <ring_recorder/rrec.h>

int hdr_rrec_compiled(void);
int hdr_rrec_compiled(void)
{
	return 1;
}
```

## src/hdr_rrec_spec.c
```c
/* Compiles the public header ring_rhw/rrec_spec.h alone: it is the first and only include of this file (step 6 plan, U0 "Done when"). */
#include <ring_rhw/rrec_spec.h>

int hdr_rrec_spec_compiled(void);
int hdr_rrec_spec_compiled(void)
{
	return 1;
}
```

## src/hdr_rst.c
```c
/* Compiles the public header ring_store/rst.h alone: it is the first and only include of this file (step 6 plan, U0 "Done when"). */
#include <ring_store/rst.h>

int hdr_rst_compiled(void);
int hdr_rst_compiled(void)
{
	return 1;
}
```

## src/hdr_rsy.c
```c
/* Compiles the public header ring_sys/rsy.h alone: it is the first and only include of this file (step 6 plan, U0 "Done when"). */
#include <ring_sys/rsy.h>

int hdr_rsy_compiled(void);
int hdr_rsy_compiled(void)
{
	return 1;
}
```

## src/hdr_rxf.c
```c
/* Compiles the public header ring_xfer/rxf.h alone: it is the first and only include of this file (step 6 plan, U0 "Done when"). */
#include <ring_xfer/rxf.h>

int hdr_rxf_compiled(void);
int hdr_rxf_compiled(void)
{
	return 1;
}
```
