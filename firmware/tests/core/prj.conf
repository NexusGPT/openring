## CMakeLists.txt
```
cmake_minimum_required(VERSION 3.20.0)

# The ring core module is found by path, so this test builds without a west.yml entry.
# RING_CORE_DIR lets a run point at a broken copy of the module (broken_run.sh) to prove that these tests can fail.
if(NOT DEFINED RING_CORE_DIR)
  set(RING_CORE_DIR ${CMAKE_CURRENT_SOURCE_DIR}/../../modules/ring_core)
endif()
list(APPEND ZEPHYR_EXTRA_MODULES ${RING_CORE_DIR})

find_package(Zephyr REQUIRED HINTS $ENV{ZEPHYR_BASE})
project(ring_core_tests)

target_include_directories(app PRIVATE src)
target_sources(app PRIVATE
  src/th.c
  src/test_rows.c
  src/test_gesture.c
  src/test_rules.c
  src/test_round2.c
  src/test_round3.c
  src/test_round4.c
)
```

## prj.conf
```kconfig
CONFIG_ZTEST=y
CONFIG_RING_CORE=y
```

## src/test_gesture.c
```c
/*
 * Gesture recogniser tests, design/firmware.md (F6) sections 2.1 and 2.2.
 * Every centre case runs for both centre sources (SW2 and PAIR).
 * Line numbers are those of design/firmware.md.
 */
#include "th.h"

#define T0 10000

/* ---- centre press durations, gesture table lines 211 to 215 ---- */

static void dur_case(enum rc_centre_source src, rc_ms_t dur, int shorts, int warns, int longs)
{
	tg_start(src);
	tg_centre(T0, dur);
	tg_tick(T0 + 5000);
	zassert_equal(tg_count(RC_GEV_SHORT), shorts, "short");
	zassert_equal(tg_count(RC_GEV_WARN), warns, "warn");
	zassert_equal(tg_count(RC_GEV_LONG), longs, "long");
	zassert_equal(tg_count(RC_GEV_DOUBLE), 0, "double");
}

#define DUR(name, dur, s, w, l) \
	ZTEST(rc_gesture, test_sw2_hold_##name) { dur_case(RC_CENTRE_SW2, dur, s, w, l); } \
	ZTEST(rc_gesture, test_pair_hold_##name) { dur_case(RC_CENTRE_PAIR, dur, s, w, l); }

DUR(39ms_graze_ignored, 39, 0, 0, 0)      /* line 214: under 40 ms ignored */
DUR(40ms_short, 40, 1, 0, 0)              /* line 212: 40 ms to 450 ms */
DUR(450ms_short, 450, 1, 0, 0)            /* lines 212, 221: 450 included (reading, notes U1) */
DUR(451ms_ignored, 451, 0, 0, 0)          /* line 215: ignored */
DUR(499ms_ignored_no_warn, 499, 0, 0, 0)  /* line 223: MW at 500 ms */
DUR(500ms_ignored_warn, 500, 0, 1, 0)     /* lines 215, 223 */
DUR(999ms_ignored_warn, 999, 0, 1, 0)     /* line 215 */
DUR(1000ms_long, 1000, 0, 1, 1)           /* line 211 */

static void long_fires_while_held(enum rc_centre_source src)
{
	/* line 211: fires at the 1,000 ms mark while still held, once per press; the release does nothing */
	tg_start(src);
	if (src == RC_CENTRE_SW2) {
		tg_in(RC_SW_CENTRE, true, T0);
	} else {
		tg_in(RC_SW_LEFT, true, T0 - 10);
		tg_in(RC_SW_RIGHT, true, T0);
	}
	tg_tick(T0 + 999);
	zassert_equal(tg_count(RC_GEV_LONG), 0);
	tg_tick(T0 + 1000);
	zassert_equal(tg_count(RC_GEV_LONG), 1);
	zassert_equal(tg_get(RC_GEV_LONG, 0)->t, T0 + 1000);
	zassert_equal(tg_get(RC_GEV_LONG, 0)->t_down, T0);
	tg_tick(T0 + 6000);                 /* G5 line 240: holding on does nothing more */
	zassert_equal(tg_count(RC_GEV_LONG), 1);
	int before = gl.n;
	if (src == RC_CENTRE_SW2) {
		tg_in(RC_SW_CENTRE, false, T0 + 6000);
	} else {
		tg_in(RC_SW_LEFT, false, T0 + 6000);
		tg_in(RC_SW_RIGHT, false, T0 + 6000);
	}
	tg_tick(T0 + 9000);
	for (int i = before; i < gl.n; i++) {
		zassert_true(gl.e[i].type == RC_GEV_CENTRE_UP, "only the key release");
	}
	zassert_equal(tg_count(RC_GEV_SHORT) + tg_count(RC_GEV_DOUBLE), 0);
}

ZTEST(rc_gesture, test_sw2_long_fires_once_while_held) { long_fires_while_held(RC_CENTRE_SW2); }
ZTEST(rc_gesture, test_pair_long_fires_once_while_held) { long_fires_while_held(RC_CENTRE_PAIR); }

static void warn_time(enum rc_centre_source src)
{
	/* G2 line 237: one MW at 500 ms of the hold */
	tg_start(src);
	tg_centre(T0, 700);
	zassert_equal(tg_count(RC_GEV_WARN), 1);
	zassert_equal(tg_get(RC_GEV_WARN, 0)->t, T0 + 500);
}

ZTEST(rc_gesture, test_sw2_warn_at_500ms) { warn_time(RC_CENTRE_SW2); }
ZTEST(rc_gesture, test_pair_warn_at_500ms) { warn_time(RC_CENTRE_PAIR); }

static void short_window(enum rc_centre_source src)
{
	/* line 212: fires when the 400 ms window closes; line 226: carries the CENTRE_DOWN time */
	tg_start(src);
	tg_centre(T0, 100);
	tg_tick(T0 + 100 + 400);
	zassert_equal(tg_count(RC_GEV_SHORT), 0, "window still open at 400 ms");
	tg_tick(T0 + 100 + 401);
	zassert_equal(tg_count(RC_GEV_SHORT), 1);
	zassert_equal(tg_get(RC_GEV_SHORT, 0)->t_down, T0);
}

ZTEST(rc_gesture, test_sw2_short_fires_when_window_closes) { short_window(RC_CENTRE_SW2); }
ZTEST(rc_gesture, test_pair_short_fires_when_window_closes) { short_window(RC_CENTRE_PAIR); }

/* ---- second press gap, lines 213, 222, 246 ---- */

static void gap_case(enum rc_centre_source src, rc_ms_t gap, int doubles, int shorts)
{
	tg_start(src);
	tg_centre(T0, 100);
	tg_centre(T0 + 100 + gap, 100);
	tg_tick(T0 + 5000);
	zassert_equal(tg_count(RC_GEV_DOUBLE), doubles, "double");
	zassert_equal(tg_count(RC_GEV_SHORT), shorts, "short");
	zassert_equal(tg_count(RC_GEV_LONG), 0);
}

#define GAP(name, gap, d, s) \
	ZTEST(rc_gesture, test_sw2_gap_##name) { gap_case(RC_CENTRE_SW2, gap, d, s); } \
	ZTEST(rc_gesture, test_pair_gap_##name) { gap_case(RC_CENTRE_PAIR, gap, d, s); }

GAP(59ms_not_double, 59, 0, 1)   /* under 60 ms: not a double; line 246: the first short is cancelled, the second judged on its own (reading, notes U2) */
GAP(60ms_double, 60, 1, 0)
GAP(400ms_double, 400, 1, 0)
GAP(401ms_two_shorts, 401, 0, 2) /* window closed: the first short fired, the second is its own short */

static void second_press_long(enum rc_centre_source src)
{
	/* line 246: held 1,000 ms, a long press from its own CENTRE_DOWN; the earlier short is cancelled */
	tg_start(src);
	tg_centre(T0, 100);
	tg_centre(T0 + 300, 1200);
	tg_tick(T0 + 5000);
	zassert_equal(tg_count(RC_GEV_LONG), 1);
	zassert_equal(tg_get(RC_GEV_LONG, 0)->t, T0 + 300 + 1000);
	zassert_equal(tg_count(RC_GEV_SHORT), 0);
	zassert_equal(tg_count(RC_GEV_DOUBLE), 0);
}

ZTEST(rc_gesture, test_sw2_second_press_long_counts_from_own_down) { second_press_long(RC_CENTRE_SW2); }
ZTEST(rc_gesture, test_pair_second_press_long_counts_from_own_down) { second_press_long(RC_CENTRE_PAIR); }

/* ---- directions, line 252 to 256 ---- */

static const enum rc_switch dirs[4] = { RC_SW_UP, RC_SW_DOWN, RC_SW_LEFT, RC_SW_RIGHT };

static void dir_tap(enum rc_centre_source src, enum rc_switch d)
{
	/* line 254: released first with no centre press: the direction is sent at that moment */
	tg_start(src);
	tg_in(d, true, T0);
	tg_in(d, false, T0 + 25);
	tg_tick(T0 + 3000);
	zassert_equal(tg_count(RC_GEV_DIR), 1);
	zassert_equal(tg_get(RC_GEV_DIR, 0)->dir, d);
	zassert_equal(tg_get(RC_GEV_DIR, 0)->t, T0 + 25);
	zassert_equal(tg_count(RC_GEV_CENTRE_DOWN), 0);
}

static void dir_hold_repeat(enum rc_centre_source src, enum rc_switch d)
{
	/* line 254: the window ends at 40 ms, the event is sent then (at most 40 ms after the edge);
	 * line 252: held 500 ms repeats every 150 ms */
	tg_start(src);
	tg_in(d, true, T0);
	tg_tick(T0 + 39);
	zassert_equal(tg_count(RC_GEV_DIR), 0);
	tg_tick(T0 + 40);
	zassert_equal(tg_count(RC_GEV_DIR), 1);
	zassert_equal(tg_get(RC_GEV_DIR, 0)->t, T0 + 40);
	zassert_false(tg_get(RC_GEV_DIR, 0)->repeat);
	tg_tick(T0 + 499);
	zassert_equal(tg_count(RC_GEV_DIR), 1);
	tg_tick(T0 + 500);
	zassert_equal(tg_count(RC_GEV_DIR), 2);
	zassert_true(tg_get(RC_GEV_DIR, 1)->repeat);
	tg_tick(T0 + 649);
	zassert_equal(tg_count(RC_GEV_DIR), 2);
	tg_tick(T0 + 650);
	zassert_equal(tg_count(RC_GEV_DIR), 3);
	tg_tick(T0 + 800);
	zassert_equal(tg_count(RC_GEV_DIR), 4);
	zassert_equal(tg_get(RC_GEV_DIR, 3)->dir, d);
	tg_in(d, false, T0 + 801);
	tg_tick(T0 + 3000);
	zassert_equal(tg_count(RC_GEV_DIR), 4, "repeat stops at release");
	zassert_equal(tg_count(RC_GEV_CENTRE_DOWN) + tg_count(RC_GEV_LONG) + tg_count(RC_GEV_WARN), 0);
}

#define DIRT(name, idx) \
	ZTEST(rc_gesture, test_sw2_dir_##name##_tap) { dir_tap(RC_CENTRE_SW2, dirs[idx]); } \
	ZTEST(rc_gesture, test_pair_dir_##name##_tap) { dir_tap(RC_CENTRE_PAIR, dirs[idx]); } \
	ZTEST(rc_gesture, test_sw2_dir_##name##_hold_repeat) { dir_hold_repeat(RC_CENTRE_SW2, dirs[idx]); } \
	ZTEST(rc_gesture, test_pair_dir_##name##_hold_repeat) { dir_hold_repeat(RC_CENTRE_PAIR, dirs[idx]); }

DIRT(up, 0)
DIRT(down, 1)
DIRT(left, 2)
DIRT(right, 3)

ZTEST(rc_gesture, test_sw2_dir_then_centre_at_39ms_centre_wins)
{
	/* line 232: a direction that closed 0 to 40 ms before SW2 is dropped and the centre wins */
	for (int i = 0; i < 4; i++) {
		tg_start(RC_CENTRE_SW2);
		tg_in(dirs[i], true, T0);
		tg_in(RC_SW_CENTRE, true, T0 + 39);
		tg_tick(T0 + 39 + 1000);
		zassert_equal(tg_count(RC_GEV_DIR), 0);
		zassert_equal(tg_get(RC_GEV_CENTRE_DOWN, 0)->t, T0 + 39);
		zassert_equal(tg_count(RC_GEV_LONG), 1);
	}
}

ZTEST(rc_gesture, test_sw2_dir_then_centre_at_40ms_direction_kept)
{
	/* line 232: one that closed 40 ms or more before SW2 keeps its direction and SW2 is ignored until all switches are open */
	for (int i = 0; i < 4; i++) {
		tg_start(RC_CENTRE_SW2);
		tg_in(dirs[i], true, T0);
		tg_in(RC_SW_CENTRE, true, T0 + 40);
		tg_tick(T0 + 3000);
		zassert_equal(tg_get(RC_GEV_DIR, 0)->dir, dirs[i]);
		zassert_equal(tg_count(RC_GEV_CENTRE_DOWN), 0);
		zassert_equal(tg_count(RC_GEV_LONG) + tg_count(RC_GEV_WARN), 0);
	}
}

ZTEST(rc_gesture, test_pair_opposite_at_39ms_is_centre_stamped_second_edge)
{
	/* line 256 rules (1), (2); line 233: stamped at the second edge */
	for (int i = 0; i < 4; i++) {
		enum rc_switch opp = dirs[i ^ 1];

		tg_start(RC_CENTRE_PAIR);
		tg_in(dirs[i], true, T0);
		tg_in(opp, true, T0 + 39);
		tg_tick(T0 + 39 + 1000);
		zassert_equal(tg_count(RC_GEV_DIR), 0);
		zassert_equal(tg_get(RC_GEV_CENTRE_DOWN, 0)->t, T0 + 39);
		zassert_equal(tg_get(RC_GEV_LONG, 0)->t, T0 + 39 + 1000);
	}
}

ZTEST(rc_gesture, test_pair_opposite_at_40ms_is_direction)
{
	/* line 256 rule (3) and "a close of the opposite switch after the window is ignored" */
	for (int i = 0; i < 4; i++) {
		enum rc_switch opp = dirs[i ^ 1];

		tg_start(RC_CENTRE_PAIR);
		tg_in(dirs[i], true, T0);
		tg_in(opp, true, T0 + 40);
		tg_tick(T0 + 3000);
		zassert_equal(tg_get(RC_GEV_DIR, 0)->dir, dirs[i]);
		zassert_equal(tg_get(RC_GEV_DIR, 0)->t, T0 + 40);
		zassert_equal(tg_count(RC_GEV_CENTRE_DOWN) + tg_count(RC_GEV_LONG), 0);
	}
}

ZTEST(rc_gesture, test_pair_non_opposite_switch_ignored)
{
	/* line 256 rule (4) */
	tg_start(RC_CENTRE_PAIR);
	tg_in(RC_SW_UP, true, T0);
	tg_in(RC_SW_LEFT, true, T0 + 10);
	tg_tick(T0 + 40);
	zassert_equal(tg_count(RC_GEV_DIR), 1);
	zassert_equal(tg_get(RC_GEV_DIR, 0)->dir, RC_SW_UP);
	zassert_equal(tg_count(RC_GEV_CENTRE_DOWN), 0);
}

ZTEST(rc_gesture, test_pair_centre_has_no_repeat)
{
	/* line 256 rule (5) */
	tg_start(RC_CENTRE_PAIR);
	tg_in(RC_SW_UP, true, T0);
	tg_in(RC_SW_DOWN, true, T0 + 5);
	tg_tick(T0 + 4000);
	zassert_equal(tg_count(RC_GEV_DIR), 0);
	zassert_equal(tg_count(RC_GEV_LONG), 1);
}

ZTEST(rc_gesture, test_pair_ignores_btn_rec)
{
	/* line 233: BTN_REC P0.04 is unused in case PAIR */
	tg_start(RC_CENTRE_PAIR);
	tg_in(RC_SW_CENTRE, true, T0);
	tg_tick(T0 + 3000);
	zassert_equal(gl.n, 0);
	zassert_equal(rc_gesture_next_tick(&gg), RC_NO_TICK);
}

ZTEST(rc_gesture, test_dir_sent_then_others_ignored_until_all_open)
{
	/* line 254: after a direction event is sent, every other switch is ignored until all switches are open */
	tg_start(RC_CENTRE_SW2);
	tg_in(RC_SW_UP, true, T0);
	tg_tick(T0 + 40);
	tg_in(RC_SW_LEFT, true, T0 + 100);
	tg_in(RC_SW_UP, false, T0 + 150);
	tg_in(RC_SW_CENTRE, true, T0 + 200);
	tg_tick(T0 + 2000);
	zassert_equal(tg_count(RC_GEV_DIR), 1);
	zassert_equal(tg_count(RC_GEV_CENTRE_DOWN), 0);
}

/* ---- centre key: roll and release hold-off, line 255 ---- */

ZTEST(rc_gesture, test_sw2_roll_does_not_end_long_press)
{
	tg_start(RC_CENTRE_SW2);
	tg_in(RC_SW_CENTRE, true, T0);
	tg_in(RC_SW_RIGHT, true, T0 + 300);   /* thumb rolls toward a direction */
	tg_in(RC_SW_CENTRE, false, T0 + 400); /* SW2 opens, the direction is still closed */
	tg_tick(T0 + 1000);
	zassert_equal(tg_count(RC_GEV_LONG), 1);
	zassert_equal(tg_count(RC_GEV_DIR), 0, "no direction while the key is down");
}

ZTEST(rc_gesture, test_pair_one_side_lets_go_does_not_end_long_press)
{
	tg_start(RC_CENTRE_PAIR);
	tg_in(RC_SW_LEFT, true, T0 - 10);
	tg_in(RC_SW_RIGHT, true, T0);
	tg_in(RC_SW_RIGHT, false, T0 + 300);
	tg_tick(T0 + 1000);
	zassert_equal(tg_count(RC_GEV_LONG), 1);
	zassert_equal(tg_count(RC_GEV_DIR), 0);
}

ZTEST(rc_gesture, test_release_holdoff_29ms_bounce_same_press)
{
	/* line 224: 30 ms release hold-off; a re-close inside it keeps the key down */
	tg_start(RC_CENTRE_SW2);
	tg_in(RC_SW_CENTRE, true, T0);
	tg_in(RC_SW_CENTRE, false, T0 + 200);
	tg_in(RC_SW_CENTRE, true, T0 + 229);
	tg_tick(T0 + 1000);
	zassert_equal(tg_count(RC_GEV_CENTRE_UP), 0);
	zassert_equal(tg_count(RC_GEV_LONG), 1);
}

ZTEST(rc_gesture, test_release_holdoff_30ms_ends_press_stamped_at_release)
{
	/* line 255: CENTRE_UP is stamped at the instant the last switch opened */
	tg_start(RC_CENTRE_SW2);
	tg_in(RC_SW_CENTRE, true, T0);
	tg_in(RC_SW_CENTRE, false, T0 + 200);
	tg_in(RC_SW_CENTRE, true, T0 + 230);
	zassert_equal(tg_count(RC_GEV_CENTRE_UP), 1);
	zassert_equal(tg_get(RC_GEV_CENTRE_UP, 0)->t, T0 + 200);
	zassert_equal(tg_count(RC_GEV_CENTRE_DOWN), 2);
}

ZTEST(rc_gesture, test_release_before_mark_in_holdoff_no_long)
{
	/* held 990 ms: the 1,000 ms mark falls inside the hold-off, the press was shorter: no long */
	tg_start(RC_CENTRE_SW2);
	tg_in(RC_SW_CENTRE, true, T0);
	tg_in(RC_SW_CENTRE, false, T0 + 990);
	tg_tick(T0 + 3000);
	zassert_equal(tg_count(RC_GEV_LONG), 0);
}

/* ---- next tick ---- */

ZTEST(rc_gesture, test_next_tick_follows_deadlines)
{
	tg_start(RC_CENTRE_SW2);
	zassert_equal(rc_gesture_next_tick(&gg), RC_NO_TICK);
	tg_in(RC_SW_CENTRE, true, T0);
	zassert_equal(rc_gesture_next_tick(&gg), T0 + 500);
	tg_tick(T0 + 500);
	zassert_equal(rc_gesture_next_tick(&gg), T0 + 1000);
	tg_start(RC_CENTRE_SW2);
	tg_in(RC_SW_CENTRE, true, T0);
	tg_in(RC_SW_CENTRE, false, T0 + 100);
	zassert_equal(rc_gesture_next_tick(&gg), T0 + 130);
	tg_tick(T0 + 130);
	zassert_equal(rc_gesture_next_tick(&gg), T0 + 100 + 401);
	tg_tick(T0 + 501);
	zassert_equal(rc_gesture_next_tick(&gg), RC_NO_TICK);
	tg_in(RC_SW_UP, true, T0 + 1000);
	zassert_equal(rc_gesture_next_tick(&gg), T0 + 1040);
}

ZTEST(rc_core_timing, test_core_next_tick_includes_state_timers)
{
	th_start(RC_ST_ERR_MIC_FAULT);
	zassert_equal(rc_core_next_tick(&core), TH_T0 + SPEC_MIC_FAULT_MS);
	th_start(RC_ST_ERR_STORAGE_FAULT);
	zassert_equal(rc_core_next_tick(&core), TH_T0 + SPEC_STORAGE_RETRY_MS);
	th_start(RC_ST_STANDBY);
	zassert_equal(rc_core_next_tick(&core), RC_NO_TICK);
}

ZTEST_SUITE(rc_gesture, NULL, NULL, NULL, NULL, NULL);
ZTEST_SUITE(rc_core_timing, NULL, NULL, NULL, NULL, NULL);
```

## src/test_round2.c
```c
/*
 * Round 2: one or more tests per ruling R1 to R8 and C1 to C6 of
 * firmware/docs/core-delta-1.md, as written into design/firmware.md (F7 part 1).
 * Line numbers are those of F7 part 1.
 */
#include "th.h"

#define F (rc_core_facts(&core))
#define A(x) RC_ACT_##x

/* ---- R1: row 12 guard, refusal rows 14 and 15, rule R-STB (lines 144 to 147, 205) ---- */

ZTEST(rc_round2, test_r1_long_press_at_b5_refused_with_message)
{
	th_start(RC_ST_STANDBY);
	F->batt = RC_BATT_B5;
	th_long();
	zassert_equal(rc_core_state(&core), RC_ST_STANDBY);
	zassert_false(th_has(&out, RC_ACT_OPEN));
	zassert_false(rc_core_mic_rail(&core));
	TH_EXPECT(A(SCR_MSG_BATTERY_LOW_3S));
}

ZTEST(rc_round2, test_r1_long_press_at_sfull_refused_with_message)
{
	th_start(RC_ST_STANDBY);
	F->storage_full = true;
	th_long();
	zassert_equal(rc_core_state(&core), RC_ST_STANDBY);
	TH_EXPECT(A(SCR_MSG_STORAGE_FULL_3S));
}

ZTEST(rc_round2, test_r1_long_press_at_b5_and_sfull_battery_message)
{
	/* row 14 comes before row 15 (battery first) */
	th_start(RC_ST_STANDBY);
	F->batt = RC_BATT_B2;
	F->storage_full = true;
	th_long();
	zassert_equal(out.last_row, 14);
	TH_EXPECT(A(SCR_MSG_BATTERY_LOW_3S));
}

static void entry_case(enum rc_state from, bool vbus, enum rc_event ev, rc_ms_t tick_ms,
		       uint8_t batt, bool full, enum rc_state want, int want_row)
{
	th_start(from);
	F->vbus = vbus;
	F->batt = batt;
	F->storage_full = full;
	if (tick_ms > 0) {
		rc_actions_clear(&out);
		th_tick_to(TH_T0 + tick_ms, &out);
	} else {
		th_event(ev);
	}
	zassert_equal(rc_core_state(&core), want, "from %d", from);
	zassert_equal(out.last_row, want_row, "from %d", from);
}

ZTEST(rc_round2, test_r1_entry_into_standby_checks_battery_then_storage)
{
	/* rule R-STB: B2 to OFF (row 22), B5 to ERR_BATTERY_LOW (row 21), SFULL to ERR_STORAGE_FULL (row 23), battery first */
	entry_case(RC_ST_TRANSFER, true, RC_EV_VBUS_OUT, 0, RC_BATT_B2, false, RC_ST_OFF, 23);
	entry_case(RC_ST_TRANSFER, true, RC_EV_VBUS_OUT, 0, RC_BATT_B5, true, RC_ST_ERR_BATTERY_LOW, 22);
	entry_case(RC_ST_TRANSFER, true, RC_EV_VBUS_OUT, 0, RC_BATT_OK, true, RC_ST_ERR_STORAGE_FULL, 24);
	entry_case(RC_ST_ERR_STORAGE_FAULT, false, RC_EV_STORAGE_RETRY_OK, 0, RC_BATT_B5, false, RC_ST_ERR_BATTERY_LOW, 22);
	entry_case(RC_ST_ERR_MIC_FAULT, false, RC_EV_TIMER_5S, SPEC_MIC_FAULT_MS, RC_BATT_OK, true, RC_ST_ERR_STORAGE_FULL, 24);
	/* since R16 the B2 row of ERR_CHARGER (67) comes before its VBUS removed row; before R16: row 22 through STANDBY */
	entry_case(RC_ST_ERR_CHARGER, true, RC_EV_VBUS_OUT, 0, RC_BATT_B2, false, RC_ST_OFF, 68);
	/* with good facts the ring stays in STANDBY */
	entry_case(RC_ST_TRANSFER, true, RC_EV_VBUS_OUT, 0, RC_BATT_B15, false, RC_ST_STANDBY, 47);
}

ZTEST(rc_round2, test_r1_entry_actions_are_those_of_the_standby_row)
{
	/* TRANSFER, VBUS removed (row 46), battery at B5: then row 21 (M3) */
	th_start(RC_ST_TRANSFER);
	F->vbus = true;
	F->batt = RC_BATT_B5;
	th_event(RC_EV_VBUS_OUT);
	TH_EXPECT(A(ABORT_COMMAND), A(SD_OFF), A(M3));
}

/* ---- R2: row 40 guard (line 171) ---- */

ZTEST(rc_round2, test_r2_vbus_out_with_sfull_and_b5_gives_battery_low)
{
	th_start(RC_ST_CHARGING);
	F->vbus = true;
	F->storage_full = true;
	F->batt = RC_BATT_B5;
	th_event(RC_EV_VBUS_OUT);
	zassert_equal(out.last_row, 43);
	zassert_equal(rc_core_state(&core), RC_ST_ERR_BATTERY_LOW);
}

/* ---- R3: storage tried again every 60 s (rows 56 to 58) ---- */

ZTEST(rc_round2, test_r3_storage_retried_every_60s_until_success)
{
	th_start(RC_ST_ERR_STORAGE_FAULT);
	for (int k = 1; k <= 3; k++) {
		rc_actions_clear(&out);
		th_tick_to(TH_T0 + k * SPEC_STORAGE_RETRY_MS - 1, &out);
		zassert_equal(out.n, 0, "try %d early", k);
		th_tick_to(TH_T0 + k * SPEC_STORAGE_RETRY_MS, &out);
		TH_EXPECT(A(RETRY_STORAGE));
		zassert_equal(rc_core_next_tick(&core), TH_T0 + (k + 1) * SPEC_STORAGE_RETRY_MS);
		th_event(RC_EV_STORAGE_RETRY_FAILED);
		zassert_equal(out.last_row, 62);
		zassert_equal(rc_core_state(&core), RC_ST_ERR_STORAGE_FAULT);
	}
	th_event(RC_EV_STORAGE_RETRY_OK);
	zassert_equal(rc_core_state(&core), RC_ST_STANDBY);
	zassert_equal(rc_core_next_tick(&core), RC_NO_TICK);
}

/* ---- R4, R5: order at init done (lines 206, 207) ---- */

ZTEST(rc_round2, test_r4_unfinished_recording_with_case_recovery_then_charging)
{
	th_start(RC_ST_BOOT);
	F->open_flag = true;
	F->vbus = true;
	th_event(RC_EV_INIT_DONE);
	zassert_equal(out.last_row, 4);
	zassert_equal(rc_core_state(&core), RC_ST_RECOVERY);
	th_event(RC_EV_SCAN_DONE);
	zassert_equal(out.last_row, 10);
	zassert_equal(rc_core_state(&core), RC_ST_CHARGING);
}

ZTEST(rc_round2, test_r5_init_done_reads_battery_first)
{
	th_start(RC_ST_BOOT);
	F->batt = RC_BATT_B2;
	th_event(RC_EV_INIT_DONE);
	zassert_equal(out.last_row, 7);
	zassert_equal(rc_core_state(&core), RC_ST_OFF);
	TH_EXPECT(A(SHIP_MODE));

	th_start(RC_ST_BOOT);
	F->batt = RC_BATT_B5;
	th_event(RC_EV_INIT_DONE);
	zassert_equal(out.last_row, 8);
	zassert_equal(rc_core_state(&core), RC_ST_ERR_BATTERY_LOW);

	th_start(RC_ST_BOOT);
	F->batt = RC_BATT_B5;
	F->vbus = true;
	th_event(RC_EV_INIT_DONE);
	zassert_equal(out.last_row, 5, "with VBUS present the battery rows do not apply (they need no VBUS)");

	th_start(RC_ST_BOOT);
	F->batt = RC_BATT_B15;
	th_event(RC_EV_INIT_DONE);
	zassert_equal(out.last_row, 3);
}

/* ---- R4b (lead's correction): recovery before battery low; no recording while the open flag is set (lines 145, 206, 207) ---- */

ZTEST(rc_round2, test_r4b_b5_with_open_flag_at_init_done_recovers_first)
{
	th_start(RC_ST_BOOT);
	F->open_flag = true;
	F->batt = RC_BATT_B5;
	th_event(RC_EV_INIT_DONE);
	zassert_equal(out.last_row, 4);
	zassert_equal(rc_core_state(&core), RC_ST_RECOVERY);
	th_event(RC_EV_SCAN_DONE);           /* row 9 into STANDBY, then R-STB: row 21 */
	zassert_equal(out.last_row, 22);
	zassert_equal(rc_core_state(&core), RC_ST_ERR_BATTERY_LOW);
	TH_EXPECT(A(WRITE_CLOSE_RECOVERED), A(CLEAR_OPEN_FLAG), A(SD_OFF), A(M3));
	zassert_false(F->open_flag);
}

ZTEST(rc_round2, test_r4b_b2_with_open_flag_goes_off_without_recovery)
{
	th_start(RC_ST_BOOT);
	F->open_flag = true;
	F->batt = RC_BATT_B2;
	th_event(RC_EV_INIT_DONE);
	zassert_equal(out.last_row, 7);
	zassert_equal(rc_core_state(&core), RC_ST_OFF);
	TH_EXPECT(A(SHIP_MODE));
	zassert_true(F->open_flag, "the flag stays set; the next start-up recovers");
}

ZTEST(rc_round2, test_r4b_long_press_with_open_flag_runs_recovery_first)
{
	th_start(RC_ST_STANDBY);
	F->open_flag = true;
	th_long();
	zassert_equal(out.last_row, 13);
	zassert_equal(rc_core_state(&core), RC_ST_RECOVERY);
	zassert_false(rc_core_mic_rail(&core));
	TH_EXPECT(A(SD_ON), A(MOUNT));
	th_event(RC_EV_SCAN_DONE);
	zassert_equal(rc_core_state(&core), RC_ST_STANDBY);
	th_long();                           /* the wearer presses again */
	zassert_equal(out.last_row, 12);
	zassert_equal(rc_core_state(&core), RC_ST_RECORDING);
}

ZTEST(rc_round2, test_r4b_failed_write_then_case_then_long_press_never_records_over_it)
{
	/* the lead's path: a write fails (open flag left set), charge, leave the case, long press */
	th_start(RC_ST_STANDBY);
	th_long();
	zassert_equal(rc_core_state(&core), RC_ST_RECORDING);
	zassert_true(F->open_flag);
	th_event(RC_EV_CHUNK_WRITE_FAILED);
	zassert_equal(rc_core_state(&core), RC_ST_ERR_STORAGE_FAULT);
	th_event(RC_EV_VBUS_IN);
	th_event(RC_EV_VBUS_OUT);
	/* since R11 the storage fault survives the case: back to ERR_STORAGE_FAULT through row 24 */
	zassert_equal(out.last_row, 25);
	zassert_equal(rc_core_state(&core), RC_ST_ERR_STORAGE_FAULT);
	zassert_true(F->open_flag);
	th_long();                           /* ignored in ERR_STORAGE_FAULT */
	zassert_false(th_has(&out, RC_ACT_OPEN));
	th_event(RC_EV_STORAGE_RETRY_OK);    /* R9: with the flag set, to RECOVERY (row 59) */
	zassert_equal(out.last_row, 60);
	zassert_equal(rc_core_state(&core), RC_ST_RECOVERY);
	zassert_true(F->open_flag);
	th_event(RC_EV_SCAN_DONE);
	zassert_false(F->open_flag);
	zassert_equal(rc_core_state(&core), RC_ST_STANDBY);
}

/* ---- R6 is test_r6_row17_screen_on_centre_action_then_mt in test_rows.c ---- */

/* ---- R7: a centre hold is cancelled by any change of state (line 257) ---- */

ZTEST(rc_round2, test_r7_hold_begun_in_charging_never_starts)
{
	th_start(RC_ST_CHARGING);
	F->vbus = true;
	rc_actions_clear(&out);
	th_sw(RC_SW_CENTRE, true, TH_T0, &out);
	th_tick_to(TH_T0 + 600, &out);
	th_event(RC_EV_VBUS_OUT);              /* out of the case, thumb still on the nub */
	zassert_equal(rc_core_state(&core), RC_ST_STANDBY);
	rc_actions_clear(&out);
	th_tick_to(TH_T0 + 5000, &out);
	zassert_equal(rc_core_state(&core), RC_ST_STANDBY);
	zassert_equal(out.n, 0, "no MW, no start");
	th_sw(RC_SW_CENTRE, false, TH_T0 + 5000, &out);
	th_tick_to(TH_T0 + 8000, &out);
	zassert_equal(out.n, 0, "the release of a cancelled hold gives nothing");
	th_long();                             /* release and press again: starts */
	zassert_equal(rc_core_state(&core), RC_ST_RECORDING);
}

ZTEST(rc_round2, test_r7_hold_cancelled_by_change_of_state_in_standby)
{
	/* hold begun in STANDBY, case inserted and removed before the mark */
	th_start(RC_ST_STANDBY);
	rc_actions_clear(&out);
	th_sw(RC_SW_CENTRE, true, TH_T0, &out);
	th_tick_to(TH_T0 + 300, &out);
	th_event(RC_EV_VBUS_IN);
	th_event(RC_EV_VBUS_OUT);
	rc_actions_clear(&out);
	th_tick_to(TH_T0 + 3000, &out);
	zassert_equal(rc_core_state(&core), RC_ST_STANDBY);
	zassert_false(th_has(&out, RC_ACT_OPEN));
	zassert_false(th_has(&out, RC_ACT_MW));
}

ZTEST(rc_round2, test_r7_no_change_of_state_keeps_the_hold)
{
	/* a self row (B15 in STANDBY) is not a change of state: the long press still starts */
	th_start(RC_ST_STANDBY);
	rc_actions_clear(&out);
	th_sw(RC_SW_CENTRE, true, TH_T0, &out);
	th_tick_to(TH_T0 + 300, &out);
	th_batt(RC_BATT_B15);
	rc_actions_clear(&out);
	th_tick_to(TH_T0 + 1000, &out);
	zassert_equal(rc_core_state(&core), RC_ST_RECORDING);
}

/* ---- R8: charge on at every appearance of VBUS, every state (line 204) ---- */

ZTEST(rc_round2, test_r8_charge_on_at_every_vbus_appearance)
{
	for (int s = 0; s < RC_ST_COUNT; s++) {
		int n = 0;

		th_start((enum rc_state)s);
		th_event(RC_EV_VBUS_IN);
		for (uint8_t i = 0; i < out.n; i++) {
			n += out.a[i] == RC_ACT_CHARGE_ON;
		}
		zassert_equal(n, 1, "state %d", s);
	}
	th_start(RC_ST_BOOT);
	th_event(RC_EV_VBUS_IN);
	zassert_equal(rc_core_state(&core), RC_ST_BOOT);
	TH_EXPECT(A(CHARGE_ON));
	th_start(RC_ST_RECOVERY);
	th_event(RC_EV_VBUS_IN);
	zassert_equal(rc_core_state(&core), RC_ST_RECOVERY);
	TH_EXPECT(A(CHARGE_ON));
}

/* ---- C1: the battery fact goes down as well as up ---- */

ZTEST(rc_round2, test_code_c1_battery_fact_both_directions)
{
	th_start(RC_ST_ERR_BATTERY_LOW);
	F->batt = RC_BATT_B5;
	F->vbus = false;
	th_event(RC_EV_VBUS_IN);
	zassert_equal(rc_core_state(&core), RC_ST_CHARGING);
	th_batt(RC_BATT_B15);                  /* charging: level rises, no row */
	zassert_equal(out.n, 0);
	th_batt(RC_BATT_OK);
	zassert_equal(out.n, 0);
	zassert_equal(F->batt, RC_BATT_OK);
	th_event(RC_EV_VBUS_OUT);
	zassert_equal(out.last_row, 40, "above B5 after the charge: STANDBY");
	zassert_equal(rc_core_state(&core), RC_ST_STANDBY);
	th_batt(RC_BATT_B5);                   /* falling again: the row runs */
	zassert_equal(out.last_row, 22);
}

ZTEST(rc_round2, test_code_c1_battery_events_refused_from_event_entry)
{
	th_start(RC_ST_STANDBY);
	th_event(RC_EV_BATT_B5);
	zassert_equal(out.n, 0);
	zassert_equal(rc_core_state(&core), RC_ST_STANDBY);
	zassert_equal(F->batt, RC_BATT_OK);
}

/* ---- C2: row 3's guard, negative side ---- */

ZTEST(rc_round2, test_code_c2_row3_guard_refuses_b5)
{
	struct rc_sm sm;
	struct rc_facts f = { 0 };

	rc_sm_init(&sm, RC_ST_BOOT);
	f.batt = RC_BATT_B5;
	zassert_is_null(rc_sm_find(&sm, RC_EV_INIT_DONE, &f));
	f.batt = RC_BATT_B2;
	zassert_is_null(rc_sm_find(&sm, RC_EV_INIT_DONE, &f));
	f.batt = RC_BATT_B15;
	zassert_equal(rc_sm_find(&sm, RC_EV_INIT_DONE, &f)->row, 3);
}

/* ---- C3: re-arm of the once flags, timers refused ---- */

ZTEST(rc_round2, test_code_c3_b15_rearmed_by_vbus)
{
	th_start(RC_ST_STANDBY);
	th_batt(RC_BATT_B15);
	zassert_true(th_has(&out, RC_ACT_M3));
	th_event(RC_EV_VBUS_IN);
	th_batt(RC_BATT_OK);
	th_event(RC_EV_VBUS_OUT);
	zassert_equal(rc_core_state(&core), RC_ST_STANDBY);
	th_batt(RC_BATT_B15);
	zassert_equal(out.last_row, 21);
	zassert_true(th_has(&out, RC_ACT_M3), "a new discharge warns again");
}

ZTEST(rc_round2, test_code_c3_s30_rearmed_by_new_recording)
{
	th_start(RC_ST_STANDBY);
	th_long();
	th_event(RC_EV_STORAGE_S30);
	zassert_true(th_has(&out, RC_ACT_M3));
	th_now += 3000;
	th_long();
	zassert_equal(rc_core_state(&core), RC_ST_STANDBY);
	th_now += 3000;
	th_long();
	zassert_equal(rc_core_state(&core), RC_ST_RECORDING);
	th_event(RC_EV_STORAGE_S30);
	zassert_true(th_has(&out, RC_ACT_M3), "a new recording warns again");
}

ZTEST(rc_round2, test_code_c3_timers_refused_from_event_entry)
{
	th_start(RC_ST_ERR_MIC_FAULT);
	th_event(RC_EV_TIMER_5S);
	zassert_equal(rc_core_state(&core), RC_ST_ERR_MIC_FAULT);
	zassert_equal(out.n, 0);
	th_start(RC_ST_ERR_STORAGE_FAULT);
	th_event(RC_EV_TIMER_60S);
	zassert_equal(out.n, 0);
}

/* ---- C6: m23 cannot change behaviour (no row lists MW, so the row filter never sees it) ---- */

ZTEST(rc_round2, test_code_c6_no_row_action_is_mw)
{
	for (int i = 0; i < rc_table_rows; i++) {
		for (int m = 0; m < 4; m++) {
			struct rc_sm sm;
			struct rc_facts f = { 0 };

			f.vibration_on = true;
			f.screen_on = m & 1;
			f.open_flag = (m >> 1) & 1;
			rc_sm_init(&sm, (enum rc_state)rc_table[i].from);
			rc_actions_clear(&out);
			rc_row_actions(&sm, rc_table[i].row, &f, &out);
			zassert_false(th_has(&out, RC_ACT_MW), "row %d", rc_table[i].row);
		}
	}
}

ZTEST_SUITE(rc_round2, NULL, NULL, NULL, NULL, NULL);
```

## src/test_round3.c
```c
/*
 * Round 3: tests named after rulings R9 to R14 and C7 of firmware/docs/core-delta-2.md,
 * as written into design/firmware.md sections 1 and 2.
 */
#include "th.h"

#define F (rc_core_facts(&core))
#define A(x) RC_ACT_##x

/* ---- R9: only a close and "scan done" clear the open flag ---- */

ZTEST(rc_round3, test_r9_recovery_request_keeps_open_flag)
{
	th_start(RC_ST_ERR_STORAGE_FAULT);
	F->open_flag = true;
	th_event(RC_EV_STORAGE_RETRY_OK);
	zassert_equal(out.last_row, 60);
	zassert_equal(rc_core_state(&core), RC_ST_RECOVERY);
	TH_EXPECT(A(SD_ON));
	zassert_true(F->open_flag, "asking for recovery clears nothing");
	th_event(RC_EV_SCAN_READ_ERROR);      /* row 11, flag still set */
	zassert_equal(rc_core_state(&core), RC_ST_ERR_STORAGE_FAULT);
	zassert_true(F->open_flag);
	th_event(RC_EV_STORAGE_RETRY_OK);
	zassert_equal(rc_core_state(&core), RC_ST_RECOVERY);
	th_event(RC_EV_SCAN_DONE);            /* row 9: clear open flag */
	zassert_false(F->open_flag);
	zassert_equal(rc_core_state(&core), RC_ST_STANDBY);
}

ZTEST(rc_round3, test_r9_long_press_recovery_keeps_flag_until_scan_done)
{
	th_start(RC_ST_STANDBY);
	F->open_flag = true;
	th_long();                            /* row 13 */
	zassert_equal(rc_core_state(&core), RC_ST_RECOVERY);
	zassert_true(F->open_flag);
	th_event(RC_EV_SCAN_DONE);
	zassert_false(F->open_flag);
}

ZTEST(rc_round3, test_r9_retry_with_flag_clear_goes_to_standby)
{
	th_start(RC_ST_ERR_STORAGE_FAULT);
	th_event(RC_EV_STORAGE_RETRY_OK);
	zassert_equal(out.last_row, 61);
	zassert_equal(rc_core_state(&core), RC_ST_STANDBY);
}

/* ---- R10: leaving the case at B2 switches the ring off ---- */

ZTEST(rc_round3, test_r10_leaving_case_at_b2_switches_off)
{
	th_start(RC_ST_CHARGING);
	F->vbus = true;
	F->batt = RC_BATT_B2;
	th_event(RC_EV_VBUS_OUT);
	zassert_equal(out.last_row, 42);
	zassert_equal(rc_core_state(&core), RC_ST_OFF);
	TH_EXPECT(A(SAVE_SETTINGS_TIME), A(SHIP_MODE));
	/* TRANSFER at B2: into STANDBY, then R-STB B2 first (row 22) */
	th_start(RC_ST_TRANSFER);
	F->vbus = true;
	F->batt = RC_BATT_B2;
	F->storage_full = true;
	th_event(RC_EV_VBUS_OUT);
	zassert_equal(out.last_row, 23);
	zassert_equal(rc_core_state(&core), RC_ST_OFF);
}

/* ---- R11: the storage fault is a fact; leaving the case does not hide it ---- */

ZTEST(rc_round3, test_r11_storage_fault_survives_the_case)
{
	th_start(RC_ST_STANDBY);
	th_long();
	th_event(RC_EV_CHUNK_WRITE_FAILED);
	zassert_true(F->storage_fault);
	th_event(RC_EV_VBUS_IN);
	zassert_equal(rc_core_state(&core), RC_ST_CHARGING);
	th_event(RC_EV_VBUS_OUT);
	zassert_equal(out.last_row, 25);
	zassert_equal(rc_core_state(&core), RC_ST_ERR_STORAGE_FAULT);
	zassert_equal(rc_core_next_tick(&core), th_now + SPEC_STORAGE_RETRY_MS, "back to the 60 s retry");
}

ZTEST(rc_round3, test_r11_fault_cleared_only_by_successful_init)
{
	th_start(RC_ST_ERR_STORAGE_FAULT);
	zassert_true(F->storage_fault);
	th_event(RC_EV_STORAGE_RETRY_FAILED);
	zassert_true(F->storage_fault);
	th_event(RC_EV_STORAGE_RETRY_OK);
	zassert_false(F->storage_fault);
	zassert_equal(rc_core_state(&core), RC_ST_STANDBY);
	th_start(RC_ST_BOOT);
	F->storage_fault = true;
	th_event(RC_EV_INIT_DONE);
	zassert_false(F->storage_fault);
	zassert_equal(rc_core_state(&core), RC_ST_STANDBY);
}

ZTEST(rc_round3, test_r15a_b2_checked_before_the_storage_fault)
{
	/* ruling R15, path (a): R-STB checks B2 (no VBUS) before the storage fault */
	th_start(RC_ST_ERR_MIC_FAULT);
	F->storage_fault = true;
	F->batt = RC_BATT_B2;
	rc_actions_clear(&out);
	th_tick_to(TH_T0 + SPEC_MIC_FAULT_MS, &out);
	zassert_equal(out.last_row, 23);
	zassert_equal(rc_core_state(&core), RC_ST_OFF);
}

/* ---- R12: battery events in BOOT are kept until "init done" ---- */

ZTEST(rc_round3, test_r12_b5_in_boot_kept_then_recovery_first)
{
	th_start(RC_ST_BOOT);
	F->open_flag = true;
	th_batt(RC_BATT_B5);
	zassert_equal(out.n, 0);
	zassert_equal(rc_core_state(&core), RC_ST_BOOT);
	zassert_equal(F->batt, RC_BATT_B5);
	th_event(RC_EV_INIT_DONE);
	zassert_equal(out.last_row, 4);
	zassert_equal(rc_core_state(&core), RC_ST_RECOVERY);
}

ZTEST(rc_round3, test_r12_b2_in_boot_kept_then_off)
{
	th_start(RC_ST_BOOT);
	th_batt(RC_BATT_B2);
	zassert_equal(out.n, 0);
	th_event(RC_EV_INIT_DONE);
	zassert_equal(out.last_row, 7);
	zassert_equal(rc_core_state(&core), RC_ST_OFF);
	/* ruling R15, path (b): the storage init fails instead: OFF through row 62 */
	th_start(RC_ST_BOOT);
	th_batt(RC_BATT_B2);
	th_event(RC_EV_STORAGE_INIT_FAILED);
	zassert_equal(out.last_row, 63);
	zassert_equal(rc_core_state(&core), RC_ST_OFF);
}

/* ---- R13: row 8 turns VDD_SD off ---- */

ZTEST(rc_round3, test_r13_row8_turns_sd_off)
{
	th_start(RC_ST_BOOT);
	F->batt = RC_BATT_B5;
	th_event(RC_EV_INIT_DONE);
	zassert_equal(out.last_row, 8);
	TH_EXPECT(A(SD_OFF), A(M3));
}

/* ---- R14: at most one storage retry per call of the tick ---- */

ZTEST(rc_round3, test_r14_one_retry_per_tick_whatever_the_delay)
{
	int n = 0;

	th_start(RC_ST_ERR_STORAGE_FAULT);
	rc_actions_clear(&out);
	rc_core_tick(&core, TH_T0 + 600000, &out);   /* 10 minutes late, one call */
	for (uint8_t i = 0; i < out.n; i++) {
		n += out.a[i] == RC_ACT_RETRY_STORAGE;
	}
	zassert_equal(n, 1);
	zassert_equal(rc_core_next_tick(&core), TH_T0 + 600000 + SPEC_STORAGE_RETRY_MS);
}

/* ---- C7: the review's surviving mutations m31, m35, m40 (m21 is the R9 tests) ---- */

ZTEST(rc_round3, test_code_c7_repeated_battery_level_does_nothing)
{
	th_start(RC_ST_STANDBY);
	th_batt(RC_BATT_B15);
	zassert_equal(out.last_row, 21);
	th_batt(RC_BATT_B15);
	zassert_equal(out.n, 0);
	zassert_equal(out.last_row, -1);
}

ZTEST(rc_round3, test_code_c7_invalid_battery_level_refused)
{
	th_start(RC_ST_STANDBY);
	th_batt((enum rc_batt)7);
	zassert_equal(out.n, 0);
	zassert_equal(F->batt, RC_BATT_OK);
	zassert_equal(rc_core_state(&core), RC_ST_STANDBY);
}

ZTEST(rc_round3, test_code_c7_sfull_event_sets_the_fact)
{
	th_start(RC_ST_STANDBY);
	th_event(RC_EV_STORAGE_SFULL);
	zassert_true(F->storage_full);
	th_event(RC_EV_VBUS_IN);
	th_event(RC_EV_VBUS_OUT);
	zassert_equal(rc_core_state(&core), RC_ST_ERR_STORAGE_FULL, "the case does not hide full storage");
}

ZTEST(rc_round3, test_r15b_failed_storage_init_with_b2_kept_goes_off)
{
	/* ruling R15, path (b), as its own test */
	th_start(RC_ST_BOOT);
	th_batt(RC_BATT_B2);
	zassert_equal(rc_core_state(&core), RC_ST_BOOT);
	th_event(RC_EV_STORAGE_INIT_FAILED);
	zassert_equal(out.last_row, 63);
	zassert_equal(rc_core_state(&core), RC_ST_OFF);
	TH_EXPECT(A(LOG_EVENT), A(MF), A(SHIP_MODE));
}

ZTEST(rc_round3, test_r15_walk_every_entry_with_b2_kept_ends_off)
{
	/* Every row of the table from another state into STANDBY or an error state, given through
	 * the real entry points with the battery fact at B2 and no VBUS after the event, ends in OFF.
	 * Rows whose guard cannot hold at B2 (above B5, or a B5 row that a B2 row precedes) and rows
	 * whose event is a battery event (it sets the level itself) or internal are skipped and counted. */
	static const uint8_t targets[] = {
		RC_ST_STANDBY, RC_ST_ERR_STORAGE_FAULT, RC_ST_ERR_STORAGE_FULL,
		RC_ST_ERR_BATTERY_LOW, RC_ST_ERR_MIC_FAULT, RC_ST_ERR_CHARGER,
	};
	int walked[RC_ST_COUNT] = { 0 };
	int total = 0;

	for (int i = 0; i < rc_table_rows; i++) {
		const struct rc_row *r = &rc_table[i];
		bool target = false;
		int ev = r->event;

		for (unsigned k = 0; k < sizeof(targets); k++) {
			target |= r->to == targets[k];
		}
		if (!target || r->to == r->from || ev == RC_EV_BATT_B15 || ev == RC_EV_BATT_B5 ||
		    ev == RC_EV_BATT_B2 || ev == RC_EV_STORAGE_FAULT_SET) {
			continue;
		}
		/* find facts under which this row is the one taken at B2 */
		bool found = false;
		int m;

		for (m = 0; m < 16 && !found; m++) {
			struct rc_sm sm;
			struct rc_facts f = { 0 };

			rc_sm_init(&sm, (enum rc_state)r->from);
			f.batt = RC_BATT_B2;
			f.vbus = (ev == RC_EV_VBUS_OUT) || (m & 8);
			f.open_flag = m & 1;
			f.storage_full = (m >> 1) & 1;
			f.factory_flag = (m >> 2) & 1;
			const struct rc_row *hit = rc_sm_find(&sm, (enum rc_event)ev, &f);

			found = hit != NULL && hit->row == r->row && !(f.vbus && ev != RC_EV_VBUS_OUT && ev != RC_EV_VBUS_IN);
		}
		if (!found) {
			continue;
		}
		m--;
		th_start((enum rc_state)r->from);
		F->batt = RC_BATT_B2;
		F->vbus = (ev == RC_EV_VBUS_OUT);
		F->open_flag = m & 1;
		F->storage_full = (m >> 1) & 1;
		F->factory_flag = (m >> 2) & 1;
		rc_actions_clear(&out);
		if (ev == RC_EV_LONG_PRESS) {
			th_long();
		} else if (ev == RC_EV_TIMER_5S) {
			th_tick_to(TH_T0 + SPEC_MIC_FAULT_MS, &out);
		} else if (ev == RC_EV_TIMER_60S) {
			th_tick_to(TH_T0 + SPEC_STORAGE_RETRY_MS, &out);
		} else {
			th_event((enum rc_event)ev);
		}
		zassert_equal(rc_core_state(&core), RC_ST_OFF, "row %d", r->row);
		zassert_true(th_has(&out, RC_ACT_SHIP_MODE), "row %d", r->row);
		walked[r->to]++;
		total++;
	}
	/* every target state is entered at least once at B2, except ERR_BATTERY_LOW: every row into it
	 * is a B5 row (battery event, or "VBUS removed, battery at B5", which the B2 row 41 precedes) */
	zassert_true(walked[RC_ST_STANDBY] > 0);
	zassert_true(walked[RC_ST_ERR_STORAGE_FAULT] > 0);
	zassert_true(walked[RC_ST_ERR_STORAGE_FULL] > 0);
	zassert_true(walked[RC_ST_ERR_MIC_FAULT] > 0);
	zassert_true(walked[RC_ST_ERR_CHARGER] > 0);
	zassert_equal(walked[RC_ST_ERR_BATTERY_LOW], 0);
	zassert_true(total >= 10, "walked %d rows", total);
}

ZTEST(rc_round3, test_r15_with_vbus_b2_does_not_switch_off)
{
	/* "with no VBUS": a fault entry while VBUS is present stays awake */
	th_start(RC_ST_CHARGING);
	F->vbus = true;
	F->batt = RC_BATT_B2;
	th_event(RC_EV_CHARGE_ERROR);
	zassert_equal(rc_core_state(&core), RC_ST_ERR_CHARGER);
	th_event(RC_EV_VBUS_OUT);            /* then leaving the case: STANDBY, R-STB B2: OFF */
	zassert_equal(rc_core_state(&core), RC_ST_OFF);
}

ZTEST_SUITE(rc_round3, NULL, NULL, NULL, NULL, NULL);
```

## src/test_round4.c
```c
/*
 * Round 4: ruling R16 (the B2 check also runs whenever VBUS is removed) and C10 (events the
 * core makes for itself are refused from outside), firmware/docs/core-delta-2.md "Round 4".
 */
#include "th.h"

#define F (rc_core_facts(&core))
#define A(x) RC_ACT_##x

ZTEST(rc_round4, test_r16_storage_fault_entered_in_case_then_vbus_out_goes_off)
{
	/* the reviewer's path D1: BOOT in the case at B2, storage init fails, VBUS removed */
	th_start(RC_ST_BOOT);
	F->vbus = true;
	th_batt(RC_BATT_B2);
	th_event(RC_EV_STORAGE_INIT_FAILED);
	zassert_equal(rc_core_state(&core), RC_ST_ERR_STORAGE_FAULT, "VBUS present: awake");
	th_event(RC_EV_VBUS_OUT);
	zassert_equal(out.last_row, 63);
	zassert_equal(rc_core_state(&core), RC_ST_OFF);
	TH_EXPECT(A(SHIP_MODE));
}

ZTEST(rc_round4, test_r16_recovery_read_error_in_case_then_vbus_out_goes_off)
{
	th_start(RC_ST_RECOVERY);
	F->vbus = true;
	F->batt = RC_BATT_B2;
	th_event(RC_EV_SCAN_READ_ERROR);
	zassert_equal(rc_core_state(&core), RC_ST_ERR_STORAGE_FAULT);
	th_event(RC_EV_VBUS_OUT);
	zassert_equal(rc_core_state(&core), RC_ST_OFF);
}

ZTEST(rc_round4, test_r16_b2_row_comes_before_the_vbus_removed_row)
{
	/* ERR_CHARGER has its own "VBUS removed" row (to STANDBY); at B2 its B2 row (67) comes first */
	th_start(RC_ST_ERR_CHARGER);
	F->vbus = true;
	F->batt = RC_BATT_B2;
	th_event(RC_EV_VBUS_OUT);
	zassert_equal(out.last_row, 68);
	TH_EXPECT(A(SAVE_SETTINGS_TIME), A(SHIP_MODE));
}

ZTEST(rc_round4, test_r16_walk_every_state_vbus_present_b2_then_vbus_out_ends_off)
{
	/* Every state, started with VBUS present and the battery fact at B2, then VBUS removed.
	 * RECOVERY ends OFF at the end of its scan, BOOT at "init done" (R4b, R12). SHIP stays SHIP:
	 * the factory ship mode, entered with VBUS, completes on VBUS removal (FW 8.4). */
	for (int s = 0; s < RC_ST_COUNT; s++) {
		th_start((enum rc_state)s);
		F->vbus = true;
		F->batt = RC_BATT_B2;
		F->factory_flag = (s == RC_ST_FACTORY_TEST);
		th_event(RC_EV_VBUS_OUT);
		if (rc_core_state(&core) == RC_ST_RECOVERY) {
			th_event(RC_EV_SCAN_DONE);
		}
		if (rc_core_state(&core) == RC_ST_BOOT) {
			th_event(RC_EV_INIT_DONE);
		}
		if (s == RC_ST_SHIP) {
			zassert_equal(rc_core_state(&core), RC_ST_SHIP);
			continue;
		}
		zassert_equal(rc_core_state(&core), RC_ST_OFF, "state %d", s);
		zassert_false(F->vbus);
	}
}

ZTEST(rc_round4, test_r16_above_b2_vbus_out_keeps_the_state_row)
{
	th_start(RC_ST_ERR_CHARGER);
	F->vbus = true;
	F->batt = RC_BATT_B15;
	th_event(RC_EV_VBUS_OUT);
	zassert_equal(out.last_row, 67);
	zassert_equal(rc_core_state(&core), RC_ST_STANDBY);
}

ZTEST(rc_round4, test_r16_sequences_never_awake_at_b2_without_vbus)
{
	/* Every state, started in the case (VBUS present) at B2, with every combination of the open
	 * flag, storage full and storage fault, then every sequence of three steps out of the outside
	 * events and a 70 s tick. After each step with no VBUS the ring must be OFF or SHIP, or in
	 * BOOT or RECOVERY, which end at B2 in OFF at "init done" or "scan done" (R4b, R15). */
	static const uint8_t evs[] = {
		RC_EV_VBUS_IN, RC_EV_VBUS_OUT, RC_EV_INIT_DONE, RC_EV_STORAGE_INIT_FAILED,
		RC_EV_SCAN_DONE, RC_EV_SCAN_READ_ERROR, RC_EV_MENU_POWER_OFF, RC_EV_STORAGE_SFULL,
		RC_EV_STORAGE_S30, RC_EV_BLE_HIGHLIGHT, RC_EV_CHUNK_WRITE_FAILED, RC_EV_MIC_NO_BLOCK,
		RC_EV_POWER_LOSS, RC_EV_USB_CONFIGURED, RC_EV_USB_UNCONFIGURED, RC_EV_CHARGE_ERROR,
		RC_EV_FW_END, RC_EV_FACTORY_ENTER, RC_EV_FACTORY_EXIT, RC_EV_SHIP_ENTER,
		RC_EV_SHIP_SAMPLE, RC_EV_STORAGE_RETRY_OK, RC_EV_STORAGE_RETRY_FAILED, 0xff,
	};
	const int ne = sizeof(evs);
	long runs = 0;

	for (int s = 0; s < RC_ST_COUNT; s++) {
		for (int m = 0; m < 8; m++) {
			for (int a = 0; a < ne; a++) {
				for (int b = 0; b < ne; b++) {
					for (int c = 0; c < ne; c++) {
						const uint8_t seq[3] = { evs[a], evs[b], evs[c] };

						th_start((enum rc_state)s);
						F->vbus = true;
						F->batt = RC_BATT_B2;
						F->open_flag = m & 1;
						F->storage_full = (m >> 1) & 1;
						F->storage_fault = (m >> 2) & 1;
						F->factory_flag = true;
						for (int k = 0; k < 3; k++) {
							rc_actions_clear(&out);
							if (seq[k] == 0xff) {
								th_now += 70000;
								rc_core_tick(&core, th_now, &out);
							} else {
								th_event((enum rc_event)seq[k]);
							}
							if (!F->vbus) {
								enum rc_state st = rc_core_state(&core);

								zassert_true(st == RC_ST_OFF || st == RC_ST_SHIP ||
									     st == RC_ST_BOOT || st == RC_ST_RECOVERY,
									     "awake at B2 without VBUS: start %d facts %d seq %d %d %d step %d state %d",
									     s, m, seq[0], seq[1], seq[2], k, st);
							}
						}
						runs++;
					}
				}
			}
		}
	}
	zassert_equal(runs, (long)RC_ST_COUNT * 8 * ne * ne * ne);
}

ZTEST(rc_round4, test_t1_r16_does_not_fire_at_b5)
{
	/* R16 is for B2 only: a ring in ERR_STORAGE_FAULT in its case at B5, taken out, stays there */
	th_start(RC_ST_ERR_STORAGE_FAULT);
	F->vbus = true;
	F->batt = RC_BATT_B5;
	th_event(RC_EV_VBUS_OUT);
	zassert_equal(rc_core_state(&core), RC_ST_ERR_STORAGE_FAULT);
	zassert_equal(out.last_row, -1);
	zassert_false(th_has(&out, RC_ACT_SHIP_MODE));
}

ZTEST(rc_round4, test_t2_r16_boot_vbus_out_at_b2_takes_row_7_before_init_done)
{
	/* BOOT leg of R16 (confirmed reading): VBUS removed in BOOT at B2 takes row 7 at once */
	th_start(RC_ST_BOOT);
	F->vbus = true;
	th_batt(RC_BATT_B2);                 /* kept in BOOT (R12) */
	zassert_equal(rc_core_state(&core), RC_ST_BOOT);
	th_event(RC_EV_VBUS_OUT);
	zassert_equal(out.last_row, 7);
	zassert_equal(rc_core_state(&core), RC_ST_OFF);
	TH_EXPECT(A(SHIP_MODE));
}

/* ---- C10: one test per event the core makes for itself ---- */

static void refused(enum rc_state st, enum rc_event ev)
{
	th_start(st);
	F->open_flag = false;
	th_event(ev);
	zassert_equal(out.n, 0, "event %d", ev);
	zassert_equal(out.last_row, -1, "event %d", ev);
	zassert_equal(rc_core_state(&core), st, "event %d", ev);
}

ZTEST(rc_round4, test_c10_refuses_storage_fault_set) { refused(RC_ST_STANDBY, RC_EV_STORAGE_FAULT_SET); }
ZTEST(rc_round4, test_c10_refuses_timer_5s) { refused(RC_ST_ERR_MIC_FAULT, RC_EV_TIMER_5S); }
ZTEST(rc_round4, test_c10_refuses_timer_60s) { refused(RC_ST_ERR_STORAGE_FAULT, RC_EV_TIMER_60S); }
ZTEST(rc_round4, test_c10_refuses_long_press) { refused(RC_ST_STANDBY, RC_EV_LONG_PRESS); }
ZTEST(rc_round4, test_c10_refuses_short_press) { refused(RC_ST_STANDBY, RC_EV_SHORT_PRESS); }
ZTEST(rc_round4, test_c10_refuses_double_press) { refused(RC_ST_STANDBY, RC_EV_DOUBLE_PRESS); }

ZTEST_SUITE(rc_round4, NULL, NULL, NULL, NULL, NULL);
```

## src/th.c
```c
#include <string.h>
#include "th.h"

struct rc_core core;
struct rc_actions out;
struct rc_actions rest;
rc_ms_t th_now;
struct rc_gesture gg;
struct rc_gev_list gl;

void th_start_src(enum rc_state st, enum rc_centre_source src)
{
	th_now = TH_T0;
	rc_core_init(&core, src, st, th_now);
	rc_actions_clear(&out);
	rc_actions_clear(&rest);
}

void th_start(enum rc_state st)
{
	th_start_src(st, RC_CENTRE_SW2);
}

void th_event(enum rc_event ev)
{
	rc_actions_clear(&out);
	rc_core_event(&core, ev, th_now, &out);
}

void th_batt(enum rc_batt level)
{
	rc_actions_clear(&out);
	rc_core_battery(&core, level, th_now, &out);
}

void th_tick_to(rc_ms_t t, struct rc_actions *o)
{
	for (int i = 0; i < 1000; i++) {
		rc_ms_t n = rc_core_next_tick(&core);

		if (n > t) {
			break;
		}
		rc_core_tick(&core, n, o);
	}
	rc_core_tick(&core, t, o);
	th_now = t;
}

void th_sw(enum rc_switch sw, bool pressed, rc_ms_t t, struct rc_actions *o)
{
	th_tick_to(t, o);
	rc_core_input(&core, sw, pressed, t, o);
	th_now = t;
}

void th_long(void)
{
	rc_ms_t t0 = th_now;

	rc_actions_clear(&rest);
	th_sw(RC_SW_CENTRE, true, t0, &rest);
	th_tick_to(t0 + SPEC_LONG_MS - 1, &rest);
	zassert_equal(rest.last_row, -1, "no row before the 1,000 ms mark");
	rc_actions_clear(&out);
	th_tick_to(t0 + SPEC_LONG_MS, &out);
	rc_actions_clear(&rest);
	th_sw(RC_SW_CENTRE, false, t0 + 1200, &rest);
	th_tick_to(t0 + 3000, &rest);
	zassert_equal(rest.n, 0, "the release after a long press does nothing");
}

void th_short(void)
{
	rc_ms_t t0 = th_now;

	rc_actions_clear(&rest);
	th_sw(RC_SW_CENTRE, true, t0, &rest);
	th_sw(RC_SW_CENTRE, false, t0 + 100, &rest);
	th_tick_to(t0 + 100 + SPEC_DOUBLE_WINDOW_MS, &rest);
	zassert_equal(rest.last_row, -1, "no row while the window is open");
	rc_actions_clear(&out);
	th_tick_to(t0 + 100 + SPEC_DOUBLE_WINDOW_MS + 1, &out);
}

void th_double(void)
{
	rc_ms_t t0 = th_now;

	rc_actions_clear(&rest);
	th_sw(RC_SW_CENTRE, true, t0, &rest);
	th_sw(RC_SW_CENTRE, false, t0 + 100, &rest);
	th_sw(RC_SW_CENTRE, true, t0 + 200, &rest);
	rc_actions_clear(&out);
	th_sw(RC_SW_CENTRE, false, t0 + 300, &out);
	th_tick_to(t0 + 300 + SPEC_RELEASE_HOLDOFF_MS, &out);
	rc_actions_clear(&rest);
	th_tick_to(t0 + 3000, &rest);
}

void th_expect(const struct rc_actions *o, const uint8_t *exp, size_t n)
{
	zassert_equal(o->n, n, "action count");
	for (size_t i = 0; i < n && i < o->n; i++) {
		zassert_equal(o->a[i], exp[i], "action %u", (unsigned)i);
	}
}

bool th_has(const struct rc_actions *o, enum rc_action a)
{
	for (uint8_t i = 0; i < o->n; i++) {
		if (o->a[i] == a) {
			return true;
		}
	}
	return false;
}

void tg_start(enum rc_centre_source src)
{
	rc_gesture_init(&gg, src);
	memset(&gl, 0, sizeof(gl));
}

void tg_in(enum rc_switch sw, bool pressed, rc_ms_t t)
{
	rc_gesture_input(&gg, sw, pressed, t, &gl);
}

void tg_tick(rc_ms_t t)
{
	for (int i = 0; i < 1000; i++) {
		rc_ms_t n = rc_gesture_next_tick(&gg);

		if (n > t) {
			break;
		}
		rc_gesture_tick(&gg, n, &gl);
	}
	rc_gesture_tick(&gg, t, &gl);
}

int tg_count(enum rc_gev_type type)
{
	int c = 0;

	for (uint8_t i = 0; i < gl.n; i++) {
		if (gl.e[i].type == type) {
			c++;
		}
	}
	return c;
}

const struct rc_gev *tg_find(enum rc_gev_type type, int nth)
{
	for (uint8_t i = 0; i < gl.n; i++) {
		if (gl.e[i].type == type && nth-- == 0) {
			return &gl.e[i];
		}
	}
	return NULL;
}

const struct rc_gev *tg_get(enum rc_gev_type type, int nth)
{
	static const struct rc_gev none = { .type = 0xff, .dir = 0xff, .t = -1, .t_down = -1 };
	const struct rc_gev *e = tg_find(type, nth);

	zassert_not_null(e, "gesture event %d number %d is missing", (int)type, nth);
	return e ? e : &none;
}

void tg_centre(rc_ms_t t0, rc_ms_t dur)
{
	if (gg.src == RC_CENTRE_SW2) {
		tg_in(RC_SW_CENTRE, true, t0);
		tg_tick(t0 + dur - 1);
		tg_in(RC_SW_CENTRE, false, t0 + dur);
	} else {
		tg_in(RC_SW_UP, true, t0 - 5);
		tg_in(RC_SW_DOWN, true, t0);   /* CENTRE_DOWN stamped at the second edge */
		tg_tick(t0 + dur - 1);
		tg_in(RC_SW_UP, false, t0 + dur - 1);
		tg_in(RC_SW_DOWN, false, t0 + dur); /* CENTRE_UP at the last opening */
	}
}
```
