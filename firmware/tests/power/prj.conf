## CMakeLists.txt
```
cmake_minimum_required(VERSION 3.20.0)

# RING_RHW_DIR and RING_POWER_DIR let a run point at a broken copy of ring_rhw or ring_power to prove that these tests
# can fail (broken_run.sh).
if(NOT DEFINED RING_RHW_DIR)
  set(RING_RHW_DIR ${CMAKE_CURRENT_SOURCE_DIR}/../../modules/ring_rhw)
endif()
if(NOT DEFINED RING_POWER_DIR)
  set(RING_POWER_DIR ${CMAKE_CURRENT_SOURCE_DIR}/../../modules/ring_power)
endif()
list(APPEND ZEPHYR_EXTRA_MODULES ${RING_RHW_DIR} ${RING_POWER_DIR})

find_package(Zephyr REQUIRED HINTS $ENV{ZEPHYR_BASE})
project(ring_power_tests)

# The pure part's header (src/rpw_logic.h) and the thin part's test control (src/rpw_priv.h) are the unit's own,
# not public: the tests reach them through the unit's source folder. ring_core's include folder only for rc_types.h
# (the state names; the core itself is not built here).
target_include_directories(app PRIVATE ${RING_POWER_DIR}/src ${CMAKE_CURRENT_SOURCE_DIR}/../../modules/ring_core/include)

target_sources(app PRIVATE
  src/common.c
  src/test_levels.c src/test_charger.c src/test_gauge.c src/test_sample.c src/test_ship.c
  src/test_reset.c src/test_ilim.c src/test_cfg.c src/test_report.c
  src/test_read.c)
```

## prj.conf
```kconfig
CONFIG_ZTEST=y
CONFIG_RING_RHW=y
CONFIG_RING_RHW_SIM=y
CONFIG_RING_POWER=y
CONFIG_THREAD_NAME=y
CONFIG_ZTEST_STACK_SIZE=8192
```

## src/common.c
```c
#include <string.h>

#include "common.h"

struct cap cap;

static void cb_level(uint8_t level)
{
	if (cap.n_level < CAP_MAX) {
		cap.level[cap.n_level] = level;
	}
	cap.n_level++;
}

static void cb_vbus(bool present)
{
	if (cap.n_vbus < CAP_MAX) {
		struct cap_vbus *v = &cap.vbus[cap.n_vbus];

		v->present = present;
		v->log_n = rhw_sim_log_count();
		v->charger_on = rhw_sim_pmic_charger_on();
	}
	cap.n_vbus++;
}

static void cb_cerr(uint8_t reason, uint8_t sensor)
{
	if (cap.n_cerr < CAP_MAX) {
		cap.cerr[cap.n_cerr].reason = reason;
		cap.cerr[cap.n_cerr].sensor = sensor;
	}
	cap.n_cerr++;
}

static void cb_ilim(bool first, uint16_t mv, uint32_t count)
{
	if (cap.n_ilim < CAP_MAX) {
		cap.ilim[cap.n_ilim].first = first;
		cap.ilim[cap.n_ilim].mv = mv;
		cap.ilim[cap.n_ilim].count = count;
	}
	cap.n_ilim++;
}

static void cb_log(uint16_t code, const uint8_t *args, size_t n)
{
	if (cap.n_log < CAP_MAX) {
		struct cap_log *l = &cap.log[cap.n_log];

		l->code = code;
		l->n = n;
		l->t_ms = k_uptime_get();
		memset(l->args, 0, sizeof(l->args));
		memcpy(l->args, args, n < sizeof(l->args) ? n : sizeof(l->args));
	}
	cap.n_log++;
}

const struct rpw_cb pw_cbs = {
	.level = cb_level, .vbus = cb_vbus, .charge_error = cb_cerr, .ilim = cb_ilim, .log = cb_log,
};

void pw_before(void *f)
{
	ARG_UNUSED(f);
	rpw_priv_reset();
	rhw_sim_reset();
	memset(&cap, 0, sizeof(cap));
}

void pw_start(void)
{
	zassert_ok(rpw_start(&pw_cbs), "rpw_start");
}

void pw_script(const uint16_t *mv, const int32_t *ua, uint32_t n)
{
	struct rhw_pmic_sample s[16];

	zassert_true(n <= 16);
	for (uint32_t i = 0; i < n; i++) {
		s[i].mv = mv[i];
		s[i].ua = ua[i];
		s[i].temp_c_x10 = 250;
		s[i].die_c_x10 = 300;
	}
	rhw_sim_pmic_script(s, n);
}

void pw_script1(uint16_t mv, int32_t ua)
{
	pw_script(&mv, &ua, 1);
}

void pw_sleep_until(int64_t t_ms)
{
	int64_t d = t_ms - k_uptime_get();

	if (d > 0) {
		k_sleep(K_MSEC(d));
	}
}

struct rhw_sim_ev pw_ev(uint32_t i)
{
	struct rhw_sim_ev e;

	zassert_true(rhw_sim_log_get(i, &e), "event %u exists", i);
	return e;
}

int32_t pw_find(uint16_t kind, uint32_t from)
{
	return rhw_sim_log_find(kind, from);
}

int32_t pw_nth(uint16_t kind, uint32_t n)
{
	int32_t i = rhw_sim_log_find(kind, 0);

	while (i >= 0 && n > 0) {
		i = rhw_sim_log_find(kind, (uint32_t)i + 1);
		n--;
	}
	return i;
}

uint32_t pw_log_count(uint16_t code)
{
	uint32_t n = 0;

	for (uint32_t i = 0; i < cap.n_log && i < CAP_MAX; i++) {
		if (cap.log[i].code == code) {
			n++;
		}
	}
	return n;
}
```

## src/common.h
```c
/* Shared helpers of the power suites (software step 6, unit U5): a capture of the callbacks, the event log helpers and
 * the set-up that puts the unit and the simulated drivers back to their start before every case. */
#ifndef POWER_TEST_COMMON_H
#define POWER_TEST_COMMON_H

#include <errno.h>
#include <stdbool.h>
#include <string.h>
#include <stdint.h>
#include <stddef.h>

#include <zephyr/kernel.h>
#include <zephyr/ztest.h>

#include <ring_core/rc_types.h>
#include <ring_power/rpw.h>
#include <ring_rhw/rhw.h>
#include <ring_rhw/rhw_sim.h>

#include "rpw_logic.h"
#include "rpw_priv.h"

#define CAP_MAX 40

struct cap_vbus { bool present; uint32_t log_n; bool charger_on; };
struct cap_ilim { bool first; uint16_t mv; uint32_t count; };
struct cap_cerr { uint8_t reason, sensor; };
struct cap_log { uint16_t code; uint8_t args[16]; size_t n; int64_t t_ms; };

struct cap {
	volatile uint32_t n_level;
	uint8_t level[CAP_MAX];
	volatile uint32_t n_vbus;
	struct cap_vbus vbus[CAP_MAX];
	volatile uint32_t n_cerr;
	struct cap_cerr cerr[CAP_MAX];
	volatile uint32_t n_ilim;
	struct cap_ilim ilim[CAP_MAX];
	volatile uint32_t n_log;
	struct cap_log log[CAP_MAX];
};
extern struct cap cap;
extern const struct rpw_cb pw_cbs;

/* before every case: unit and simulated drivers back to the start, the capture cleared */
void pw_before(void *f);
/* rpw_start() with pw_cbs; asserts 0 */
void pw_start(void);
/* One script entry for the simulated power chip's sample (thermistor 25.0 C, die 30.0 C), repeated for the last one. */
void pw_script(const uint16_t *mv, const int32_t *ua, uint32_t n);
void pw_script1(uint16_t mv, int32_t ua);
/* sleep until the uptime t_ms (no-op when past) */
void pw_sleep_until(int64_t t_ms);
/* entry i of the event log (asserts it exists) */
struct rhw_sim_ev pw_ev(uint32_t i);
/* the next entry index of this kind at or after from, or -1 */
int32_t pw_find(uint16_t kind, uint32_t from);
/* index of the n-th (from 0) entry of this kind, or -1 */
int32_t pw_nth(uint16_t kind, uint32_t n);
/* number of captured log records with this code */
uint32_t pw_log_count(uint16_t code);
/* all 14 states in table order (FW l.1.1) */
#define PW_STATES RC_ST_COUNT

#endif
```

## src/test_cfg.c
```c
/* Suite power_cfg (software step 6, unit U5): CHARGE_CURRENT, VBUS is an input only, the power-fail warning is not
 * used. Rows P2 (runtime part), P17, P19. The build assertions of P2 are proven by the broken copies cc_*. */
#include "common.h"

ZTEST_SUITE(power_cfg, NULL, NULL, pw_before, NULL, NULL);

/* The calls that exist on the power chip interface (rhw.h) and the event kinds a full session may log: the session
 * starts, charges, samples, hits the current limit, reports, ships and boots. */
static bool kind_allowed(uint16_t k)
{
	switch (k) {
	case RHW_EV_PMIC_CHG_ENABLE:
	case RHW_EV_PMIC_CHG_CURRENT:
	case RHW_EV_PMIC_CHG_STATUS:
	case RHW_EV_PMIC_SAMPLE:
	case RHW_EV_PMIC_ILIM:
	case RHW_EV_PMIC_RST_READ:
	case RHW_EV_PMIC_RST_CLEAR:
	case RHW_EV_PMIC_SHPHLD_CFG:
	case RHW_EV_PMIC_SHPHLD_STROBE:
	case RHW_EV_PMIC_SHIP:
	case RHW_EV_SHIP_REFUSED:
	case RHW_EV_GAUGE_START:
	case RHW_EV_GAUGE_PROCESS:
	case RHW_EV_PMIC_VBUS:             /* only the test's own calls write this kind */
		return true;
	default:
		return false;
	}
}

/* FW l.878, l.894 (rule 2): 15,000 uA; a multiple of 500 inside 4,000 to 100,000 and at most 17,600; the value that
 * reaches the chip is the constant. */
ZTEST(power_cfg, test_charge_current_constant)
{
	uint32_t cc = rpw_charge_current_ua();

	zassert_equal(cc, 15000, "FW l.878: 15 mA");
	zassert_equal(cc, rpwl_charge_current_ua());
	zassert_true(cc <= 17600 && cc >= 4000 && cc <= 100000 && cc % 500 == 0);
	pw_start();
	zassert_ok(rpw_charge_on());
	zassert_equal(rhw_sim_pmic_charger_ua(), 15000);
}

/* FW l.977 (8.6 rule 1): VBUS is an input only. The power chip interface has 14 calls and none drives VBUS (the
 * frozen header rhw.h; a new member would change the size), and a full session makes no call of any other kind than
 * those of that interface; the VBUS entries in the log are the test's own (counted below). */
ZTEST(power_cfg, test_no_vbus_output_call)
{
	uint32_t own = 0;

	zassert_equal(sizeof(struct rhw_pmic_api), 14 * sizeof(void *),
		      "14 calls: rail_set rail_get charger_enable charger_current charge_status sample ilim_active "
		      "reset_causes reset_causes_clear shphld_config shphld_strobe ship_task vbus_present set_callbacks");
	zassert_equal(sizeof(struct rhw_pmic_cb), 2 * sizeof(void *), "two callbacks in: VBUS and charge error");
	pw_script1(3900, 0);
	rpw_state(RC_ST_RECORDING);
	pw_start();
	rhw_sim_pmic_vbus(true);            /* the test's own VBUS: 1 */
	k_sleep(K_MSEC(50));
	rhw_sim_pmic_vbus(false);           /* 2 */
	own = 2;
	k_sleep(K_MSEC(3500));
	zassert_ok(rpw_charge_on());
	zassert_ok(rpw_charge_off());
	(void)rpw_ship(NULL);
	for (uint32_t i = 0; i < rhw_sim_log_count(); i++) {
		struct rhw_sim_ev e = pw_ev(i);

		zassert_true(kind_allowed(e.kind), "entry %u has kind %u", i, e.kind);
	}
	zassert_equal(rhw_sim_log_count_kind(RHW_EV_PMIC_VBUS), own, "VBUS changed only where the test changed it");
	zassert_equal(rhw_sim_log_count_kind(RHW_EV_PMIC_RAIL), 0, "and no rail call at all (ruling: no rail in this unit)");
}

/* FW l.997: the power-fail warning is not used: POFCONFIG and VSYSPOF stay at their reset values. The interface has
 * no call that could write them (the size check above) and the same session leaves only the kinds listed above in
 * the log: no entry of any other kind, so no register write besides the charger, SHPHLD and ship ones. */
ZTEST(power_cfg, test_pof_untouched)
{
	pw_script1(3900, 0);
	rpw_state(RC_ST_RECORDING);
	pw_start();
	zassert_ok(rpw_charge_on());
	k_sleep(K_MSEC(2500));
	zassert_ok(rpw_boot_causes(NULL));
	(void)rpw_ship(NULL);
	zassert_equal(sizeof(struct rhw_pmic_api), 14 * sizeof(void *));
	for (uint32_t i = 0; i < rhw_sim_log_count(); i++) {
		zassert_true(kind_allowed(pw_ev(i).kind), "entry %u has kind %u", i, pw_ev(i).kind);
	}
}
```

## src/test_charger.c
```c
/* Suite power_charger (software step 6, unit U5): "charge on" and "charge off" (FW l.129), the order of the writes
 * (FW l.894), charge on at every VBUS appearance in every state (R-CHG, ruling R8, FW l.210). Rows C6, C22, P3. */
#include "common.h"

ZTEST_SUITE(power_charger, NULL, NULL, pw_before, NULL, NULL);

/* ENABLE entries of the log with this value (1 = enable, 0 = disable) */
static uint32_t n_enable(int64_t on)
{
	uint32_t n = 0;

	for (int32_t i = pw_find(RHW_EV_PMIC_CHG_ENABLE, 0); i >= 0; i = pw_find(RHW_EV_PMIC_CHG_ENABLE, i + 1)) {
		if (pw_ev(i).a0 == on) {
			n++;
		}
	}
	return n;
}

/* FW l.129: charge on = enabled and set to CHARGE_CURRENT; already on, nothing changes. FW l.878: 15,000 uA.
 * FW l.894: disable, write the current, enable. */
ZTEST(power_charger, test_charge_on_twice_writes_once)
{
	uint32_t n1;

	pw_start();
	rhw_sim_log_clear();
	zassert_ok(rpw_charge_on());
	zassert_equal(n_enable(1), 1, "enabled once");
	zassert_equal(rhw_sim_log_count_kind(RHW_EV_PMIC_CHG_CURRENT), 1, "current written once");
	zassert_true(rhw_sim_pmic_charger_on());
	zassert_equal(rhw_sim_pmic_charger_ua(), 15000);
	n1 = rhw_sim_log_count();
	zassert_ok(rpw_charge_on());
	zassert_equal(n_enable(1), 1, "the second call enabled nothing");
	zassert_equal(rhw_sim_log_count_kind(RHW_EV_PMIC_CHG_CURRENT), 1, "the second call wrote nothing");
	zassert_equal(rhw_sim_log_count(), n1, "the second call made no call at all");
}

/* FW l.129: charge off = the charger is disabled. A later "charge on" writes again. */
ZTEST(power_charger, test_charge_off)
{
	pw_start();
	zassert_ok(rpw_charge_on());
	zassert_true(rhw_sim_pmic_charger_on());
	rhw_sim_log_clear();
	zassert_ok(rpw_charge_off());
	zassert_false(rhw_sim_pmic_charger_on());
	zassert_equal(rhw_sim_log_count(), 1);
	zassert_equal(pw_ev(0).kind, RHW_EV_PMIC_CHG_ENABLE);
	zassert_equal(pw_ev(0).a0, 0);
	zassert_ok(rpw_charge_on());
	zassert_true(rhw_sim_pmic_charger_on());
	zassert_equal(rhw_sim_log_count_kind(RHW_EV_PMIC_CHG_CURRENT), 1, "on after off writes the sequence again");
}

/* FW l.894: the charger is disabled before the current register is written and enabled after. The chip is found
 * enabled (it came up so); the write of the current must find it disabled. */
ZTEST(power_charger, test_disable_write_enable_order)
{
	int32_t a, b, c;

	pw_start();
	zassert_ok(rhw_pmic()->charger_enable(true));
	rhw_sim_log_clear();
	zassert_ok(rpw_charge_on());
	zassert_equal(rhw_sim_log_count(), 3);
	a = 0;
	b = 1;
	c = 2;
	zassert_equal(pw_ev(a).kind, RHW_EV_PMIC_CHG_ENABLE);
	zassert_equal(pw_ev(a).a0, 0, "first: disable");
	zassert_equal(pw_ev(b).kind, RHW_EV_PMIC_CHG_CURRENT);
	zassert_equal(pw_ev(b).a0, 15000);
	zassert_equal(pw_ev(b).a1, 0, "the current is written while the charger is disabled");
	zassert_equal(pw_ev(c).kind, RHW_EV_PMIC_CHG_ENABLE);
	zassert_equal(pw_ev(c).a0, 1, "last: enable");
}

/* FW l.210 and ruling R8: charge on at every VBUS appearance, in every state, BOOT and RECOVERY included, before
 * the VBUS callback goes out. Each state: VBUS out, VBUS in. */
ZTEST(power_charger, test_on_at_every_vbus)
{
	pw_start();
	zassert_false(rhw_sim_pmic_charger_on());
	for (uint8_t st = 0; st < PW_STATES; st++) {
		uint32_t cur_before, nv;

		rpw_state(st);
		rhw_sim_pmic_vbus(false);
		k_sleep(K_MSEC(20));
		cur_before = rhw_sim_log_count_kind(RHW_EV_PMIC_CHG_CURRENT);
		nv = cap.n_vbus;
		rhw_sim_pmic_vbus(true);
		k_sleep(K_MSEC(20));
		zassert_equal(rhw_sim_log_count_kind(RHW_EV_PMIC_CHG_CURRENT), cur_before + 1,
			      "state %u: charge on written at VBUS in", st);
		zassert_true(rhw_sim_pmic_charger_on(), "state %u: charger on", st);
		zassert_equal(cap.n_vbus, nv + 1, "state %u: VBUS callback", st);
		zassert_true(cap.vbus[nv].present);
		zassert_true(cap.vbus[nv].charger_on, "state %u: charge on done before the callback", st);
	}
	zassert_equal(rhw_sim_log_count_kind(RHW_EV_PMIC_CHG_CURRENT), PW_STATES, "once per state, 14 states");
	zassert_equal(RC_ST_BOOT, 2);
	zassert_equal(RC_ST_RECOVERY, 3);
}

/* FW l.893: VBUS present at start: charge on at once, then the callback. */
ZTEST(power_charger, test_on_at_start_with_vbus)
{
	rhw_sim_pmic_vbus(true);
	pw_start();
	zassert_true(rhw_sim_pmic_charger_on(), "on when rpw_start returns");
	k_sleep(K_MSEC(20));
	zassert_equal(cap.n_vbus, 1);
	zassert_true(cap.vbus[0].present);
	zassert_true(cap.vbus[0].charger_on);
}

/* A charge error: the chip's latched values reach the callback (FW l.176). */
ZTEST(power_charger, test_charge_error_reaches_callback)
{
	pw_start();
	rhw_sim_pmic_charge_error(0x12, 0x34);
	k_sleep(K_MSEC(20));
	zassert_equal(cap.n_cerr, 1);
	zassert_equal(cap.cerr[0].reason, 0x12);
	zassert_equal(cap.cerr[0].sensor, 0x34);
}
```

## src/test_gauge.c
```c
/* Suite power_gauge (software step 6, unit U5): each sample feeds the gauge; the motor's charge since the last
 * sample is added as a discharge, I_fed = I_measured + Q_motor / t_sample (FW l.926, l.927). Row P8. */
#include "common.h"

ZTEST_SUITE(power_gauge, NULL, NULL, pw_before, NULL, NULL);

/* FW l.927: "one MF, 51.50 mA.s, in a 1 s sample adds 51.5 mA to that sample". The sample measures 3,000 uA, so the
 * gauge is fed 54,500 uA; the charge is used once (the next sample is fed the measured current alone). */
ZTEST(power_gauge, test_motor_charge_added)
{
	int64_t t0;
	int32_t g;

	pw_script1(3900, 3000);
	rpw_state(RC_ST_RECORDING);
	t0 = k_uptime_get();
	pw_start();
	zassert_equal(rhw_sim_log_count_kind(RHW_EV_GAUGE_START), 1);
	rpw_motor_charge(51500);            /* 51.50 mA.s in uA.s, added during the first second */
	pw_sleep_until(t0 + 1500);          /* sample 2 came at t0 + 1 s */
	g = pw_nth(RHW_EV_GAUGE_PROCESS, 1);    /* the 0th is the first step of rpw_start (no time passed) */
	zassert_true(g >= 0, "a gauge step after the sample");
	/* the sample covers 1,000 ms (the clock counts whole ms: 1,000 or 1,001); 51,500 uA.s over that time */
	zassert_within(pw_ev(g).a1, 1000, 2, "the sample covers 1,000 ms");
	zassert_within(pw_ev(g).a0, 54500, 100, "3,000 uA measured + about 51,500 uA of the motor (FW l.927)");
	zassert_within(pw_ev(g).a0, 3000 + 51500000 / pw_ev(g).a1, 1, "I_fed = I_measured + Q / t over the ms fed");
	pw_sleep_until(t0 + 2500);          /* sample 3 */
	g = pw_nth(RHW_EV_GAUGE_PROCESS, 2);
	zassert_true(g >= 0);
	zassert_equal(pw_ev(g).a0, 3000, "the charge was used once");
	/* each sample feeds the gauge once: start step + 2 samples */
	zassert_equal(rhw_sim_log_count_kind(RHW_EV_GAUGE_PROCESS), 3);

	/* the pure rule on its own: positive uA = discharge (the sign of struct rhw_pmic_sample) */
	zassert_equal(rpwl_fed_ua(3000, 51500, 1000), 54500);
	zassert_equal(rpwl_fed_ua(3000, 51500, 2000), 3000 + 25750, "spread over the longer sample");
	zassert_equal(rpwl_fed_ua(-15000, 0, 1000), -15000, "charging current is kept as it is");
	zassert_equal(rpwl_fed_ua(-15000, 51500, 1000), 36500);
	zassert_equal(rpwl_fed_ua(3000, 51500, 0), 3000, "no time, no division");

	/* the charge counted before a gauge failure is not lost: it goes into the next step */
	pw_before(NULL);
	pw_script1(3900, 3000);
	rpw_state(RC_ST_RECORDING);
	t0 = k_uptime_get();
	pw_start();
	rhw_sim_gauge_error(-5);
	rpw_motor_charge(10000);
	pw_sleep_until(t0 + 1500);                   /* the step failed */
	rhw_sim_gauge_error(0);
	pw_sleep_until(t0 + 2500);                   /* the next step carries it: 10,000 uA.s over 1 s */
	g = pw_nth(RHW_EV_GAUGE_PROCESS, 2);       /* 0: start, 1: the failed step, 2: the next one */
	zassert_true(g >= 0);
	zassert_equal(pw_ev(g).a0, 3000 + 10000, "the charge of the failed step came with the next one");
}
```

## src/test_ilim.c
```c
/* Suite power_ilim (software step 6, unit U5): the battery current limit status (FW l.990 to l.995). Row P18.
 * The screen is the join's: this unit tells it ("first" or "again"), logs, and does nothing else (no motor, nothing
 * closed, nothing refused). */
#include "common.h"

ZTEST_SUITE(power_ilim, NULL, NULL, pw_before, NULL, NULL);

static uint32_t le32(const uint8_t *p)
{
	return p[0] | (p[1] << 8) | (p[2] << 16) | ((uint32_t)p[3] << 24);
}

/* FW l.991 to l.995: the first ACTIVE reading: one record (battery mV, state, screen on, count), the callback with
 * first = true; no motor pattern, no rail change, no level or VBUS report: nothing closed, nothing refused. */
ZTEST(power_ilim, test_first_active)
{
	int64_t t0;

	pw_script1(3777, 0);
	rpw_state(RC_ST_RECORDING);
	t0 = k_uptime_get();
	pw_start();
	rhw_sim_log_clear();
	rhw_sim_pmic_ilim_at_sample(1);     /* the next sample (sample 2) reads ACTIVE */
	pw_sleep_until(t0 + 1500);
	zassert_equal(cap.n_ilim, 1, "one callback");
	zassert_true(cap.ilim[0].first, "first reading of a run");
	zassert_equal(cap.ilim[0].mv, 3777);
	zassert_equal(cap.ilim[0].count, 1);
	zassert_equal(pw_log_count(RREC_LOG_ILIM_ACTIVE), 1, "one record");
	zassert_equal(cap.log[0].code, 0x0210);
	zassert_equal(cap.log[0].n, 8);
	zassert_equal(cap.log[0].args[0] | (cap.log[0].args[1] << 8), 3777, "battery mV");
	zassert_equal(cap.log[0].args[2], RC_ST_RECORDING, "the state");
	zassert_equal(cap.log[0].args[3], 1, "the screen was on");
	zassert_equal(le32(&cap.log[0].args[4]), 1, "count 1");
	zassert_equal(rhw_sim_log_count_kind(RHW_EV_MOTOR), 0, "no motor pattern (FW l.995)");
	zassert_equal(rhw_sim_log_count_kind(RHW_EV_PMIC_RAIL), 0, "no rail changed");
	zassert_equal(cap.n_level, 0, "nothing closed or refused: no level change");
	zassert_equal(cap.n_vbus, 0);
	/* a later sample that reads not active adds nothing */
	pw_sleep_until(t0 + 2500);
	zassert_equal(cap.n_ilim, 1);
	zassert_equal(pw_log_count(RREC_LOG_ILIM_ACTIVE), 1);
}

/* FW l.995: ACTIVE again with the screen already off: logged once more with a count, nothing else. The screen is off
 * for 10 s (RREC_ILIM_SCREEN_MS); a reading after that starts a new run. Samples come at t0 + j s; ACTIVE at j = 1,
 * 2, 3 and 12. */
ZTEST(power_ilim, test_again_with_screen_off)
{
	int64_t t0;

	pw_script1(3800, 0);
	rpw_state(RC_ST_RECORDING);
	t0 = k_uptime_get();
	pw_start();
	for (uint32_t j = 1; j <= 12; j++) {
		if (j <= 3 || j == 12) {
			rhw_sim_pmic_ilim_at_sample(1);
		}
		pw_sleep_until(t0 + (int64_t)j * 1000 + 500);
	}
	zassert_equal(cap.n_ilim, 4);
	zassert_true(cap.ilim[0].first && cap.ilim[0].count == 1);
	zassert_true(!cap.ilim[1].first && cap.ilim[1].count == 2, "again, count 2");
	zassert_true(!cap.ilim[2].first && cap.ilim[2].count == 3, "again, count 3");
	zassert_true(cap.ilim[3].first && cap.ilim[3].count == 1, "11 s later: the screen is on again, a new run");
	zassert_equal(pw_log_count(RREC_LOG_ILIM_ACTIVE), 4);
	/* the record of an "again" reading: screen off (0), count 2 */
	zassert_equal(cap.log[1].code, 0x0210);
	zassert_equal(cap.log[1].args[3], 0, "the screen was already off");
	zassert_equal(le32(&cap.log[1].args[4]), 2);
	zassert_equal(le32(&cap.log[2].args[4]), 3);
	zassert_equal(cap.log[3].args[3], 1);
	zassert_equal(cap.n_level, 0, "nothing else changes");
}

/* The edge of the 10 s: 9,999 ms is still "again", 10,000 ms starts a new run. */
ZTEST(power_ilim, test_screen_off_edge_10s)
{
	struct rpwl_ilim s;
	uint32_t c = 0;

	rpwl_ilim_reset(&s);
	zassert_equal(rpwl_ilim_step(&s, false, 500, &c), RPWL_ILIM_NONE);
	zassert_equal(rpwl_ilim_step(&s, true, 1000, &c), RPWL_ILIM_FIRST);
	zassert_equal(rpwl_ilim_step(&s, true, 1000 + 9999, &c), RPWL_ILIM_AGAIN);
	zassert_equal(c, 2);
	zassert_equal(rpwl_ilim_step(&s, true, 1000 + 10000, &c), RPWL_ILIM_FIRST);
	zassert_equal(c, 1);
	/* not active for a while, then active: first again */
	zassert_equal(rpwl_ilim_step(&s, false, 30000, &c), RPWL_ILIM_NONE);
	zassert_equal(rpwl_ilim_step(&s, true, 31000, &c), RPWL_ILIM_FIRST);
}
```

## src/test_levels.c
```c
/* Suite power_levels (software step 6, unit U5): the battery levels from the gauge and the voltage, the mean of 10 in
 * RECORDING, the report to the core on every change in both directions. Rows C2 and P11 of firmware/docs/step6-plan.md.
 * Every expected value is typed here from design/firmware.md ("FW l.N"), never produced by the code under test. */
#include "common.h"

ZTEST_SUITE(power_levels, NULL, NULL, pw_before, NULL, NULL);

/* FW l.115 to l.117: B15 at or under 15 %, B5 at or under 5 %, B2 at or under 2 % (state of charge).
 * rpw_start judges its first sample alone (single sample), so the level is read right after it. */
ZTEST(power_levels, test_soc_edges)
{
	static const struct { uint16_t pct_x10; uint8_t level; } t[] = {
		{ 160, 0 },   /* 16 %: above B15 */
		{ 150, 1 },   /* 15 %: B15 */
		{ 60, 1 },    /* 6 %: B15 */
		{ 50, 2 },    /* 5 %: B5 */
		{ 30, 2 },    /* 3 %: B5 */
		{ 20, 3 },    /* 2 %: B2 */
		{ 19, 3 },    /* 1.9 % */
		{ 21, 2 },    /* 2.1 % */
	};

	for (size_t i = 0; i < ARRAY_SIZE(t); i++) {
		struct rpw_values v;

		pw_before(NULL);
		rhw_sim_gauge_start_soc(t[i].pct_x10);
		pw_script1(3900, 0);        /* a full cell's voltage: only the state of charge judges */
		pw_start();
		rpw_values(&v);
		zassert_equal(v.soc_x10, t[i].pct_x10, "case %u: gauge value passed on", (unsigned)i);
		zassert_equal(v.level, t[i].level, "case %u: soc %u (x10) level %u", (unsigned)i, t[i].pct_x10,
			      v.level);
		/* the pure rule agrees on the same pair */
		zassert_equal(rpwl_level(t[i].pct_x10, 3900, 1), t[i].level, "pure rule, case %u", (unsigned)i);
	}
}

/* FW l.116 and l.117: B5 at or under 3.45 V, B2 at or under 3.30 V (single sample outside RECORDING). */
ZTEST(power_levels, test_voltage_edges)
{
	static const struct { uint16_t mv; uint8_t level; } t[] = {
		{ 3451, 0 }, { 3450, 2 }, { 3301, 2 }, { 3300, 3 }, { 4350, 0 }, { 3299, 3 },
	};

	for (size_t i = 0; i < ARRAY_SIZE(t); i++) {
		struct rpw_values v;

		pw_before(NULL);
		rhw_sim_gauge_start_soc(800);   /* 80 %: only the voltage judges */
		pw_script1(t[i].mv, 0);
		pw_start();
		rpw_values(&v);
		zassert_equal(v.battery_mv, t[i].mv, "case %u: sample passed on", (unsigned)i);
		zassert_equal(v.level, t[i].level, "case %u: %u mV level %u", (unsigned)i, t[i].mv, v.level);
		zassert_equal(rpwl_level(800, t[i].mv, 1), t[i].level, "pure rule, case %u", (unsigned)i);
	}
	/* the compare is exact, not rounded: a mean of 3450.9 mV (34509 over 10) is above 3.45 V */
	zassert_equal(rpwl_level(800, 34509, 10), 0);
	zassert_equal(rpwl_level(800, 34500, 10), 2);
	zassert_equal(rpwl_level(800, 33001, 10), 2);
	zassert_equal(rpwl_level(800, 33000, 10), 3);
}

/* FW l.114, l.928: voltage averaged over 10 s, one sample a second in RECORDING. Eleven samples: 3,340 mV five times,
 * 3,260 mV five times, then 3,400 mV. The mean of the last ten is 3,300 mV (B2) exactly at the tenth sample, and not
 * B2 before it (a mean of the last five would reach B2 at the eighth) and not after the eleventh (3,306 mV). */
ZTEST(power_levels, test_mean_of_ten_in_recording)
{
	static const uint16_t mv[11] = { 3340, 3340, 3340, 3340, 3340, 3260, 3260, 3260, 3260, 3260, 3400 };
	static const int32_t ua[11] = { 0 };
	int64_t t0;

	pw_script(mv, ua, 11);
	rhw_sim_gauge_start_soc(800);
	rpw_state(RC_ST_RECORDING);
	t0 = k_uptime_get();
	pw_start();                         /* sample 1 */
	for (uint32_t j = 2; j <= 11; j++) {
		struct rpw_values v;

		pw_sleep_until(t0 + (int64_t)(j - 1) * 1000 + 500);   /* sample j came at t0 + (j - 1) s */
		rpw_values(&v);
		zassert_equal(v.battery_mv, mv[j - 1], "sample %u was taken", j);
		if (j == 10) {
			zassert_equal(v.level, 3, "mean of ten is 3,300 mV: B2 at sample 10");
		} else if (j == 11) {
			zassert_not_equal(v.level, 3, "mean 3,306 mV: no longer B2 after sample 11");
		} else {
			zassert_not_equal(v.level, 3, "sample %u: mean above 3,300 mV, not B2", j);
		}
	}
}

/* FW l.211 to l.213 (R-CHG, R-STB): the level is reported to the core on every change, both directions, and not
 * twice for the same level. The gauge value is set before each sample (ua 0: the gauge keeps it). */
ZTEST(power_levels, test_report_on_change_both_ways)
{
	static const uint16_t soc[] = { 40, 12, 12, 100, 800 };   /* 4 %, 1.2 %, same, 10 %, 80 % */
	static const uint8_t expect[] = { 2, 3, 1, 0 };            /* B5, B2, B15, OK: two down, two up */
	int64_t t0;

	pw_script1(3900, 0);
	rhw_sim_gauge_start_soc(800);
	rpw_state(RC_ST_RECORDING);
	t0 = k_uptime_get();
	pw_start();
	for (uint32_t j = 1; j <= ARRAY_SIZE(soc); j++) {
		rhw_sim_gauge_start_soc(soc[j - 1]);               /* for sample j */
		pw_sleep_until(t0 + (int64_t)j * 1000 + 500);
	}
	zassert_equal(cap.n_level, ARRAY_SIZE(expect), "levels reported: %u", cap.n_level);
	for (uint32_t i = 0; i < ARRAY_SIZE(expect); i++) {
		zassert_equal(cap.level[i], expect[i], "report %u", i);
	}
	/* the event log holds one record per change: level u8, soc x10 u16, mean mV u16 (rrec_spec.h) */
	zassert_equal(pw_log_count(RREC_LOG_BATTERY), 4);
	zassert_equal(cap.log[0].code, 0x0020);
	zassert_equal(cap.log[0].n, 5);
	zassert_equal(cap.log[0].args[0], 2);
	zassert_equal(cap.log[0].args[1] | (cap.log[0].args[2] << 8), 40);
	zassert_equal(cap.log[0].args[3] | (cap.log[0].args[4] << 8), 3900);
	zassert_equal(cap.log[3].args[0], 0, "the last record is the way back up to OK");
}

/* A level other than OK at the first sample is reported once, from the power thread, after rpw_start. */
ZTEST(power_levels, test_first_level_reported_at_start)
{
	pw_script1(3900, 0);
	rhw_sim_gauge_start_soc(100);       /* 10 %: B15 */
	pw_start();
	k_sleep(K_MSEC(20));
	zassert_equal(cap.n_level, 1);
	zassert_equal(cap.level[0], 1);
}
```

## src/test_read.c
```c
/* Suite power_read (software step 6, the join's addition to the power unit, lead's ruling 3 on the factory unit's gaps):
 * rpw_sample_now() and rpw_charger_now() read the power chip NOW on the power thread (the one owner of the chip, rhw.h)
 * and hand the values to the caller, for T-MOTOR (FW l.1028) and T-CHARGE (FW l.1032). */
#include <string.h>

#include "common.h"

ZTEST_SUITE(power_read, NULL, NULL, pw_before, NULL, NULL);

/* the sample events of the simulated chip since the log was cleared, and the thread that made the last one */
static uint32_t samples(char *who, size_t n)
{
	uint32_t k = 0;

	for (int32_t i = pw_find(RHW_EV_PMIC_SAMPLE, 0); i >= 0; i = pw_find(RHW_EV_PMIC_SAMPLE, i + 1)) {
		struct rhw_sim_ev e = pw_ev(i);

		strncpy(who, e.caller, n - 1);
		who[n - 1] = '\0';
		k++;
	}
	return k;
}

/* one sample now, taken by the power thread, values as the chip gives them; the gauge is not stepped */
ZTEST(power_read, test_sample_now_from_power_thread)
{
	char who[16] = "";
	uint16_t mv = 0;
	int32_t ua = 0;

	pw_start();
	k_sleep(K_MSEC(50));   /* the start's callbacks are out */
	pw_script1(3712, 4321);
	rhw_sim_log_clear();
	zassert_ok(rpw_sample_now(&mv, &ua));
	zassert_equal(mv, 3712, "mV as sampled (%u)", mv);
	zassert_equal(ua, 4321, "uA as sampled (%d)", ua);
	zassert_equal(samples(who, sizeof(who)), 1, "one sample");
	zassert_equal(strcmp(who, "rpw"), 0, "taken by the power thread, not by the caller (%s)", who);
	zassert_equal(rhw_sim_log_count_kind(RHW_EV_GAUGE_PROCESS), 0, "the gauge is not stepped by the read");
}

/* T-CHARGE: the charger state with the latched error and the battery current, read now (FW l.702 code 5 = error) */
ZTEST(power_read, test_charger_now_latched_error)
{
	uint8_t st = 0xFF, err = 0xFF;
	int32_t ua = 0;

	pw_start();
	k_sleep(K_MSEC(50));
	pw_script1(3900, -15000);
	zassert_ok(rpw_charger_now(&st, &err, &ua));
	zassert_equal(st, 0, "no VBUS: charger off, code 0 (FW l.702)");
	zassert_equal(err, 0, "no error latched");
	zassert_equal(ua, -15000, "the battery current of the sample");
	rhw_sim_pmic_charge_error(3, 4);
	k_sleep(K_MSEC(50));
	zassert_ok(rpw_charger_now(&st, &err, &ua));
	zassert_equal(st, 5, "error, code 5 (FW l.702)");
	zassert_equal(err, 3, "the latched reason");
}

/* not started: no power thread answers; the caller gets -ETIMEDOUT, not a stale value */
ZTEST(power_read, test_read_before_start_times_out)
{
	uint16_t mv = 0;
	int32_t ua = 0;

	zassert_equal(rpw_sample_now(&mv, &ua), -ETIMEDOUT, "no answer without rpw_start");
}
```

## src/test_report.c
```c
/* Suite power_report (software step 6, unit U5): the GET_BATTERY values (FW l.702) and the values for SCR_CHARGING
 * (FW l.374). Rows X13 and C39. */
#include "common.h"

ZTEST_SUITE(power_report, NULL, NULL, pw_before, NULL, NULL);

/* FW l.702: charging state 0 off, 1 trickle, 2 constant current, 3 constant voltage, 4 full, 5 error: the byte after
 * the two u16 values. A latched error reads 5 whatever the state. */
ZTEST(power_report, test_charge_state_codes)
{
	uint8_t b[RREC_GET_BATTERY_BYTES];

	pw_script1(3900, 0);
	pw_start();
	for (int s = 0; s <= 5; s++) {
		rhw_sim_pmic_charge_state(s);
		memset(b, 0xEE, sizeof(b));
		zassert_ok(rpw_battery_report(b));
		zassert_equal(b[4], s, "charger state %d", s);
	}
	/* an error latched while the state still reads constant current: error */
	rhw_sim_pmic_charge_state(2);
	rhw_sim_pmic_charge_error(0x01, 0x02);
	rhw_sim_pmic_charge_state(2);
	zassert_ok(rpw_battery_report(b));
	zassert_equal(b[4], 5);
	/* automatic state: off without VBUS */
	pw_before(NULL);
	pw_script1(3900, 0);
	pw_start();
	zassert_ok(rpw_battery_report(b));
	zassert_equal(b[4], 0);
	/* the pure mapping */
	zassert_equal(rpwl_charge_code(0, 0), 0);
	zassert_equal(rpwl_charge_code(3, 0), 3);
	zassert_equal(rpwl_charge_code(4, 0), 4);
	zassert_equal(rpwl_charge_code(5, 0), 5);
	zassert_equal(rpwl_charge_code(1, 7), 5);
	zassert_equal(rpwl_charge_code(9, 0), 5);
}

/* The nine bytes (FW l.702: battery_mv u16, soc_percent_x10 u16, charging state u8, die temp 0.1 C i16, time to full
 * in minutes u16; little endian, FW l.70). 3,912 mV = 0x0F48, 73.4 % = 734 = 0x02DE, state CC, die 30.0 C = 300 =
 * 0x012C. Not charging: time to full unknown, 0xFFFF. */
ZTEST(power_report, test_battery_bytes_layout)
{
	static const uint8_t want[RREC_GET_BATTERY_BYTES] = { 0x48, 0x0F, 0xDE, 0x02, 0x02, 0x2C, 0x01, 0xFF, 0xFF };
	uint8_t b[RREC_GET_BATTERY_BYTES];

	pw_script1(3912, 0);
	rhw_sim_gauge_start_soc(734);
	pw_start();
	rhw_sim_pmic_charge_state(2);
	zassert_ok(rpw_battery_report(b));
	zassert_mem_equal(b, want, sizeof(want));
	/* a negative die temperature: -5.5 C = -55 = 0xFFC9 */
	rpwl_battery_bytes(3300, 20, 0, -55, 0, b);
	zassert_equal(b[5], 0xC9);
	zassert_equal(b[6], 0xFF);
}

/* Time to full from the gauge while charging: 17.6 mAh cell at 80 %, charging at 15,000 uA: 20 % = 3.52 mAh =
 * 12,672 mA.s, 844 s, rounded up to 15 minutes. And the values for SCR_CHARGING (FW l.374): charging, not full. */
ZTEST(power_report, test_values_and_time_to_full)
{
	struct rpw_values v;
	uint8_t b[RREC_GET_BATTERY_BYTES];

	rhw_sim_pmic_vbus(true);
	pw_script1(4000, -15000);
	rhw_sim_gauge_start_soc(800);
	pw_start();                         /* VBUS present: charge on */
	zassert_ok(rpw_battery_report(b));
	rpw_values(&v);
	zassert_true(v.vbus);
	zassert_true(v.charging, "constant current with VBUS and the charger on");
	zassert_false(v.full);
	zassert_equal(v.battery_mv, 4000);
	zassert_equal(v.soc_x10, 800);
	zassert_equal(v.to_full_min, 15);
	zassert_equal(b[7] | (b[8] << 8), 15);
	zassert_equal(v.die_c_x10, 300);
	rhw_sim_pmic_charge_state(4);       /* full */
	zassert_ok(rpw_battery_report(b));
	rpw_values(&v);
	zassert_equal(b[4], 4);
	/* values change at the next sample; the pure rounding */
	zassert_equal(rpwl_ttf_min(0), 0);
	zassert_equal(rpwl_ttf_min(1), 1);
	zassert_equal(rpwl_ttf_min(60), 1);
	zassert_equal(rpwl_ttf_min(61), 2);
	zassert_equal(rpwl_ttf_min(UINT32_MAX), 0xFFFF);
	zassert_equal(rpwl_ttf_min(60u * 70000u), 65534);
}

/* Before rpw_start there is nothing to report. */
ZTEST(power_report, test_report_before_start)
{
	uint8_t b[RREC_GET_BATTERY_BYTES];
	struct rpw_values v;

	zassert_equal(rpw_battery_report(b), -EAGAIN);
	rpw_values(&v);
	zassert_equal(v.to_full_min, UINT16_MAX);
	zassert_false(v.vbus);
}
```

## src/test_reset.c
```c
/* Suite power_reset (software step 6, unit U5): after a wake BOOT reads RSTCAUSE and the charger error log, writes
 * them into the event log and clears them (FW l.943, l.996). Row P14. */
#include "common.h"

ZTEST_SUITE(power_reset, NULL, NULL, pw_before, NULL, NULL);

/* rpw_boot_causes() takes the log hook itself (rpw_start has not run yet at boot). */
static void boot_log(uint16_t code, const uint8_t *args, size_t n)
{
	if (cap.n_log < CAP_MAX) {
		cap.log[cap.n_log].code = code;
		cap.log[cap.n_log].n = n;
		for (size_t i = 0; i < n && i < sizeof(cap.log[0].args); i++) {
			cap.log[cap.n_log].args[i] = args[i];
		}
	}
	cap.n_log++;
}

/* FW l.996: each of the seven bits (SHIPMODEEXIT bit 0, BOOTMONITORTIMEOUT 1, WATCHDOGTIMEOUT 2, LONGPRESSTIMEOUT 3,
 * THERMALSHUTDOWN 4, VSYSLOW 5, SWRESET 6) with the two charger error values beside it: one record
 * (code 0x0220: RSTCAUSE, CHARGERERRREASON, CHARGERERRSENSOR); the read comes before the clear; after it the chip
 * holds nothing. */
ZTEST(power_reset, test_causes_logged_then_cleared)
{
	for (uint8_t bit = 0; bit < 7; bit++) {
		uint8_t rc = 0xFF, er = 0xFF, es = 0xFF;
		int32_t rd, cl;

		pw_before(NULL);
		rhw_sim_pmic_set_reset_causes((uint8_t)(1u << bit), (uint8_t)(0x01 + bit), (uint8_t)(0x10 + bit));
		zassert_ok(rpw_boot_causes(boot_log), "bit %u", bit);
		zassert_equal(cap.n_log, 1, "bit %u: one record", bit);
		zassert_equal(cap.log[0].code, 0x0220);
		zassert_equal(cap.log[0].n, 3);
		zassert_equal(cap.log[0].args[0], 1u << bit, "bit %u in the record", bit);
		zassert_equal(cap.log[0].args[1], 0x01 + bit);
		zassert_equal(cap.log[0].args[2], 0x10 + bit);
		rd = pw_find(RHW_EV_PMIC_RST_READ, 0);
		cl = pw_find(RHW_EV_PMIC_RST_CLEAR, 0);
		zassert_true(rd >= 0 && cl > rd, "bit %u: read, then clear", bit);
		zassert_ok(rhw_pmic()->reset_causes(&rc, &er, &es));
		zassert_equal(rc, 0, "bit %u: RSTCAUSE cleared", bit);
		zassert_equal(er, 0, "bit %u: error reason cleared", bit);
		zassert_equal(es, 0, "bit %u: error sensor cleared", bit);
	}
}

/* All seven bits together, and nothing set: still one record (a boot with no cause is a fact too). */
ZTEST(power_reset, test_all_bits_and_none)
{
	rhw_sim_pmic_set_reset_causes(0x7F, 0xAB, 0xCD);
	zassert_ok(rpw_boot_causes(boot_log));
	zassert_equal(cap.n_log, 1);
	zassert_equal(cap.log[0].args[0], 0x7F);
	zassert_equal(cap.log[0].args[1], 0xAB);
	zassert_equal(cap.log[0].args[2], 0xCD);
	zassert_equal(rpwl_cause_count(0x7F), 7);
	zassert_equal(rpwl_cause_count(0x00), 0);
	zassert_equal(rpwl_cause_count(0x80), 0, "bit 7 is no cause");

	pw_before(NULL);
	zassert_ok(rpw_boot_causes(boot_log));
	zassert_equal(cap.n_log, 1);
	zassert_equal(cap.log[0].args[0], 0);
}
```

## src/test_sample.c
```c
/* Suite power_sample (software step 6, unit U5): a sample every 1 s in RECORDING, every 60 s in the other awake
 * states, none in SHIP and OFF; every sample also reads the current limit status (FW l.928). Row P9. */
#include "common.h"

ZTEST_SUITE(power_sample, NULL, NULL, pw_before, NULL, NULL);

/* The sampling period of every state (FW l.928; the states of FW 1.1 in table order): RECORDING 1,000 ms; SHIP and OFF
 * do not run; every other awake state 60,000 ms. A value that is no state changes nothing. */
ZTEST(power_sample, test_period_per_state)
{
	static const uint32_t want[RC_ST_COUNT] = {
		0,      /* SHIP */
		0,      /* OFF */
		60000,  /* BOOT */
		60000,  /* RECOVERY */
		60000,  /* STANDBY */
		1000,   /* RECORDING */
		60000,  /* CHARGING */
		60000,  /* TRANSFER */
		60000,  /* ERR_STORAGE_FULL */
		60000,  /* ERR_BATTERY_LOW */
		60000,  /* ERR_STORAGE_FAULT */
		60000,  /* ERR_MIC_FAULT */
		60000,  /* ERR_CHARGER */
		60000,  /* FACTORY_TEST */
	};

	pw_start();
	zassert_equal(rpw_priv_period_ms(), 60000, "60 s until rpw_state says otherwise");
	for (uint8_t st = 0; st < RC_ST_COUNT; st++) {
		rpw_state(st);
		zassert_equal(rpw_priv_period_ms(), want[st], "state %u", st);
		zassert_equal(rpwl_period_ms(st), want[st], "pure rule, state %u", st);
	}
	rpw_state(RC_ST_STANDBY);
	rpw_state(RC_ST_COUNT);             /* no such state */
	rpw_state(200);
	zassert_equal(rpw_priv_period_ms(), 60000, "an unknown state changes nothing");
}

/* The period is real: in RECORDING 5 samples in 5.5 s, 1,000 ms apart; in STANDBY 2 samples in 125 s, 60 s apart. */
ZTEST(power_sample, test_period_in_time)
{
	int64_t t0;
	int32_t i, prev;
	uint32_t seen = 0;

	pw_script1(3900, 0);
	rpw_state(RC_ST_RECORDING);
	t0 = k_uptime_get();
	pw_start();
	pw_sleep_until(t0 + 5500);
	zassert_equal(rhw_sim_log_count_kind(RHW_EV_PMIC_SAMPLE), 6, "the start sample and 5 more");
	prev = -1;
	for (i = pw_find(RHW_EV_PMIC_SAMPLE, 0); i >= 0; i = pw_find(RHW_EV_PMIC_SAMPLE, i + 1)) {
		if (prev >= 0) {
			int64_t d = pw_ev(i).t_us - pw_ev(prev).t_us;

			zassert_within(d, 1000000, 2000, "samples 1,000 ms apart, got %lld us", d);
			seen++;
		}
		prev = i;
	}
	zassert_equal(seen, 5);

	pw_before(NULL);
	pw_script1(3900, 0);
	rpw_state(RC_ST_STANDBY);
	t0 = k_uptime_get();
	pw_start();
	pw_sleep_until(t0 + 125000);
	zassert_equal(rhw_sim_log_count_kind(RHW_EV_PMIC_SAMPLE), 3, "the start sample, 60 s, 120 s");
	i = pw_find(RHW_EV_PMIC_SAMPLE, 1);
	zassert_within(pw_ev(i).t_us - pw_ev(0).t_us, 60000000, 2000);
}

/* SHIP and OFF: no sampling at all. */
ZTEST(power_sample, test_no_sampling_in_ship_and_off)
{
	int64_t t0;

	pw_script1(3900, 0);
	rpw_state(RC_ST_OFF);
	t0 = k_uptime_get();
	pw_start();
	pw_sleep_until(t0 + 130000);
	zassert_equal(rhw_sim_log_count_kind(RHW_EV_PMIC_SAMPLE), 1, "only the start sample");
}

/* FW l.928: every sample also reads the current limit status, right after it. */
ZTEST(power_sample, test_ilim_read_with_every_sample)
{
	int64_t t0;
	uint32_t ns, k = 0;

	pw_script1(3900, 0);
	rpw_state(RC_ST_RECORDING);
	t0 = k_uptime_get();
	pw_start();
	pw_sleep_until(t0 + 4500);
	ns = rhw_sim_log_count_kind(RHW_EV_PMIC_SAMPLE);
	zassert_equal(ns, 5);
	zassert_equal(rhw_sim_log_count_kind(RHW_EV_PMIC_ILIM), ns, "one status read per sample");
	for (int32_t i = pw_find(RHW_EV_PMIC_SAMPLE, 0); i >= 0; i = pw_find(RHW_EV_PMIC_SAMPLE, i + 1)) {
		int32_t j = pw_find(RHW_EV_PMIC_ILIM, i);

		zassert_true(j > i, "a status read follows sample %u", k);
		/* nothing but the gauge step and the charger status between the sample and its status read */
		for (int32_t m = i + 1; m < j; m++) {
			uint16_t kd = pw_ev(m).kind;

			zassert_true(kd == RHW_EV_GAUGE_START || kd == RHW_EV_GAUGE_PROCESS ||
				     kd == RHW_EV_PMIC_CHG_STATUS,
				     "entry %d between a sample and its status read: kind %u", m, kd);
		}
		k++;
	}
}
```

## src/test_ship.c
```c
/* Suite power_ship (software step 6, unit U5): ship mode entry steps 2 to 5 of FW 8.4 (l.936 to l.941).
 * Rows P12 and P13. rpw_ship() is called in the test thread. After the simulated ship task every driver call is
 * refused and counted (the simulated chip's "no supply"); the real chip would stop the ring there. */
#include <errno.h>
#include <string.h>

#include "common.h"

ZTEST_SUITE(power_ship, NULL, NULL, pw_before, NULL, NULL);

static volatile uint32_t hook_calls;
static volatile uint32_t hook_log_n;

static void hook(void)
{
	hook_calls++;
	hook_log_n = rhw_sim_log_count();
}

/* the first task finds a case pushed on during the hook: VBUS present at the chip, removed 1.5 s later */
static void hook_vbus_back(void)
{
	hook_calls++;
	rhw_sim_pmic_vbus(true);
	rhw_sim_vbus_at(k_uptime_get() + 1500, false);
}

/* kinds that may stand between two entries */
static bool only_kinds(uint32_t from, uint32_t to, uint16_t k1, uint16_t k2)
{
	for (uint32_t i = from; i < to; i++) {
		uint16_t kd = pw_ev(i).kind;

		if (kd != k1 && kd != k2) {
			return false;
		}
	}
	return true;
}

/* FW l.936 to l.940, no VBUS: SHPHLDCONFIG at 96 ms, the strobe, then (the beacon hook), then the task. Nothing else
 * in between, no sample while it runs. */
ZTEST(power_ship, test_entry_order_without_vbus)
{
	int32_t cfg, str, task;

	pw_script1(3900, 0);
	rpw_state(RC_ST_RECORDING);         /* 1 s sampling: it must stop while the ship steps run */
	pw_start();
	rhw_sim_log_clear();
	hook_calls = 0;
	zassert_equal(rpw_ship(hook), -ETIMEDOUT, "the simulated chip cannot cut the supply for real: returns");
	cfg = pw_find(RHW_EV_PMIC_SHPHLD_CFG, 0);
	zassert_true(cfg >= 0, "SHPHLDCONFIG written");
	str = pw_find(RHW_EV_PMIC_SHPHLD_STROBE, cfg);
	zassert_true(str > cfg, "the strobe follows the configuration");
	task = pw_find(RHW_EV_PMIC_SHIP, str);
	zassert_true(task > str, "the task follows the strobe");
	zassert_equal(pw_ev(cfg).a0, 96, "FW l.938: the default press time, 96 ms");
	zassert_equal(pw_ev(task).a0, 0, "no VBUS at the task");
	zassert_equal(task, cfg + 2, "nothing between the three writes");
	zassert_equal(hook_calls, 1, "the beacon hook runs once");
	zassert_equal(hook_log_n, (uint32_t)task, "the hook runs right before the task");
	zassert_equal(rhw_sim_log_count_kind(RHW_EV_PMIC_SHIP), 1, "one task that reached the chip");
	zassert_equal(rhw_sim_log_count_kind(RHW_EV_PMIC_SAMPLE), 0, "no sample during the ship steps");

	/* the step machine, no VBUS: the same order, then the one retry (FW l.936 to l.941), the beacon hook only once */
	{
		struct rpwl_ship s;

		rpwl_ship_reset(&s);
		zassert_equal(rpwl_ship_next(&s, false), RPWL_SHIP_CONFIG);
		zassert_equal(rpwl_ship_next(&s, false), RPWL_SHIP_STROBE);
		zassert_equal(rpwl_ship_next(&s, false), RPWL_SHIP_BEFORE_TASK);
		zassert_equal(rpwl_ship_next(&s, false), RPWL_SHIP_TASK);
		zassert_equal(rpwl_ship_next(&s, false), RPWL_SHIP_WAIT_1S);
		zassert_equal(rpwl_ship_next(&s, false), RPWL_SHIP_LOG_RETRY);
		zassert_equal(rpwl_ship_next(&s, false), RPWL_SHIP_TASK, "the retry has no second hook");
		zassert_equal(rpwl_ship_next(&s, false), RPWL_SHIP_WAIT_1S);
		zassert_equal(rpwl_ship_next(&s, false), RPWL_SHIP_GIVE_UP, "the retry is once");
		zassert_equal(rpwl_ship_next(&s, false), RPWL_SHIP_GIVE_UP);
	}
}

/* FW l.939: with VBUS, wait for VBUS removed, doing nothing else; the task only after it.
 * Part A: VBUS present from the start, removed 700 ms after the call. Part B: the first task finds VBUS back (a case
 * pushed on during the hook): 1 s later the retry goes back to step 3 and waits again before the second task. */
ZTEST(power_ship, test_waits_for_vbus_removed)
{
	int32_t cfg, out, task, task2;
	int64_t t;

	/* part A */
	rhw_sim_pmic_vbus(true);
	pw_script1(3900, 0);
	pw_start();
	k_sleep(K_MSEC(20));
	rhw_sim_log_clear();
	t = k_uptime_get();
	rhw_sim_vbus_at(t + 700, false);
	zassert_equal(rpw_ship(hook), -ETIMEDOUT);
	cfg = pw_find(RHW_EV_PMIC_SHPHLD_CFG, 0);
	out = pw_find(RHW_EV_PMIC_VBUS, cfg);
	zassert_true(cfg >= 0 && out > cfg, "VBUS removed after the configuration");
	zassert_equal(pw_ev(out).a0, 0);
	task = pw_find(RHW_EV_PMIC_SHIP, 0);
	zassert_true(task > out, "the task was written after VBUS went (entry %d, VBUS entry %d)", task, out);
	zassert_equal(pw_ev(task).a0, 0, "VBUS absent at the task");
	zassert_true(only_kinds(cfg + 1, out, RHW_EV_PMIC_SHPHLD_STROBE, RHW_EV_PMIC_SHPHLD_STROBE),
		     "while it waits the ring does nothing else");
	zassert_true(pw_ev(task).t_us - pw_ev(cfg).t_us >= 690000, "it waited for the removal");

	/* the step machine: with VBUS present it keeps answering "wait", after the two writes of step 2 */
	{
		struct rpwl_ship s;

		rpwl_ship_reset(&s);
		(void)rpwl_ship_next(&s, true);
		(void)rpwl_ship_next(&s, true);
		zassert_equal(rpwl_ship_next(&s, true), RPWL_SHIP_WAIT_VBUS);
		zassert_equal(rpwl_ship_next(&s, true), RPWL_SHIP_WAIT_VBUS, "keeps waiting while VBUS is present");
		zassert_equal(rpwl_ship_next(&s, false), RPWL_SHIP_BEFORE_TASK, "task only after VBUS went");
	}

	/* part B */
	pw_before(NULL);
	pw_script1(3900, 0);
	pw_start();
	rhw_sim_log_clear();
	memset(&cap, 0, sizeof(cap));
	t = k_uptime_get();
	zassert_equal(rpw_ship(hook_vbus_back), -ETIMEDOUT);
	task = pw_find(RHW_EV_PMIC_SHIP, 0);
	zassert_true(task >= 0);
	zassert_equal(pw_ev(task).a0, 1, "the first task met VBUS: the simulated chip stays up");
	out = pw_find(RHW_EV_PMIC_VBUS, task);
	zassert_true(out > task && pw_ev(out).a0 == 0, "VBUS removed after the first task");
	task2 = pw_find(RHW_EV_PMIC_SHIP, task + 1);
	zassert_true(task2 > out, "the second task waited for VBUS removed (entry %d, VBUS entry %d)", task2, out);
	zassert_equal(pw_ev(task2).a0, 0, "VBUS absent at the second task");
	zassert_equal(rhw_sim_log_count_kind(RHW_EV_PMIC_SHIP), 2, "two tasks, no third");
	zassert_equal(pw_log_count(RREC_LOG_SHIP_RETRY), 1);
	zassert_within(cap.log[0].t_ms - pw_ev(task).t_us / 1000, 1000, 2, "the retry is logged 1 s after the first task");
	zassert_equal(rhw_sim_log_count_kind(RHW_EV_PMIC_SAMPLE), 0, "no sample while it waits");
}

/* FW l.941: still running 1 s after the task: log, back to step 3 once. No VBUS: the retry's task is refused by
 * the simulated chip (no supply); the call returns -ETIMEDOUT after the second try, 2 s after the first task. */
ZTEST(power_ship, test_retry_once_after_1s)
{
	int32_t task, refused;
	int64_t t_start, t_end;

	pw_start();
	rhw_sim_log_clear();
	t_start = k_uptime_get();
	zassert_equal(rpw_ship(NULL), -ETIMEDOUT);
	t_end = k_uptime_get();
	task = pw_find(RHW_EV_PMIC_SHIP, 0);
	zassert_true(task >= 0);
	zassert_equal(pw_log_count(RREC_LOG_SHIP_RETRY), 1, "one retry record");
	zassert_equal(cap.log[0].code, 0x0250);
	zassert_equal(cap.log[0].n, 1);
	zassert_equal(cap.log[0].args[0], 1, "try 1");
	zassert_within(cap.log[0].t_ms - pw_ev(task).t_us / 1000, 1000, 2, "logged 1 s after the task");
	refused = pw_find(RHW_EV_SHIP_REFUSED, task);
	zassert_true(refused > task, "the second task was tried");
	zassert_equal(pw_ev(refused).a0, RHW_EV_PMIC_SHIP, "what was refused is the task");
	zassert_within(pw_ev(refused).t_us - pw_ev(task).t_us, 1000000, 2000, "the retry comes 1 s after");
	zassert_equal(rhw_sim_log_count_kind(RHW_EV_PMIC_SHIP), 1);
	zassert_equal(rhw_sim_log_count_kind(RHW_EV_SHIP_REFUSED), 1, "once, not more");
	zassert_within(t_end - t_start, 2000, 20, "two tries of 1 s each");
}

/* FW l.939: only the factory commands reach step 3 with VBUS present; every row into OFF starts without VBUS.
 * Without VBUS the call never waits: the three writes come in the same instant. */
ZTEST(power_ship, test_off_never_waits)
{
	int32_t cfg, task;

	pw_start();
	rhw_sim_log_clear();
	zassert_equal(rpw_ship(NULL), -ETIMEDOUT);
	cfg = pw_find(RHW_EV_PMIC_SHPHLD_CFG, 0);
	task = pw_find(RHW_EV_PMIC_SHIP, cfg);
	zassert_true(cfg >= 0 && task > cfg);
	zassert_true(pw_ev(task).t_us - pw_ev(cfg).t_us < 10000, "no wait before the task");
	zassert_true(only_kinds(cfg + 1, task, RHW_EV_PMIC_SHPHLD_STROBE, RHW_EV_PMIC_SHPHLD_STROBE));
}
```
