## CMakeLists.txt
```
cmake_minimum_required(VERSION 3.20.0)

# RING_RHW_DIR and RING_SYS_DIR let a run point at a broken copy of ring_rhw or ring_sys to prove that these tests can
# fail (broken_run.sh). ring_time (existing) is added because the saved-time test checks that the guess never reaches
# the clock.
if(NOT DEFINED RING_RHW_DIR)
  set(RING_RHW_DIR ${CMAKE_CURRENT_SOURCE_DIR}/../../modules/ring_rhw)
endif()
if(NOT DEFINED RING_SYS_DIR)
  set(RING_SYS_DIR ${CMAKE_CURRENT_SOURCE_DIR}/../../modules/ring_sys)
endif()
set(RING_TIME_DIR ${CMAKE_CURRENT_SOURCE_DIR}/../../modules/ring_time)
list(APPEND ZEPHYR_EXTRA_MODULES ${RING_RHW_DIR} ${RING_SYS_DIR} ${RING_TIME_DIR})

find_package(Zephyr REQUIRED HINTS $ENV{ZEPHYR_BASE})
project(ring_sys_tests)

# rsy_logic.h and rsy_int.h are the unit's own (not public) headers: taken from the same copy as the code.
target_include_directories(app PRIVATE ${RING_SYS_DIR}/src ${CMAKE_CURRENT_SOURCE_DIR}/src)

target_sources(app PRIVATE
  src/common.c
  src/test_update.c
  src/test_time.c
  src/test_persist.c
  src/test_crash.c
  src/test_wdt.c)
```

## prj.conf
```kconfig
CONFIG_ZTEST=y
CONFIG_RING_RHW=y
CONFIG_RING_RHW_SIM=y
CONFIG_RING_SYS=y
CONFIG_RING_TIME=y
CONFIG_THREAD_NAME=y
CONFIG_ZTEST_STACK_SIZE=8192
```

## boards/native_sim.conf
```kconfig
# Kernel ticks of 0.1 ms so that the timing cases measure the simulated drivers, not a 10 ms tick (as in tests/audio)
CONFIG_SYS_CLOCK_TICKS_PER_SEC=10000
```

## src/common.c
```c
#include "common.h"

static struct t_logged logged[T_LOG_MAX];
static int nlogged;

void t_log_fn(uint16_t code, const uint8_t *args, size_t nargs)
{
	if (nlogged < T_LOG_MAX) {
		logged[nlogged].code = code;
		logged[nlogged].n = nargs;
		memset(logged[nlogged].args, 0, sizeof(logged[nlogged].args));
		memcpy(logged[nlogged].args, args, nargs < RREC_LOG_ARG_BYTES ? nargs : RREC_LOG_ARG_BYTES);
	}
	nlogged++;
}

void t_log_reset(void)
{
	nlogged = 0;
}

int t_nlog(void)
{
	return nlogged;
}

const struct t_logged *t_log_at(int i)
{
	return &logged[i];
}

void t_init(void)
{
	rhw_sim_reset();
	t_log_reset();
	zassert_equal(rsy_init(t_log_fn), 0, "rsy_init");
}

void t_cleanup(void)
{
	rhw_sim_reboot();
	rhw_sim_reset();
	t_log_reset();
}

void t_next_boot(void)
{
	rhw_sim_reboot();
	t_log_reset();
	zassert_equal(rsy_init(t_log_fn), 0, "rsy_init after reboot");
}

int32_t ev_find(uint16_t kind, uint32_t from)
{
	return rhw_sim_log_find(kind, from);
}

uint32_t ev_count(uint16_t kind)
{
	return rhw_sim_log_count_kind(kind);
}

bool ev_get(int32_t i, struct rhw_sim_ev *e)
{
	return i >= 0 && rhw_sim_log_get((uint32_t)i, e);
}

void t_fill(uint8_t *p, size_t n, uint8_t seed)
{
	for (size_t i = 0; i < n; i++) {
		p[i] = (uint8_t)(seed + 7u * i + (i >> 8));
	}
}
```

## src/common.h
```c
/* Helpers shared by the suites of tests/sys (software step 6, unit U7). Every expected value in the suites is a literal
 * written from design/firmware.md (the line is cited at each case), never produced by the code under test. */
#ifndef SYS_TEST_COMMON_H
#define SYS_TEST_COMMON_H

#include <errno.h>
#include <string.h>

#include <zephyr/kernel.h>
#include <zephyr/sys/crc.h>
#include <zephyr/ztest.h>

#include <ring_rhw/rhw.h>
#include <ring_rhw/rhw_sim.h>
#include <ring_sys/rsy.h>

#include "rsy_int.h"
#include "rsy_logic.h"

/* the log records the unit wrote through its hook */
#define T_LOG_MAX 16
struct t_logged {
	uint16_t code;
	uint8_t args[RREC_LOG_ARG_BYTES];
	size_t n;
};
void t_log_reset(void);
int t_nlog(void);
const struct t_logged *t_log_at(int i);
void t_log_fn(uint16_t code, const uint8_t *args, size_t nargs);

/* rhw_sim_reset(), the captured log emptied, then rsy_init(t_log_fn) */
void t_init(void);
/* rhw_sim_reboot() (the unit's reboot hook clears its RAM state and cancels its work), then rhw_sim_reset() */
void t_cleanup(void);
/* a simulated reboot of the ring followed by rsy_init(t_log_fn): the next boot */
void t_next_boot(void);

/* event log helpers */
int32_t ev_find(uint16_t kind, uint32_t from);
uint32_t ev_count(uint16_t kind);
bool ev_get(int32_t i, struct rhw_sim_ev *e);

/* a deterministic byte pattern */
void t_fill(uint8_t *p, size_t n, uint8_t seed);

#endif
```

## src/crash_expect.h
```c
/* generated by build-logs/step6/u7-gen-crash-expect.py: the stored crash block for reason 4, pc 0x0001A2B4,
 * lr 0x0001A2B5, psr 0x61000000, thread "audio", stack word i = 0xA5000000 + i. CRC-32 over bytes 0..291: 0x50B8D35F */
static const uint8_t crash_expect[296] = {
	0x43, 0x52, 0x53, 0x48, 0x04, 0x00, 0x00, 0x00, 0xB4, 0xA2, 0x01, 0x00,
	0xB5, 0xA2, 0x01, 0x00, 0x00, 0x00, 0x00, 0x61, 0x61, 0x75, 0x64, 0x69,
	0x6F, 0x00, 0x00, 0x00, 0x00, 0x00, 0x00, 0x00, 0x00, 0x00, 0x00, 0x00,
	0x00, 0x00, 0x00, 0xA5, 0x01, 0x00, 0x00, 0xA5, 0x02, 0x00, 0x00, 0xA5,
	0x03, 0x00, 0x00, 0xA5, 0x04, 0x00, 0x00, 0xA5, 0x05, 0x00, 0x00, 0xA5,
	0x06, 0x00, 0x00, 0xA5, 0x07, 0x00, 0x00, 0xA5, 0x08, 0x00, 0x00, 0xA5,
	0x09, 0x00, 0x00, 0xA5, 0x0A, 0x00, 0x00, 0xA5, 0x0B, 0x00, 0x00, 0xA5,
	0x0C, 0x00, 0x00, 0xA5, 0x0D, 0x00, 0x00, 0xA5, 0x0E, 0x00, 0x00, 0xA5,
	0x0F, 0x00, 0x00, 0xA5, 0x10, 0x00, 0x00, 0xA5, 0x11, 0x00, 0x00, 0xA5,
	0x12, 0x00, 0x00, 0xA5, 0x13, 0x00, 0x00, 0xA5, 0x14, 0x00, 0x00, 0xA5,
	0x15, 0x00, 0x00, 0xA5, 0x16, 0x00, 0x00, 0xA5, 0x17, 0x00, 0x00, 0xA5,
	0x18, 0x00, 0x00, 0xA5, 0x19, 0x00, 0x00, 0xA5, 0x1A, 0x00, 0x00, 0xA5,
	0x1B, 0x00, 0x00, 0xA5, 0x1C, 0x00, 0x00, 0xA5, 0x1D, 0x00, 0x00, 0xA5,
	0x1E, 0x00, 0x00, 0xA5, 0x1F, 0x00, 0x00, 0xA5, 0x20, 0x00, 0x00, 0xA5,
	0x21, 0x00, 0x00, 0xA5, 0x22, 0x00, 0x00, 0xA5, 0x23, 0x00, 0x00, 0xA5,
	0x24, 0x00, 0x00, 0xA5, 0x25, 0x00, 0x00, 0xA5, 0x26, 0x00, 0x00, 0xA5,
	0x27, 0x00, 0x00, 0xA5, 0x28, 0x00, 0x00, 0xA5, 0x29, 0x00, 0x00, 0xA5,
	0x2A, 0x00, 0x00, 0xA5, 0x2B, 0x00, 0x00, 0xA5, 0x2C, 0x00, 0x00, 0xA5,
	0x2D, 0x00, 0x00, 0xA5, 0x2E, 0x00, 0x00, 0xA5, 0x2F, 0x00, 0x00, 0xA5,
	0x30, 0x00, 0x00, 0xA5, 0x31, 0x00, 0x00, 0xA5, 0x32, 0x00, 0x00, 0xA5,
	0x33, 0x00, 0x00, 0xA5, 0x34, 0x00, 0x00, 0xA5, 0x35, 0x00, 0x00, 0xA5,
	0x36, 0x00, 0x00, 0xA5, 0x37, 0x00, 0x00, 0xA5, 0x38, 0x00, 0x00, 0xA5,
	0x39, 0x00, 0x00, 0xA5, 0x3A, 0x00, 0x00, 0xA5, 0x3B, 0x00, 0x00, 0xA5,
	0x3C, 0x00, 0x00, 0xA5, 0x3D, 0x00, 0x00, 0xA5, 0x3E, 0x00, 0x00, 0xA5,
	0x3F, 0x00, 0x00, 0xA5, 0x5F, 0xD3, 0xB8, 0x50,
};
```

## src/test_crash.c
```c
/* Suite sys_crash (software step 6, unit U7): crash capture (FW l.1063) on the simulated retained memory. Row T28 of the
 * plan. The handler on the real chip and retained RAM across a real reset are not provable without hardware. */
#include "common.h"

#include <zephyr/fatal.h>

#include "crash_expect.h"

static void before(void *f)
{
	ARG_UNUSED(f);
	rhw_sim_reset();
}

static void after(void *f)
{
	ARG_UNUSED(f);
	t_cleanup();
}

ZTEST_SUITE(sys_crash, NULL, NULL, before, after, NULL);

static uint32_t words64[64];

static void fill_words(void)
{
	for (uint32_t i = 0; i < 64u; i++) {
		words64[i] = 0xA5000000u + i;
	}
}

/* K11 compile test: the kit's declaration of the handler we override has this signature (a different one is a compile
 * error here). */
_Static_assert(__builtin_types_compatible_p(__typeof__(k_sys_fatal_error_handler),
					    void(unsigned int, const struct arch_esf *)),
	       "k_sys_fatal_error_handler signature differs from the one ring_sys overrides");

ZTEST(sys_crash, test_handler_signature_matches_kit)
{
	void (*p)(unsigned int, const struct arch_esf *) = k_sys_fatal_error_handler;

	zassert_not_null(p);
}

/* T28, FW l.1063: the crash block is reason u32, PC u32, LR u32, PSR u32, thread name 16 bytes, 64 stack words (288
 * bytes) in retained RAM; the unit adds its magic in front and a CRC-32 behind (296 bytes). Expected bytes are typed in
 * crash_expect.h from the layout by an independent script. */
ZTEST(sys_crash, test_block_format)
{
	uint8_t raw[RREC_RETAINED_BYTES];

	t_init();
	fill_words();
	zassert_equal(rsy_crash_capture(4u, 0x0001A2B4u, 0x0001A2B5u, 0x61000000u, "audio", words64, 64u), 0);
	rhw_sim_retained_get(raw, sizeof(raw));
	zassert_mem_equal(raw, crash_expect, sizeof(crash_expect), "the stored block equals the typed bytes");
	for (size_t i = sizeof(crash_expect); i < sizeof(raw); i++) {
		zassert_equal(raw[i], 0, "retained byte %u past the block is untouched", (unsigned)i);
	}
	zassert_equal(sizeof(crash_expect), 4u + RREC_CRASH_BLOCK_BYTES + 4u);
	zassert_equal(RREC_CRASH_BLOCK_BYTES, 288u, "4 x 4 + 16 + 64 x 4 (FW l.1063)");

	/* a thread name longer than 15 characters is cut so that it stays NUL-terminated; fewer than 64 words: the rest zero;
	 * more than 64: only 64 are kept */
	rhw_sim_reset();
	zassert_equal(rsy_crash_capture(3u, 1u, 2u, 3u, "abcdefghijklmnopqrstuvwxyz", words64, 10u), 0);
	rhw_sim_retained_get(raw, sizeof(raw));
	zassert_mem_equal(raw + 4 + 16, "abcdefghijklmno", 15, "name cut to 15 characters");
	zassert_equal(raw[4 + 16 + 15], 0, "name ends with NUL");
	for (uint32_t i = 0; i < 64u; i++) {
		uint32_t w = (uint32_t)raw[4 + 32 + 4 * i] | ((uint32_t)raw[4 + 33 + 4 * i] << 8) |
			     ((uint32_t)raw[4 + 34 + 4 * i] << 16) | ((uint32_t)raw[4 + 35 + 4 * i] << 24);

		zassert_equal(w, i < 10u ? 0xA5000000u + i : 0u, "stack word %u", i);
	}
	rhw_sim_reset();
	zassert_equal(rsy_crash_capture(3u, 1u, 2u, 3u, NULL, words64, 200u), 0);
	rhw_sim_retained_get(raw, sizeof(raw));
	zassert_equal(raw[4 + 16], '?', "no thread name: ?");
	TC_PRINT("EVIDENCE sys_crash format: %u stored bytes equal the typed block (crc word %02X%02X%02X%02X)\n",
		 (unsigned)sizeof(crash_expect), crash_expect[295], crash_expect[294], crash_expect[293], crash_expect[292]);
}

/* T28, FW l.1063: BOOT copies a valid crash block into the log and clears it: the copy happens once; gpregret1 is given
 * back with it and cleared too. */
ZTEST(sys_crash, test_boot_copies_valid_block_once)
{
	struct rrec_crash c;
	uint8_t gp = 0xEE;
	uint8_t raw[RREC_RETAINED_BYTES];

	t_init();
	fill_words();
	zassert_equal(rsy_crash_capture(4u, 0x0001A2B4u, 0x0001A2B5u, 0x61000000u, "audio", words64, 64u), 0);
	zassert_equal(rhw_retained()->gpregret1_set(4u), 0);
	t_next_boot();                       /* the reboot after the crash */
	memset(&c, 0, sizeof(c));
	zassert_equal(rsy_crash_take(&c, &gp), 1, "a valid block is found at boot");
	zassert_equal(c.reason, 4u);
	zassert_equal(c.pc, 0x0001A2B4u);
	zassert_equal(c.lr, 0x0001A2B5u);
	zassert_equal(c.psr, 0x61000000u);
	zassert_mem_equal(c.thread, "audio", 6);
	for (uint32_t i = 0; i < 64u; i++) {
		zassert_equal(c.stack[i], 0xA5000000u + i, "stack word %u", i);
	}
	zassert_equal(gp, 4u, "gpregret1 handed back");
	rhw_sim_retained_get(raw, sizeof(raw));
	for (size_t i = 0; i < sizeof(raw); i++) {
		zassert_equal(raw[i], 0, "retained byte %u cleared", (unsigned)i);
	}
	zassert_equal(rhw_sim_gpregret1_get(), 0, "gpregret1 cleared");
	/* once: the next boot finds nothing */
	zassert_equal(rsy_crash_take(&c, &gp), 0, "the block is not copied a second time");
	t_next_boot();
	zassert_equal(rsy_crash_take(&c, &gp), 0, "nor at the boot after");
	TC_PRINT("EVIDENCE sys_crash once: first take 1, second take 0, retained cleared, gpregret1 %u\n",
		 rhw_sim_gpregret1_get());
}

/* T28: power-up garbage and damaged blocks are not valid: nothing is returned and nothing is touched. */
ZTEST(sys_crash, test_invalid_block_ignored)
{
	struct rrec_crash c;
	uint8_t gp = 0xEE;
	uint8_t raw[RREC_RETAINED_BYTES];

	t_init();
	memset(&c, 0x5A, sizeof(c));
	zassert_equal(rsy_crash_take(&c, &gp), 0, "blank retained memory: no block");
	memset(raw, 0xFF, sizeof(raw));
	rhw_sim_retained_set(raw, sizeof(raw));
	zassert_equal(rsy_crash_take(&c, &gp), 0, "all 0xFF: no block");
	for (size_t bad = 0; bad < 4; bad++) {
		static const size_t where[4] = { 0, 4, 100, 292 };   /* magic, reason, a stack word, the CRC */

		rhw_sim_retained_set(crash_expect, sizeof(crash_expect));
		rhw_sim_retained_get(raw, sizeof(raw));
		raw[where[bad]] ^= 0x01;
		rhw_sim_retained_set(raw, sizeof(raw));
		zassert_equal(rsy_crash_take(&c, &gp), 0, "one flipped bit at byte %u: not valid", (unsigned)where[bad]);
	}
	zassert_equal(gp, 0xEE, "gpregret1 output untouched when no block is valid");
	zassert_equal(c.reason, 0x5A5A5A5Au, "the output block untouched when no block is valid");
	zassert_equal(ev_count(RHW_EV_RET_CLEAR), 0u, "an invalid area is left as it is");
	zassert_equal(rsy_crash_take(NULL, &gp), 0, "no output: nothing taken");
	/* the intact block is still valid and is taken (gp output may be NULL) */
	rhw_sim_retained_set(crash_expect, sizeof(crash_expect));
	zassert_equal(rsy_crash_take(&c, NULL), 1);
	TC_PRINT("EVIDENCE sys_crash invalid: blank, 0xFF and 4 damaged blocks all rejected, retained clears %u\n",
		 (unsigned)ev_count(RHW_EV_RET_CLEAR));
}

/* T28, FW l.1063: the fatal path writes the block, puts the reason code into gpregret1, then reboots (in this order). */
ZTEST(sys_crash, test_fatal_path_order)
{
	struct rrec_crash c;
	uint8_t gp = 0;

	t_init();
	rsy_fatal(4u, NULL);
	int32_t w = ev_find(RHW_EV_RET_WRITE, 0);
	int32_t g = ev_find(RHW_EV_GPREG_SET, 0);
	int32_t r = ev_find(RHW_EV_IMG_REBOOT, 0);

	zassert_true(w >= 0 && g > w && r > g, "order: block %d, gpregret1 %d, reboot %d", w, g, r);
	zassert_equal(rhw_sim_gpregret1_get(), 4u, "reason code in gpregret1");
	zassert_equal(rhw_sim_image_last_reboot(), 6, "reboot reason CRASH (6)");
	t_next_boot();
	zassert_equal(rsy_crash_take(&c, &gp), 1, "the block written by the fatal path is valid at the next boot");
	zassert_equal(c.reason, 4u);
	zassert_equal(c.pc, 0u, "no exception frame: registers 0");
	zassert_equal(gp, 4u);
	/* when the retained write fails (the chip is already gone: every call is refused) the path still ends in a reboot request
	 * and does not hang */
	t_cleanup();
	t_init();
	zassert_equal(rhw_pmic()->ship_task(), 0);
	rsy_fatal(4u, NULL);
	zassert_equal(ev_count(RHW_EV_IMG_REBOOT), 0u, "refused calls are not counted as reboots");
	zassert_true(rhw_sim_ship_refused() >= 3u, "the three calls of the path were made and refused (%u)",
		     (unsigned)rhw_sim_ship_refused());
	TC_PRINT("EVIDENCE sys_crash fatal path: block %d < gpregret1 %d < reboot %d, reboot reason %d\n", w, g, r, 6);
}
```

## src/test_persist.c
```c
/* Suite sys_persist (software step 6, unit U7): the persistent settings, the factory flag (FW l.1019) and the way saved
 * values keep each other. Row T11 (the ring's part) of the plan. */
#include "common.h"

static void before(void *f)
{
	ARG_UNUSED(f);
	rhw_sim_reset();
}

static void after(void *f)
{
	ARG_UNUSED(f);
	t_cleanup();
}

ZTEST_SUITE(sys_persist, NULL, NULL, before, after, NULL);

/* T11, FW l.1019: the flag is written when the factory programs the ring (assembly step 5: the settings hold 1), and
 * cleared only by SHIP_ENTER; it survives reboots; a cleared flag stays cleared. */
ZTEST(sys_persist, test_factory_flag_survives_reboot)
{
	struct rhw_persist seed = { .factory_flag = 1 };
	struct rhw_persist p;

	/* before the first init the flag is clear (nothing loaded) */
	rhw_sim_reset();
	zassert_false(rsy_factory_flag(), "no flag before rsy_init");
	rhw_sim_persist_set(&seed);        /* the factory's programming */
	zassert_equal(rsy_init(t_log_fn), 0);
	zassert_true(rsy_factory_flag(), "flag 1 read from the settings");
	t_next_boot();
	zassert_true(rsy_factory_flag(), "flag still 1 after a reboot");
	t_next_boot();
	zassert_true(rsy_factory_flag(), "flag still 1 after a second reboot");
	/* SHIP_SAMPLE keeps it: the join then only saves the time */
	zassert_equal(rsy_time_save(1794513600000, 60, true), 0);
	t_next_boot();
	zassert_true(rsy_factory_flag(), "saving the time keeps the flag");
	/* SHIP_ENTER clears it */
	zassert_equal(rsy_factory_flag_set(false), 0);
	zassert_false(rsy_factory_flag(), "cleared at once");
	rhw_sim_persist_get(&p);
	zassert_equal(p.factory_flag, 0, "cleared in the settings");
	zassert_true(p.time_saved, "clearing the flag keeps the saved time");
	zassert_equal(p.saved_utc_ms, 1794513600000);
	t_next_boot();
	zassert_false(rsy_factory_flag(), "a cleared flag stays cleared after a reboot");
	int64_t g = 0;

	zassert_true(rsy_time_guess(&g), "the saved time survived the flag write");
	zassert_equal(g, 1794513600000);
	/* the flag can be set again through the settings (factory programming of a sample ring) and is kept */
	zassert_equal(rsy_factory_flag_set(true), 0);
	t_next_boot();
	zassert_true(rsy_factory_flag());
	/* a failing settings write (ship mode already entered: every call refused) is an error and the flag stays as it was */
	zassert_equal(rhw_pmic()->ship_task(), 0);
	zassert_not_equal(rsy_factory_flag_set(false), 0, "a failed write is reported");
	zassert_true(rsy_factory_flag(), "the flag is unchanged after a failed write");
	TC_PRINT("EVIDENCE sys_persist flag: 1 over 3 reboots, cleared by the write, clear over 1 reboot, write errors reported\n");
}

/* A blank settings area reads all zero: no flag, no saved time. */
ZTEST(sys_persist, test_blank_settings_read_as_clear)
{
	int64_t g = 7;

	t_init();
	zassert_false(rsy_factory_flag());
	zassert_false(rsy_time_guess(&g));
	zassert_equal(g, 7);
	zassert_equal(ev_count(RHW_EV_PERSIST_LOAD), 1u, "one settings read at init");
	zassert_equal(ev_count(RHW_EV_PERSIST_SAVE), 0u, "init writes nothing");
}
```

## src/test_time.c
```c
/* Suite sys_time (software step 6, unit U7): the saved time (FW l.1005, ruling D18). Row T4 of the plan.
 * The time is saved on entry into SHIP and OFF (the join calls rsy_time_save); after the next boot it is a guess that the
 * join writes once into the event log and that is used nowhere else: the ring's clock stays "not set" (utc_ms 0, chunk
 * flag bit 5, "--:--") until SET_TIME. */
#include "common.h"

#include <ring_time/rtime.h>

static void before(void *f)
{
	ARG_UNUSED(f);
	rhw_sim_reset();
}

static void after(void *f)
{
	ARG_UNUSED(f);
	t_cleanup();
}

ZTEST_SUITE(sys_time, NULL, NULL, before, after, NULL);

/* T4: entry into SHIP saves the time, and so does entry into OFF; the next boot finds the last one saved. */
ZTEST(sys_time, test_saved_on_ship_and_off)
{
	int64_t g = -1;
	struct rhw_persist p;

	t_init();
	zassert_false(rsy_time_guess(&g), "nothing saved yet: no guess");
	zassert_equal(g, -1, "no guess leaves *utc_ms alone");
	/* entry into SHIP: 2026-11-13 08:00:00 UTC (1,794,513,600,000 ms), zone +60 min, zone known */
	zassert_equal(rsy_time_save(1794513600000, 60, true), 0);
	rhw_sim_persist_get(&p);
	zassert_true(p.time_saved);
	zassert_equal(p.saved_utc_ms, 1794513600000);
	zassert_equal(p.saved_tz_min, 60);
	zassert_true(p.saved_zone_known);
	zassert_equal(ev_count(RHW_EV_PERSIST_SAVE), 1u, "one settings write for the save");
	t_next_boot();
	zassert_true(rsy_time_guess(&g), "after the next boot the saved time is there as a guess");
	zassert_equal(g, 1794513600000);
	/* entry into OFF later: the newer time replaces it; zone unknown this time */
	zassert_equal(rsy_time_save(1794600000123, -330, false), 0);
	t_next_boot();
	zassert_true(rsy_time_guess(&g));
	zassert_equal(g, 1794600000123, "the last time saved wins");
	rhw_sim_persist_get(&p);
	zassert_equal(p.saved_tz_min, -330);
	zassert_false(p.saved_zone_known);
	/* a clock that is not set (utc_ms 0) has no time to save: an older saved time is cleared, not kept as a wrong guess */
	zassert_equal(rsy_time_save(0, 0, false), 0);
	t_next_boot();
	zassert_false(rsy_time_guess(&g), "a not-set clock saves no time");
	/* and with nothing saved before, saving a not-set clock writes nothing */
	uint32_t w = ev_count(RHW_EV_PERSIST_SAVE);

	zassert_equal(rsy_time_save(0, 0, false), 0);
	zassert_equal(ev_count(RHW_EV_PERSIST_SAVE), w, "nothing to clear, nothing written");
	/* a settings write that fails (the chip is already in ship mode: every call is refused) is reported */
	zassert_equal(rsy_time_save(1794600000123, 0, true), 0);
	zassert_equal(rhw_pmic()->ship_task(), 0);
	zassert_true(rhw_sim_shipped());
	zassert_not_equal(rsy_time_save(1794600009999, 0, true), 0, "a failed settings write is an error");
	TC_PRINT("EVIDENCE sys_time saved: saved at SHIP and at OFF, the later one found after the reboot (%lld), settings writes %u\n",
		 (long long)1794600000123, (unsigned)ev_count(RHW_EV_PERSIST_SAVE));
}

/* T4, ruling D18: the guess is not the time. After a boot with a saved time the clock is still not set, reads utc_ms 0, and
 * nothing in this unit changed it. (A copy that marks the guess as set calls rtime_set and fails here.) */
ZTEST(sys_time, test_guess_is_not_set)
{
	int64_t g = 0;
	uint32_t upd0 = rtime_updates();

	t_init();
	zassert_equal(rsy_time_save(1794513600000, 60, true), 0);
	t_next_boot();
	zassert_true(rsy_time_guess(&g));
	zassert_equal(g, 1794513600000, "the guess itself is available for the log");
	zassert_false(rtime_is_set(), "the clock is not set by a guess");
	zassert_equal(rtime_utc_ms(), 0, "utc_ms reads 0 (not set)");
	zassert_false(rtime_zone_known(), "no zone is known from a guess");
	zassert_equal(rtime_updates(), upd0, "nothing was written to the clock");
	/* asking again gives the same guess and still does not set anything */
	int64_t g2 = 0;

	zassert_true(rsy_time_guess(&g2));
	zassert_equal(g2, g);
	zassert_false(rtime_is_set());
	zassert_equal(rtime_utc_ms(), 0);
	TC_PRINT("EVIDENCE sys_time guess: guess %lld, rtime_is_set %d, rtime_utc_ms %lld, clock updates %u -> %u\n",
		 (long long)g, (int)rtime_is_set(), (long long)rtime_utc_ms(), (unsigned)upd0, (unsigned)rtime_updates());
}
```

## src/test_update.c
```c
/* Suite sys_update (software step 6, unit U7): the firmware update over USB (FW 9.2) and its 30 s self-test, on the
 * simulated image store. Rows T5, T6, T8, T9, T10 of the plan. Expected values are literals written from
 * design/firmware.md (lines cited), never computed by the code under test. Time is the kernel's simulated time. */
#include "common.h"

static uint8_t img[32768];
static uint8_t back[3u * 4096u + 17u];

static void before(void *f)
{
	ARG_UNUSED(f);
	rhw_sim_reset();
}

static void after(void *f)
{
	ARG_UNUSED(f);
	t_cleanup();
}

ZTEST_SUITE(sys_update, NULL, NULL, before, after, NULL);

static bool img_write_ok_and_inside(const struct rhw_sim_ev *e)
{
	return e->res == 0 && e->a0 >= 0 && e->a1 >= 0 && e->a0 + e->a1 <= 999424;
}

/* T5, FW l.1010: the flash layout, typed from the line: MCUboot 64 KB at 0x00000000, slot 0 976 KB at 0x00010000, slot 1
 * 976 KB at 0x00104000, settings 20 KB at 0x001F8000, 2,036 KB in total (64 + 976 + 976 + 20). Not provable: the swap. */
ZTEST(sys_update, test_layout_sums_to_2036_kb)
{
	zassert_equal(RREC_FLASH_MCUBOOT_ADDR, 0x00000000u);
	zassert_equal(RREC_FLASH_MCUBOOT_BYTES, 65536u);
	zassert_equal(RREC_FLASH_SLOT0_ADDR, 0x00010000u);
	zassert_equal(RREC_FLASH_SLOT_BYTES, 999424u);
	zassert_equal(RREC_FLASH_SLOT1_ADDR, 0x00104000u);
	zassert_equal(RREC_FLASH_SETTINGS_ADDR, 0x001F8000u);
	zassert_equal(RREC_FLASH_SETTINGS_BYTES, 20480u);
	zassert_equal(RREC_FLASH_TOTAL_BYTES, 2084864u);   /* 2,036 x 1,024 */
	zassert_equal(RREC_FLASH_MCUBOOT_BYTES + 2u * RREC_FLASH_SLOT_BYTES + RREC_FLASH_SETTINGS_BYTES,
		      2036u * 1024u);
	/* slot 1 ends where the settings begin, slot 0 ends where slot 1 begins (0x00104000 + 976 x 1,024 = 0x001F8000) */
	zassert_equal(RREC_FLASH_SLOT0_ADDR + RREC_FLASH_SLOT_BYTES, RREC_FLASH_SLOT1_ADDR);
	zassert_equal(RREC_FLASH_SLOT1_ADDR + RREC_FLASH_SLOT_BYTES, RREC_FLASH_SETTINGS_ADDR);
	zassert_equal(RREC_IMAGE_MAX_BYTES, 999424u);      /* FW l.1012: 976 KB = 999,424 bytes */
	zassert_equal(RREC_SELFTEST_MS, 30000u);           /* FW l.1014 */
	TC_PRINT("EVIDENCE sys_update layout: sum %u KB, image max %u bytes\n",
		 (unsigned)(RREC_FLASH_TOTAL_BYTES / 1024u), (unsigned)RREC_IMAGE_MAX_BYTES);
}

/* T6, FW l.1012 rule 1: FW_BEGIN refuses an image_size above 999,424 bytes with BAD_ARG (4); 999,424 is accepted. */
ZTEST(sys_update, test_size_limit)
{
	t_init();
	zassert_equal(rsy_fw_begin(999425u, 0u, 1000u, true), 4, "999,425 bytes refused with BAD_ARG");
	zassert_equal(rsy_fw_begin(0u, 0u, 1000u, true), 4, "size 0 refused with BAD_ARG");
	zassert_equal(rsy_fw_begin(4294967295u, 0u, 1000u, true), 4, "4,294,967,295 refused with BAD_ARG");
	zassert_equal(ev_count(RHW_EV_IMG_ERASE), 0u, "a refused FW_BEGIN erases nothing");
	/* a refused FW_BEGIN starts no update: FW_DATA is refused (BAD_ARG) */
	img[0] = 1;
	zassert_equal(rsy_fw_data(0u, img, 1u), 4, "no FW_BEGIN in force after a refusal");
	zassert_equal(rsy_fw_begin(999424u, 0u, 1000u, true), RREC_ST_OK, "999,424 bytes accepted");
	zassert_equal(ev_count(RHW_EV_IMG_ERASE), 1u, "the accepted FW_BEGIN erased slot 1");
	TC_PRINT("EVIDENCE sys_update size: 999424 -> OK, 999425 -> BAD_ARG(4), erases %u\n",
		 (unsigned)ev_count(RHW_EV_IMG_ERASE));
}

/* T6, FW l.1012 rule 1: FW_DATA refuses an offset plus length past the limit with BAD_ARG, and writes nothing then. */
ZTEST(sys_update, test_data_end_limit)
{
	t_init();
	t_fill(img, sizeof(img), 3);
	/* declared size 999,424: the last byte is at 999,423 */
	zassert_equal(rsy_fw_begin(999424u, 0u, 1000u, true), RREC_ST_OK);
	zassert_equal(rsy_fw_data(999324u, img, 100u), RREC_ST_OK, "end exactly at 999,424 accepted");
	uint32_t w = ev_count(RHW_EV_IMG_WRITE);

	zassert_equal(w, 1u);
	zassert_equal(rsy_fw_data(999324u, img, 101u), 4, "end at 999,425 refused (BAD_ARG)");
	zassert_equal(rsy_fw_data(999424u, img, 1u), 4, "offset 999,424 refused");
	zassert_equal(rsy_fw_data(4294967295u, img, 2u), 4, "a sum that wraps 32 bits is refused");
	zassert_equal(ev_count(RHW_EV_IMG_WRITE), w, "refused FW_DATA writes nothing");
	/* a smaller declared image: the end of the image is the limit */
	zassert_equal(rsy_fw_begin(8192u, 0u, 1000u, true), RREC_ST_OK);
	zassert_equal(rsy_fw_data(4096u, img, 4096u), RREC_ST_OK, "end exactly at 8,192 accepted");
	zassert_equal(rsy_fw_data(4096u, img, 4097u), 4, "end at 8,193 refused");
	zassert_equal(rsy_fw_data(8192u, img, 1u), 4, "offset 8,192 refused");
	zassert_equal(ev_count(RHW_EV_IMG_WRITE), w + 1u);
	/* FW_DATA without FW_BEGIN in force is refused */
	t_next_boot();
	zassert_equal(rsy_fw_data(0u, img, 16u), 4, "FW_DATA without FW_BEGIN: BAD_ARG");
	TC_PRINT("EVIDENCE sys_update data end: 999424 ok, 999425 BAD_ARG, 8192 ok, 8193 BAD_ARG\n");
}

/* T6, FW l.1012 rules 1 and 2: every write of the update path lands inside slot 1 at the offset the case sent (the
 * image store has no call for slot 0 or the MCUboot area); a write that goes to the wrong place is seen in the log. */
ZTEST(sys_update, test_writes_only_slot1)
{
	const uint32_t total = 3u * 4096u + 17u;

	t_init();
	t_fill(img, total, 9);
	zassert_equal(rsy_fw_begin(total, 0u, 1000u, true), RREC_ST_OK);
	for (uint32_t off = 0; off < total; off += 4096u) {
		uint32_t n = total - off < 4096u ? total - off : 4096u;

		zassert_equal(rsy_fw_data(off, img + off, n), RREC_ST_OK, "block at %u", off);
	}
	int32_t erase = ev_find(RHW_EV_IMG_ERASE, 0);
	uint32_t seen = 0;
	struct rhw_sim_ev e;

	zassert_true(erase >= 0, "slot 1 erased first");
	for (uint32_t i = 0; i < rhw_sim_log_count(); i++) {
		zassert_true(ev_get((int32_t)i, &e));
		if (e.kind != RHW_EV_IMG_WRITE) {
			continue;
		}
		zassert_true((int32_t)i > erase, "a write before the erase");
		zassert_true(img_write_ok_and_inside(&e), "write %u: offset %lld len %lld res %d outside slot 1 (999,424)",
			     seen, e.a0, e.a1, e.res);
		zassert_equal(e.a0, (int64_t)seen * 4096, "write %u at offset %lld", seen, e.a0);
		zassert_equal(e.a1, seen < 3u ? 4096 : 17, "write %u length %lld", seen, e.a1);
		seen++;
	}
	zassert_equal(seen, 4u, "four writes (3 x 4,096 + 17)");
	rhw_sim_image_peek(0u, back, total);
	zassert_mem_equal(back, img, total, "slot 1 holds the image at the offsets sent");
	TC_PRINT("EVIDENCE sys_update slot1: %u writes, all inside 0..999424 and at the offsets sent\n", (unsigned)seen);
}

/* T8, FW l.1013: FW_BEGIN erases slot 1; FW_DATA blocks; FW_END checks the CRC-32 and requests the test upgrade; the
 * reboot comes after the OK response and is the join's (not done by FW_END). Image "123456789": CRC-32 0xCBF43926. */
ZTEST(sys_update, test_sequence)
{
	static const uint8_t nine[9] = { '1', '2', '3', '4', '5', '6', '7', '8', '9' };
	uint32_t crc;

	t_init();
	zassert_equal(rsy_fw_begin(9u, 0xCBF43926u, 1000u, false), RREC_ST_OK);
	zassert_equal(rsy_fw_data(0u, nine, 9u), RREC_ST_OK);
	zassert_false(rhw_sim_image_upgrade_requested(), "no upgrade requested before FW_END");
	zassert_equal(rsy_fw_end(), RREC_ST_OK);
	zassert_true(rhw_sim_image_upgrade_requested(), "test upgrade requested after the CRC matched");
	int32_t er = ev_find(RHW_EV_IMG_ERASE, 0);
	int32_t wr = ev_find(RHW_EV_IMG_WRITE, 0);
	int32_t rd = ev_find(RHW_EV_IMG_READ, 0);
	int32_t rq = ev_find(RHW_EV_IMG_REQUEST, 0);

	zassert_true(er >= 0 && wr > er && rd > wr && rq > rd, "order erase %d, write %d, read-back %d, request %d", er, wr,
		     rd, rq);
	zassert_equal(rhw_sim_image_reboots(), 0u, "FW_END itself does not reboot");
	/* a second FW_DATA or FW_END without a new FW_BEGIN is refused */
	zassert_equal(rsy_fw_data(0u, nine, 9u), 4);
	zassert_equal(rsy_fw_end(), 10, "FW_END without FW_BEGIN: FW_ERROR");
	/* an image of several 4,096-byte blocks, its CRC from the library (the typed case above settles the library) */
	const uint32_t total = 5u * 4096u + 100u;

	t_fill(img, total, 21);
	crc = crc32_ieee(img, total);
	zassert_equal(rsy_fw_begin(total, crc, 1000u, true), RREC_ST_OK);
	for (uint32_t off = 0; off < total; off += 4096u) {
		zassert_equal(rsy_fw_data(off, img + off, total - off < 4096u ? total - off : 4096u), RREC_ST_OK);
	}
	zassert_equal(rsy_fw_end(), RREC_ST_OK, "a multi-block image checks out");
	zassert_equal(ev_count(RHW_EV_IMG_REQUEST), 2u);
	TC_PRINT("EVIDENCE sys_update sequence: erase %d < write %d < read %d < request %d, reboots by FW_END %u\n", er, wr,
		 rd, rq, (unsigned)rhw_sim_image_reboots());
}

/* T8: FW_END with a CRC that does not match answers FW_ERROR (10) and requests nothing. Outside answers: a write error
 * and a read-back that cannot be done are FW_ERROR too. */
ZTEST(sys_update, test_end_bad_crc_fw_error)
{
	static const uint8_t nine[9] = { '1', '2', '3', '4', '5', '6', '7', '8', '9' };
	static const uint8_t nine_bad[9] = { '1', '2', '3', '4', '5', '6', '7', '8', '0' };

	t_init();
	zassert_equal(rsy_fw_end(), 10, "FW_END without FW_BEGIN: FW_ERROR");
	/* wrong CRC announced */
	zassert_equal(rsy_fw_begin(9u, 0xCBF43927u, 1000u, true), RREC_ST_OK);
	zassert_equal(rsy_fw_data(0u, nine, 9u), RREC_ST_OK);
	zassert_equal(rsy_fw_end(), 10, "announced CRC differs by one bit: FW_ERROR");
	zassert_false(rhw_sim_image_upgrade_requested(), "nothing requested");
	zassert_equal(ev_count(RHW_EV_IMG_REQUEST), 0u);
	/* a byte of the image differs from the one the CRC was made for */
	zassert_equal(rsy_fw_begin(9u, 0xCBF43926u, 1000u, true), RREC_ST_OK);
	zassert_equal(rsy_fw_data(0u, nine_bad, 9u), RREC_ST_OK);
	zassert_equal(rsy_fw_end(), 10, "one byte differs: FW_ERROR");
	/* only part of the image was sent: the rest reads as erased bytes */
	zassert_equal(rsy_fw_begin(9u, 0xCBF43926u, 1000u, true), RREC_ST_OK);
	zassert_equal(rsy_fw_data(0u, nine, 5u), RREC_ST_OK);
	zassert_equal(rsy_fw_end(), 10, "an incomplete image: FW_ERROR");
	/* a write error of the store: FW_ERROR (the second write fails) */
	rhw_sim_image_write_error(2u);
	zassert_equal(rsy_fw_begin(9u, 0xCBF43926u, 1000u, true), RREC_ST_OK);
	zassert_equal(rsy_fw_data(0u, nine, 4u), RREC_ST_OK, "first write works");
	zassert_equal(rsy_fw_data(4u, nine + 4, 5u), 10, "second write fails: FW_ERROR");
	rhw_sim_image_write_error(0u);
	zassert_equal(ev_count(RHW_EV_IMG_REQUEST), 0u, "no test upgrade requested in any failing case");
	TC_PRINT("EVIDENCE sys_update bad crc: FW_END -> FW_ERROR(10) in 4 cases, upgrade requests %u\n",
		 (unsigned)ev_count(RHW_EV_IMG_REQUEST));
}

/* T10, FW l.1015 and ruling D12: allowed only with the battery ABOVE 30 % or VBUS present; otherwise NOT_ALLOWED (11).
 * soc_x10 is in tenths of a percent: 300 = 30.0 %. */
ZTEST(sys_update, test_allowed_rule)
{
	t_init();
	zassert_equal(rsy_fw_begin(100u, 0u, 300u, false), 11, "30.0 % without VBUS: NOT_ALLOWED");
	zassert_equal(rsy_fw_begin(100u, 0u, 299u, false), 11, "29.9 %: NOT_ALLOWED");
	zassert_equal(rsy_fw_begin(100u, 0u, 0u, false), 11, "0 %: NOT_ALLOWED");
	zassert_equal(ev_count(RHW_EV_IMG_ERASE), 0u, "a refused update erases nothing");
	zassert_equal(rsy_fw_begin(100u, 0u, 301u, false), RREC_ST_OK, "30.1 % without VBUS: accepted");
	zassert_equal(rsy_fw_begin(100u, 0u, 1000u, false), RREC_ST_OK, "100 %: accepted");
	zassert_equal(rsy_fw_begin(100u, 0u, 0u, true), RREC_ST_OK, "0 % with VBUS: accepted");
	zassert_equal(rsy_fw_begin(100u, 0u, 300u, true), RREC_ST_OK, "30.0 % with VBUS: accepted");
	zassert_equal(ev_count(RHW_EV_IMG_ERASE), 4u);
	TC_PRINT("EVIDENCE sys_update allowed: 300 no-VBUS -> 11, 301 -> OK, VBUS any -> OK\n");
}

/* T9, FW l.1014: all items pass: confirm. Without VBUS the USB item is not needed; with VBUS it is. */
ZTEST(sys_update, test_self_test_pass_confirms)
{
	t_init();
	rhw_sim_image_set_confirmed(false);
	zassert_equal(rsy_selftest_start(true), 1, "an unconfirmed image starts the self-test");
	zassert_true(rsy_selftest_running());
	rsy_selftest_pass(RSY_ITEM_STORAGE);
	rsy_selftest_pass(RSY_ITEM_BLUETOOTH);
	zassert_equal(ev_count(RHW_EV_IMG_CONFIRM), 0u, "with VBUS the USB item is still missing");
	zassert_true(rsy_selftest_running());
	rsy_selftest_pass(RSY_ITEM_USB);
	zassert_equal(ev_count(RHW_EV_IMG_CONFIRM), 1u, "all three passed: confirmed");
	zassert_false(rsy_selftest_running());
	zassert_equal(t_nlog(), 1);
	zassert_equal(t_log_at(0)->code, RREC_LOG_SELFTEST);
	zassert_equal(t_log_at(0)->args[0], 0, "log result 0 = pass");
	zassert_equal(t_log_at(0)->args[1], 7, "log mask: storage, Bluetooth and USB");
	rsy_selftest_pass(RSY_ITEM_USB);
	k_sleep(K_MSEC(31000));
	zassert_equal(rhw_sim_image_reboots(), 0u, "a passed self-test never reboots at 30 s");
	zassert_equal(ev_count(RHW_EV_IMG_CONFIRM), 1u, "one confirm only");
	TC_PRINT("EVIDENCE sys_update self-test pass: confirm events %u, reboots %u, log result %u mask %u\n",
		 (unsigned)ev_count(RHW_EV_IMG_CONFIRM), (unsigned)rhw_sim_image_reboots(), t_log_at(0)->args[0],
		 t_log_at(0)->args[1]);

	/* no VBUS: storage and Bluetooth are enough; passing the same item twice counts once */
	t_cleanup();
	t_init();
	rhw_sim_image_set_confirmed(false);
	zassert_equal(rsy_selftest_start(false), 1);
	rsy_selftest_pass(RSY_ITEM_STORAGE);
	rsy_selftest_pass(RSY_ITEM_STORAGE);
	zassert_equal(ev_count(RHW_EV_IMG_CONFIRM), 0u, "the same item twice is not two items");
	rsy_selftest_pass(RSY_ITEM_BLUETOOTH);
	zassert_equal(ev_count(RHW_EV_IMG_CONFIRM), 1u, "no VBUS: two items confirm");
	zassert_equal(t_log_at(0)->args[1], 3);

	/* a confirmed image: nothing to do, no window, no reboot, a late pass is ignored */
	t_cleanup();
	t_init();
	rhw_sim_image_set_confirmed(true);
	zassert_equal(rsy_selftest_start(true), 0, "a confirmed image: nothing to do");
	zassert_false(rsy_selftest_running());
	rsy_selftest_pass(RSY_ITEM_STORAGE);
	rsy_selftest_pass(RSY_ITEM_BLUETOOTH);
	rsy_selftest_pass(RSY_ITEM_USB);
	k_sleep(K_MSEC(31000));
	zassert_equal(ev_count(RHW_EV_IMG_CONFIRM), 0u);
	zassert_equal(rhw_sim_image_reboots(), 0u);
}

/* T9, FW l.1014: 30 s pass without every item: reboot without confirming. */
ZTEST(sys_update, test_self_test_timeout_reboots)
{
	t_init();
	rhw_sim_image_set_confirmed(false);
	zassert_equal(rsy_selftest_start(false), 1);
	int32_t start_ev = ev_find(RHW_EV_IMG_IS_CONFIRMED, 0);

	zassert_true(start_ev >= 0);
	rsy_selftest_pass(RSY_ITEM_STORAGE);   /* only one of the two needed items */
	k_sleep(K_MSEC(29900));
	zassert_true(rsy_selftest_running(), "still running at 29.9 s");
	zassert_equal(rhw_sim_image_reboots(), 0u, "no reboot before 30 s");
	k_sleep(K_MSEC(200));                  /* now 30.1 s after the start */
	zassert_false(rsy_selftest_running(), "the window ended");
	zassert_equal(rhw_sim_image_reboots(), 1u, "rebooted once");
	zassert_equal(rhw_sim_image_last_reboot(), 5, "reason SELFTEST_FAIL (5)");
	zassert_equal(ev_count(RHW_EV_IMG_CONFIRM), 0u, "never confirmed");
	struct rhw_sim_ev s, r;

	zassert_true(ev_get(start_ev, &s));
	zassert_true(ev_get(ev_find(RHW_EV_IMG_REBOOT, 0), &r));
	int64_t dt_us = r.t_us - s.t_us;

	zassert_true(dt_us >= 30000000 && dt_us <= 30005000, "reboot %lld us after the start (30 s = 30,000,000 us)", dt_us);
	zassert_equal(t_nlog(), 1);
	zassert_equal(t_log_at(0)->code, RREC_LOG_SELFTEST);
	zassert_equal(t_log_at(0)->args[0], 2, "log result 2 = window ended");
	zassert_equal(t_log_at(0)->args[1], 1, "log mask: storage only");
	TC_PRINT("EVIDENCE sys_update self-test timeout: reboot %lld us after the start, reason %d, confirms %u\n", dt_us,
		 rhw_sim_image_last_reboot(), (unsigned)ev_count(RHW_EV_IMG_CONFIRM));
}

/* T9, FW l.1014: the microphones are not powered in the self-test: neither rail nor input is touched by the unit, in the
 * passing run and in the run that times out. */
ZTEST(sys_update, test_self_test_no_mic)
{
	t_init();
	rhw_sim_image_set_confirmed(false);
	zassert_equal(rsy_selftest_start(true), 1);
	rsy_selftest_pass(RSY_ITEM_STORAGE);
	rsy_selftest_pass(RSY_ITEM_BLUETOOTH);
	rsy_selftest_pass(RSY_ITEM_USB);
	zassert_equal(ev_count(RHW_EV_PMIC_RAIL), 0u, "a passing self-test switches no rail");
	zassert_equal(ev_count(RHW_EV_MIC_CONFIGURE) + ev_count(RHW_EV_MIC_START) + ev_count(RHW_EV_MIC_READ), 0u);
	zassert_equal(strlen(rhw_sim_pmic_rail_caller(RHW_RAIL_MIC)), 0u, "the microphone rail was never written");
	t_cleanup();
	t_init();
	rhw_sim_image_set_confirmed(false);
	zassert_equal(rsy_selftest_start(true), 1);
	k_sleep(K_MSEC(31000));
	zassert_equal(rhw_sim_image_reboots(), 1u);
	zassert_equal(ev_count(RHW_EV_PMIC_RAIL), 0u, "a failing self-test switches no rail");
	zassert_equal(ev_count(RHW_EV_MIC_START), 0u);
	TC_PRINT("EVIDENCE sys_update self-test no mic: rail events %u, microphone input events %u\n",
		 (unsigned)ev_count(RHW_EV_PMIC_RAIL), (unsigned)ev_count(RHW_EV_MIC_START));
}
```

## src/test_wdt.c
```c
/* Suite sys_wdt (software step 6, unit U7): the watchdog feed rule (FW l.1065, plan row C23/T29) on the simulated
 * watchdog: 8 s timeout, fed every 1 s, only when the audio and storage threads reported progress in the last 2 s, or when
 * no recording runs (ruling on the root unit's reading 9). The watchdog reset itself is not provable without hardware. */
#include "common.h"

static void before(void *f)
{
	ARG_UNUSED(f);
	rhw_sim_reset();
}

static void after(void *f)
{
	ARG_UNUSED(f);
	t_cleanup();
}

ZTEST_SUITE(sys_wdt, NULL, NULL, before, after, NULL);

/* both threads report every 500 ms for `ms` ms */
static void both_report(uint32_t ms)
{
	for (uint32_t t = 0; t < ms; t += 500u) {
		rsy_progress(RSY_THREAD_AUDIO);
		rsy_progress(RSY_THREAD_STORAGE);
		k_sleep(K_MSEC(500));
	}
}

/* C23/T29: during a recording the feed needs progress of BOTH threads. The storage thread stalls: feeding stops, and the
 * simulated watchdog reports that it would have reset. */
ZTEST(sys_wdt, test_feed_only_with_progress)
{
	t_init();
	zassert_equal(rsy_wdt_start(), 0);
	zassert_true(rhw_sim_wdt_started());
	rsy_recording(true);
	both_report(10000u);
	uint32_t f_ok = rhw_sim_wdt_feeds();

	zassert_true(f_ok >= 8u && f_ok <= 10u, "10 s of progress by both: %u feeds (about 1 per second)", (unsigned)f_ok);
	zassert_false(rhw_sim_wdt_would_reset(), "no reset while both report");

	/* only the audio thread goes on: the storage thread has stopped */
	for (int i = 0; i < 24; i++) {
		rsy_progress(RSY_THREAD_AUDIO);
		k_sleep(K_MSEC(500));
	}
	uint32_t f_stall = rhw_sim_wdt_feeds();

	zassert_true(f_stall <= f_ok + 2u, "at most the two ticks inside the 2 s window still feed: %u after %u",
		     (unsigned)f_stall, (unsigned)f_ok);
	zassert_true(rhw_sim_wdt_would_reset(), "12 s without a feed: the watchdog would have reset");

	/* and the other way round: audio stops, storage goes on */
	t_cleanup();
	t_init();
	zassert_equal(rsy_wdt_start(), 0);
	rsy_recording(true);
	both_report(4000u);
	uint32_t g0 = rhw_sim_wdt_feeds();

	for (int i = 0; i < 24; i++) {
		rsy_progress(RSY_THREAD_STORAGE);
		k_sleep(K_MSEC(500));
	}
	zassert_true(rhw_sim_wdt_feeds() <= g0 + 2u, "audio stalled: feeding stops (%u after %u)",
		     (unsigned)rhw_sim_wdt_feeds(), (unsigned)g0);
	zassert_true(rhw_sim_wdt_would_reset());
	TC_PRINT("EVIDENCE sys_wdt: feeds with progress %u in 10 s; feeds after a 12 s stall of one thread %u; would_reset %d\n",
		 (unsigned)f_ok, (unsigned)f_stall, (int)true);
}

/* Start values: the watchdog is started with 8,000 ms, once; a second start is refused; a start the driver refuses is
 * reported. */
ZTEST(sys_wdt, test_start_8s_once)
{
	struct rhw_sim_ev e;

	t_init();
	zassert_false(rhw_sim_wdt_started());
	zassert_equal(rsy_wdt_start(), 0);
	zassert_true(ev_get(ev_find(RHW_EV_WDT_START, 0), &e));
	zassert_equal(e.a0, 8000, "timeout 8 s (FW l.1065)");
	zassert_equal(rsy_wdt_start(), -EALREADY, "started once");
	zassert_equal(ev_count(RHW_EV_WDT_START), 1u);
	t_cleanup();
	t_init();
	zassert_equal(rhw_pmic()->ship_task(), 0);
	zassert_not_equal(rsy_wdt_start(), 0, "a refused driver start is an error");
	zassert_equal(ev_count(RHW_EV_WDT_FEED), 0u);
}

/* No recording runs: the threads do not report, and the watchdog is fed every second all the same. Feeds come 1 s apart. */
ZTEST(sys_wdt, test_feed_when_no_recording)
{
	t_init();
	zassert_equal(rsy_wdt_start(), 0);
	k_sleep(K_MSEC(30500));
	uint32_t f = rhw_sim_wdt_feeds();

	zassert_equal(f, 30u, "30 feeds in 30.5 s");
	zassert_false(rhw_sim_wdt_would_reset());
	struct rhw_sim_ev a, b;
	int32_t i0 = ev_find(RHW_EV_WDT_FEED, 0);

	zassert_true(ev_get(i0, &a));
	for (int k = 1; k < 30; k++) {
		int32_t i1 = ev_find(RHW_EV_WDT_FEED, (uint32_t)i0 + 1u);

		zassert_true(ev_get(i1, &b));
		zassert_true(b.t_us - a.t_us >= 999000 && b.t_us - a.t_us <= 1001000, "feed %d came %lld us after the one before", k,
			     b.t_us - a.t_us);
		a = b;
		i0 = i1;
	}
	/* a recording that ends resumes feeding at once: stall during a recording, then stop it */
	rsy_recording(true);
	k_sleep(K_MSEC(6000));
	uint32_t f_stalled = rhw_sim_wdt_feeds();

	rsy_recording(false);
	k_sleep(K_MSEC(2000));
	zassert_true(rhw_sim_wdt_feeds() >= f_stalled + 1u, "feeding resumes when the recording ends");
	TC_PRINT("EVIDENCE sys_wdt no recording: %u feeds in 30.5 s with no progress reports, spacing 1 s\n", (unsigned)f);
}

/* FW l.1065 "in the last 2 s" at the edge, on the pure rule: 2,000 ms ago counts, 2,001 ms does not; never reported does
 * not; no recording needs no progress. */
ZTEST(sys_wdt, test_progress_window_edges)
{
	const int64_t now = 100000;

	zassert_true(rsl_wdt_should_feed(true, now, now - 2000, now - 2000), "2,000 ms: counts");
	zassert_false(rsl_wdt_should_feed(true, now, now - 2001, now - 2000), "audio 2,001 ms ago");
	zassert_false(rsl_wdt_should_feed(true, now, now - 2000, now - 2001), "storage 2,001 ms ago");
	zassert_true(rsl_wdt_should_feed(true, now, now, now));
	zassert_false(rsl_wdt_should_feed(true, now, RSL_NEVER, now), "audio never reported");
	zassert_false(rsl_wdt_should_feed(true, now, now, RSL_NEVER), "storage never reported");
	zassert_true(rsl_wdt_should_feed(false, now, RSL_NEVER, RSL_NEVER), "no recording: fed without progress");
	zassert_equal(RREC_WDT_TIMEOUT_MS, 8000u);
	zassert_equal(RREC_WDT_FEED_MS, 1000u);
	zassert_equal(RREC_WDT_PROGRESS_MS, 2000u);
}

/* A new recording does not inherit the progress of the one before: reports count only when made during this recording. */
ZTEST(sys_wdt, test_new_recording_clears_old_progress)
{
	t_init();
	zassert_equal(rsy_wdt_start(), 0);
	rsy_recording(true);
	both_report(2000u);
	rsy_recording(false);
	rsy_recording(true);                 /* the next recording starts at once; both reports above are stale for it */
	uint32_t f0 = rhw_sim_wdt_feeds();

	k_sleep(K_MSEC(1500));               /* one tick inside the 2 s of the old reports */
	zassert_equal(rhw_sim_wdt_feeds(), f0, "old progress does not feed a new recording");
	rsy_progress(RSY_THREAD_AUDIO);
	rsy_progress(RSY_THREAD_STORAGE);
	k_sleep(K_MSEC(1000));
	zassert_true(rhw_sim_wdt_feeds() > f0, "reports of this recording feed");
}
```
