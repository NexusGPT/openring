## CMakeLists.txt
```
cmake_minimum_required(VERSION 3.20.0)
# Compile check of ring_sys's real driver file against the kit for the nRF54LM20 development kit (manual, not part of
# the unit run: no testcase.yaml here). See ../../../docs/sys-notes.md.
set(FWM ${CMAKE_CURRENT_SOURCE_DIR}/../../../modules)
list(APPEND ZEPHYR_EXTRA_MODULES ${FWM}/ring_rhw ${FWM}/ring_sys)
find_package(Zephyr REQUIRED HINTS $ENV{ZEPHYR_BASE})
project(ring_sys_kitcompile)
target_include_directories(app PRIVATE ${FWM}/ring_sys/src)
target_sources(app PRIVATE src/main.c)
```

## prj.conf
```kconfig
CONFIG_RING_RHW=y
CONFIG_RING_SYS=y
CONFIG_SETTINGS=y
CONFIG_WATCHDOG=y
CONFIG_RETAINED_MEM=y
CONFIG_BOOTLOADER_MCUBOOT=y
CONFIG_THREAD_NAME=y
CONFIG_FLASH=y
CONFIG_FLASH_MAP=y
CONFIG_IMG_MANAGER=y
CONFIG_MCUBOOT_IMG_MANAGER=y
CONFIG_STREAM_FLASH=y
```

## app.overlay
```dts
/* the board files of step 7 will switch the watchdog on; this scratch compile does it here */
&wdt31 {
	status = "okay";
};
```

## src/main.c
```c
/* Compile check only: touches every public call of ring_sys so the thin part and the real file are linked. */
#include <zephyr/kernel.h>
#include <ring_sys/rsy.h>
#include "rsy_int.h"

int main(void)
{
	struct rrec_crash c;
	uint8_t gp;
	int64_t t;

	(void)rsy_init(NULL);
	(void)rsy_selftest_start(true);
	rsy_selftest_pass(RSY_ITEM_STORAGE);
	(void)rsy_fw_begin(1, 0, 1000, true);
	(void)rsy_fw_data(0, (const uint8_t *)"x", 1);
	(void)rsy_fw_end();
	(void)rsy_factory_flag();
	(void)rsy_time_guess(&t);
	(void)rsy_crash_take(&c, &gp);
	(void)rsy_wdt_start();
	rsy_progress(RSY_THREAD_AUDIO);
	rsy_recording(false);
	rsy_fatal(0, NULL);
	return 0;
}
```
