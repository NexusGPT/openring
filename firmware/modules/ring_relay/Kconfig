## firmware/modules/ring_relay/Kconfig
```kconfig
config RING_RELAY_LOGIC
	bool "Ring relay logic: frames and records of the relay service (pure)"
	select RING_INBOX
	help
	  No kernel, driver or Bluetooth call.

config RING_RELAY
	bool "Ring relay: notifications from a helper app on an Android phone"
	select RING_RELAY_LOGIC
	select RING_IPHONE
	depends on BT_PERIPHERAL && BT_SMP
	help
	  A Bluetooth service of the ring (design/firmware.md section 7.7) that accepts notifications
	  from a helper app and puts them in the same store as the iPhone's. Nothing received here can
	  start or stop a recording, and nothing here calls the core.

config RING_RELAY_TEST_HOOKS
	bool "Ring relay test hooks (tests only)"
	depends on RING_RELAY
	default n
	help
	  Lets a test block the Out queue. Never set in the product (tools/build_all.sh checks the product's settings).
```

## firmware/modules/ring_sys/Kconfig
```kconfig
config RING_SYS_LOGIC
	bool "Ring sys: update checks, self-test steps, crash block, watchdog rule, saved time (pure part, no kernel call)"
	select CRC
	help
	  Image size and range checks, the running CRC-32, the 30 s self-test step machine, the update-allowed rule,
	  the crash block format, the watchdog feed decision and the saved-time guess (design/firmware.md sections 9.1
	  to 9.4). Stdint, stdbool, string and the CRC library only.

config RING_SYS
	bool "Ring sys: firmware update, settings, crash capture, watchdog (thin part, hardware only through ring_rhw)"
	depends on RING_RHW
	select RING_SYS_LOGIC
	select REBOOT if !RING_RHW_SIM
	help
	  The update calls on slot 1, the self-test window, the factory flag and saved time in the settings, the crash
	  block in retained memory and the watchdog feed work (design/firmware.md sections 9.1 to 9.4).

if RING_SYS

config RING_SYS_FATAL_HANDLER
	bool "Replace k_sys_fatal_error_handler() with the crash capture of FW l.1063"
	default y
	depends on !ZTEST
	help
	  The test framework defines its own handler, so test builds leave this off and call the capture function
	  of rsy_int.h directly.

endif
```

## firmware/modules/ring_time/Kconfig
```kconfig
config RING_TIME_LOGIC
	bool "Ring time logic: the clock record and civil time conversion (pure)"
	help
	  No kernel, driver or Bluetooth call.

config RING_TIME
	bool "Ring time: the ring's clock (UTC in ms and a time-is-set flag)"
	select RING_TIME_LOGIC
	help
	  UTC milliseconds from the kernel uptime plus an offset that is set from outside
	  (the iPhone's Current Time Service, later USB SET_TIME). design/firmware.md section 9.1.
```

## firmware/tests/audio/testcase.yaml
```yaml
tests:
  ring_audio.sim:
    tags: ring_audio
    platform_allow:
      - native_sim
      - nrf54lm20bsim/nrf54lm20a/cpuapp
    integration_platforms:
      - native_sim
```

## firmware/tests/control/testcase.yaml
```yaml
tests:
  ring_control.logic:
    tags: ring_control
    platform_allow:
      - native_sim
      - nrf54lm20bsim/nrf54lm20a/cpuapp
    integration_platforms:
      - native_sim
```

## firmware/tests/core/testcase.yaml
```yaml
tests:
  ring_core.logic:
    tags: ring_core
    platform_allow:
      - native_sim
      - nrf54lm20bsim/nrf54lm20a/cpuapp
    integration_platforms:
      - native_sim
```

## firmware/tests/inbox/testcase.yaml
```yaml
tests:
  ring_inbox.logic:
    tags: ring_inbox
    platform_allow:
      - native_sim
      - nrf54lm20bsim/nrf54lm20a/cpuapp
    integration_platforms:
      - native_sim
```

## firmware/tests/iphone/testcase.yaml
```yaml
tests:
  ring_iphone.logic:
    tags: ring_iphone
    platform_allow:
      - native_sim
      - nrf54lm20bsim/nrf54lm20a/cpuapp
    integration_platforms:
      - native_sim
```

## firmware/tests/motor/testcase.yaml
```yaml
tests:
  ring_motor.sim:
    tags: ring_motor
    platform_allow:
      - native_sim
      - nrf54lm20bsim/nrf54lm20a/cpuapp
    integration_platforms:
      - native_sim
```

## firmware/tests/recorder/testcase.yaml
```yaml
tests:
  ring_recorder.sim:
    tags: ring_recorder
    timeout: 3600
    platform_allow:
      - native_sim
      - nrf54lm20bsim/nrf54lm20a/cpuapp
    integration_platforms:
      - native_sim
```

## firmware/tests/rhw/testcase.yaml
```yaml
tests:
  ring_rhw.sim:
    tags: ring_rhw
    platform_allow:
      - native_sim
      - nrf54lm20bsim/nrf54lm20a/cpuapp
    integration_platforms:
      - native_sim
```

## firmware/tests/screens/testcase.yaml
```yaml
tests:
  ring_screens.all:
    tags: ring_screens
    timeout: 120
    platform_allow:
      - native_sim
      - nrf54lm20bsim/nrf54lm20a/cpuapp
    integration_platforms:
      - native_sim
```

## firmware/tests/smoke/testcase.yaml
```yaml
tests:
  ring.smoke:
    tags: ring smoke
    platform_allow:
      - native_sim
      - nrf54lm20bsim/nrf54lm20a/cpuapp
    integration_platforms:
      - native_sim
      - nrf54lm20bsim/nrf54lm20a/cpuapp
```

## firmware/tests/sys/testcase.yaml
```yaml
tests:
  ring_sys.sim:
    tags: ring_sys
    platform_allow:
      - native_sim
      - nrf54lm20bsim/nrf54lm20a/cpuapp
    integration_platforms:
      - native_sim
```

## firmware/tests/time/testcase.yaml
```yaml
tests:
  ring_time.logic:
    tags: ring_time
    platform_allow:
      - native_sim
      - nrf54lm20bsim/nrf54lm20a/cpuapp
    integration_platforms:
      - native_sim
```

## firmware/tests/xfer/real_build/testcase.yaml
```yaml
tests:
  ring_xfer.real_build:
    tags: ring_xfer
    build_only: true
    platform_allow:
      - native_sim
    integration_platforms:
      - native_sim
```

## firmware/tests/xfer/testcase.yaml
```yaml
tests:
  ring_xfer.sim:
    tags: ring_xfer
    platform_allow:
      - native_sim
      - nrf54lm20bsim/nrf54lm20a/cpuapp
    integration_platforms:
      - native_sim
```
