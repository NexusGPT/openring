/* Generated by tools/gen_table.py from design/firmware.md section 1.2. Do not edit. */
#define RC_TABLE_ROWS 72
#define RC_TABLE_FNV1A 0xe61dece0u
RC_ROW(1, 133, SHIP, VBUS_IN, NONE, BOOT, "VBUS appears (case contact)")
RC_ROW(2, 134, OFF, VBUS_IN, NONE, BOOT, "VBUS appears")
RC_ROW(3, 135, BOOT, INIT_DONE, OPEN_CLEAR_NO_VBUS_ABOVE_B5, STANDBY, "init done, superblock open flag clear, no VBUS, battery above B5")
RC_ROW(4, 136, BOOT, INIT_DONE, OPEN_SET, RECOVERY, "init done, superblock open flag set")
RC_ROW(5, 137, BOOT, INIT_DONE, VBUS, CHARGING, "init done, VBUS present")
RC_ROW(6, 138, BOOT, STORAGE_INIT_FAILED, NONE, ERR_STORAGE_FAULT, "storage init fails 3 times, 200 ms apart")
RC_ROW(7, 139, BOOT, BATT_B2, NO_VBUS, OFF, "battery at B2 and no VBUS")
RC_ROW(8, 140, BOOT, BATT_B5, NO_VBUS, ERR_BATTERY_LOW, "battery at B5 and no VBUS")
RC_ROW(9, 141, RECOVERY, SCAN_DONE, NO_VBUS, STANDBY, "scan done, no VBUS")
RC_ROW(10, 142, RECOVERY, SCAN_DONE, VBUS, CHARGING, "scan done, VBUS present")
RC_ROW(11, 143, RECOVERY, SCAN_READ_ERROR, NONE, ERR_STORAGE_FAULT, "read error during scan")
RC_ROW(12, 144, STANDBY, LONG_PRESS, OPEN_CLEAR_ABOVE_B5_ABOVE_SFULL_SIGN, RECORDING, "long press of the joystick centre")
RC_ROW(13, 145, STANDBY, LONG_PRESS, OPEN_SET, RECOVERY, "long press, superblock open flag set")
RC_ROW(14, 146, STANDBY, LONG_PRESS, AT_B5, STANDBY, "long press of the joystick centre, battery at B5")
RC_ROW(15, 147, STANDBY, LONG_PRESS, SFULL, STANDBY, "long press of the joystick centre, free space at SFULL")
RC_ROW(16, 148, STANDBY, LONG_PRESS, SIGN_NOT_DRAWN, STANDBY, "long press of the joystick centre, recording sign not drawn")
RC_ROW(17, 149, STANDBY, SHORT_PRESS, NONE, STANDBY, "short press of the joystick centre")
RC_ROW(18, 150, STANDBY, DOUBLE_PRESS, NONE, STANDBY, "double press of the joystick centre")
RC_ROW(19, 151, STANDBY, MENU_POWER_OFF, NONE, OFF, "menu \"Power off\" confirmed")
RC_ROW(20, 152, STANDBY, VBUS_IN, NONE, CHARGING, "VBUS appears")
RC_ROW(21, 153, STANDBY, BATT_B15, NONE, STANDBY, "battery reaches B15")
RC_ROW(22, 154, STANDBY, BATT_B5, NONE, ERR_BATTERY_LOW, "battery reaches B5")
RC_ROW(23, 155, STANDBY, BATT_B2, NONE, OFF, "battery reaches B2")
RC_ROW(24, 156, STANDBY, STORAGE_SFULL, NONE, ERR_STORAGE_FULL, "free space at SFULL")
RC_ROW(25, 157, STANDBY, STORAGE_FAULT_SET, NONE, ERR_STORAGE_FAULT, "storage fault set at entry (rule R-STB)")
RC_ROW(26, 158, RECORDING, LONG_PRESS, NONE, STANDBY, "long press of the joystick centre")
RC_ROW(27, 159, RECORDING, SHORT_PRESS, NONE, RECORDING, "short press of the joystick centre")
RC_ROW(28, 160, RECORDING, DOUBLE_PRESS, NONE, RECORDING, "double press of the joystick centre")
RC_ROW(29, 161, RECORDING, BLE_HIGHLIGHT, NONE, RECORDING, "BLE control \"highlight\" from a bonded phone")
RC_ROW(30, 162, RECORDING, VBUS_IN, NONE, CHARGING, "VBUS appears (case insertion during a recording)")
RC_ROW(31, 163, RECORDING, BATT_B15, NONE, RECORDING, "battery reaches B15")
RC_ROW(32, 164, RECORDING, BATT_B5, NONE, ERR_BATTERY_LOW, "battery reaches B5")
RC_ROW(33, 165, RECORDING, BATT_B2, NONE, OFF, "battery reaches B2")
RC_ROW(34, 166, RECORDING, STORAGE_S30, NONE, RECORDING, "free space reaches S30")
RC_ROW(35, 167, RECORDING, STORAGE_SFULL, NONE, ERR_STORAGE_FULL, "free space at SFULL")
RC_ROW(36, 168, RECORDING, CHUNK_WRITE_FAILED, NONE, ERR_STORAGE_FAULT, "chunk write fails 3 times")
RC_ROW(37, 169, RECORDING, MIC_NO_BLOCK, NONE, ERR_MIC_FAULT, "the PDM instance gives no block for 100 ms")
RC_ROW(38, 170, RECORDING, POWER_LOSS, NONE, BOOT, "sudden power loss (cell cut, short, brown-out) during a write")
RC_ROW(39, 171, CHARGING, USB_CONFIGURED, NONE, TRANSFER, "USB configured by the case (`USBD_MSG_CONFIGURATION`)")
RC_ROW(40, 172, CHARGING, VBUS_OUT, ABOVE_SFULL_ABOVE_B5, STANDBY, "VBUS removed, free space above SFULL, battery above B5")
RC_ROW(41, 173, CHARGING, VBUS_OUT, SFULL_ABOVE_B5, ERR_STORAGE_FULL, "VBUS removed, free space at SFULL, battery above B5")
RC_ROW(42, 174, CHARGING, VBUS_OUT, AT_B2, OFF, "VBUS removed, battery at B2")
RC_ROW(43, 175, CHARGING, VBUS_OUT, AT_B5, ERR_BATTERY_LOW, "VBUS removed, battery at B5")
RC_ROW(44, 176, CHARGING, CHARGE_ERROR, NONE, ERR_CHARGER, "nPM1304 event charge error")
RC_ROW(45, 177, CHARGING, LONG_PRESS, NONE, CHARGING, "long press")
RC_ROW(46, 178, TRANSFER, USB_UNCONFIGURED, NONE, CHARGING, "USB suspended or unconfigured by the case")
RC_ROW(47, 179, TRANSFER, VBUS_OUT, NONE, STANDBY, "VBUS removed")
RC_ROW(48, 180, TRANSFER, FW_END, NONE, BOOT, "command FW_END accepted")
RC_ROW(49, 181, TRANSFER, FACTORY_ENTER, FACTORY_FLAG, FACTORY_TEST, "command FACTORY_ENTER with the factory flag set")
RC_ROW(50, 182, TRANSFER, LONG_PRESS, NONE, TRANSFER, "long press")
RC_ROW(51, 183, ERR_STORAGE_FULL, VBUS_IN, NONE, CHARGING, "VBUS appears")
RC_ROW(52, 184, ERR_STORAGE_FULL, LONG_PRESS, NONE, ERR_STORAGE_FULL, "long press")
RC_ROW(53, 185, ERR_STORAGE_FULL, BATT_B5, NONE, ERR_BATTERY_LOW, "battery reaches B5")
RC_ROW(54, 186, ERR_STORAGE_FULL, BATT_B2, NONE, OFF, "battery reaches B2")
RC_ROW(55, 187, ERR_BATTERY_LOW, VBUS_IN, NONE, CHARGING, "VBUS appears")
RC_ROW(56, 188, ERR_BATTERY_LOW, LONG_PRESS, NONE, ERR_BATTERY_LOW, "long press")
RC_ROW(57, 189, ERR_BATTERY_LOW, BATT_B2, NONE, OFF, "battery reaches B2")
RC_ROW(58, 190, ERR_STORAGE_FAULT, VBUS_IN, NONE, CHARGING, "VBUS appears")
RC_ROW(59, 191, ERR_STORAGE_FAULT, TIMER_60S, NONE, ERR_STORAGE_FAULT, "60 s elapsed")
RC_ROW(60, 192, ERR_STORAGE_FAULT, STORAGE_RETRY_OK, OPEN_SET, RECOVERY, "storage retry succeeds, superblock open flag set")
RC_ROW(61, 193, ERR_STORAGE_FAULT, STORAGE_RETRY_OK, OPEN_CLEAR, STANDBY, "storage retry succeeds, superblock open flag clear")
RC_ROW(62, 194, ERR_STORAGE_FAULT, STORAGE_RETRY_FAILED, NONE, ERR_STORAGE_FAULT, "storage retry fails")
RC_ROW(63, 195, ERR_STORAGE_FAULT, BATT_B2, NONE, OFF, "battery reaches B2")
RC_ROW(64, 196, ERR_MIC_FAULT, TIMER_5S, NONE, STANDBY, "5 s elapsed")
RC_ROW(65, 197, ERR_MIC_FAULT, VBUS_IN, NONE, CHARGING, "VBUS appears")
RC_ROW(66, 198, ERR_MIC_FAULT, BATT_B2, NONE, OFF, "battery reaches B2")
RC_ROW(67, 199, ERR_CHARGER, VBUS_OUT, NONE, STANDBY, "VBUS removed")
RC_ROW(68, 200, ERR_CHARGER, BATT_B2, NONE, OFF, "battery reaches B2")
RC_ROW(69, 201, FACTORY_TEST, FACTORY_EXIT, NONE, BOOT, "command FACTORY_EXIT")
RC_ROW(70, 202, FACTORY_TEST, SHIP_ENTER, NONE, SHIP, "command SHIP_ENTER")
RC_ROW(71, 203, FACTORY_TEST, SHIP_SAMPLE, NONE, SHIP, "command SHIP_SAMPLE (sample rings only)")
RC_ROW(72, 204, FACTORY_TEST, VBUS_OUT, NONE, BOOT, "VBUS removed, no ship command accepted")
